[part 5 of 11: package /CANAnalyzer/CommunicationClusters]
AUTOSAR XML (schema 00051)
package /CANAnalyzer/CommunicationClusters  (continued)
  can cluster CAN_FD_IPB_41  (continued)
    can physical channel Channel  (continued)
      frame StatusCPDData1FBD_VL: id 0x14E, frame-length=64, can-addressing-mode=STANDARD, can-frame-rx-behavior=CAN-FD, can-frame-tx-behavior=CAN-FD
        pdu StatusCPDData1FBD_VL: length=64, unused-bit-pattern=0
          signal StatusCPDData1FBD_VL_MsgCounter: start 0, 8 bit, little-endian, data-type-policy=OVERRIDE, base-type=uint8, compu {phys=raw}, range phys 0..252
          signal StatusCPDData1FBD_VL_LinkID: start 8, 8 bit, little-endian, data-type-policy=OVERRIDE, base-type=uint8, compu {phys=raw}, range phys 0..252
          signal StatusCPDData1FBD_VL_AGCValue: start 16, 8 bit, little-endian, data-type-policy=OVERRIDE, base-type=uint8, compu {phys=raw}, range phys 0..252
          signal StatusCPDData1FBD_VL_Channel: start 24, 8 bit, little-endian, data-type-policy=OVERRIDE, base-type=uint8, compu {phys=raw}, range phys 0..252
          signal StatusCPDData1FBD_VL_CIRData00: start 32, 8 bit, little-endian, data-type-policy=OVERRIDE, base-type=uint8, compu {phys=raw}, range phys 0..255
          signal StatusCPDData1FBD_VL_CIRData01: start 40, 8 bit, little-endian, data-type-policy=OVERRIDE, base-type=uint8, compu {phys=raw}, range phys 0..255
          signal StatusCPDData1FBD_VL_CIRData02: start 48, 8 bit, little-endian, data-type-policy=OVERRIDE, base-type=uint8, compu {phys=raw}, range phys 0..255
          signal StatusCPDData1FBD_VL_CIRData03: start 56, 8 bit, little-endian, data-type-policy=OVERRIDE, base-type=uint8, compu {phys=raw}, range phys 0..255
          signal StatusCPDData1FBD_VL_CIRData04: start 64, 8 bit, little-endian, data-type-policy=OVERRIDE, base-type=uint8, compu {phys=raw}, range phys 0..255
          signal StatusCPDData1FBD_VL_CIRData05: start 72, 8 bit, little-endian, data-type-policy=OVERRIDE, base-type=uint8, compu {phys=raw}, range phys 0..255
          signal StatusCPDData1FBD_VL_CIRData06: start 80, 8 bit, little-endian, data-type-policy=OVERRIDE, base-type=uint8, compu {phys=raw}, range phys 0..255
          signal StatusCPDData1FBD_VL_CIRData07: start 88, 8 bit, little-endian, data-type-policy=OVERRIDE, base-type=uint8, compu {phys=raw}, range phys 0..255
          signal StatusCPDData1FBD_VL_CIRData08: start 96, 8 bit, little-endian, data-type-policy=OVERRIDE, base-type=uint8, compu {phys=raw}, range phys 0..255
          signal StatusCPDData1FBD_VL_CIRData09: start 104, 8 bit, little-endian, data-type-policy=OVERRIDE, base-type=uint8, compu {phys=raw}, range phys 0..255
          signal StatusCPDData1FBD_VL_CIRData10: start 112, 8 bit, little-endian, data-type-policy=OVERRIDE, base-type=uint8, compu {phys=raw}, range phys 0..255
          signal StatusCPDData1FBD_VL_CIRData11: start 120, 8 bit, little-endian, data-type-policy=OVERRIDE, base-type=uint8, compu {phys=raw}, range phys 0..255
          signal StatusCPDData1FBD_VL_CIRData12: start 128, 8 bit, little-endian, data-type-policy=OVERRIDE, base-type=uint8, compu {phys=raw}, range phys 0..255
          signal StatusCPDData1FBD_VL_CIRData13: start 136, 8 bit, little-endian, data-type-policy=OVERRIDE, base-type=uint8, compu {phys=raw}, range phys 0..255
          signal StatusCPDData1FBD_VL_CIRData14: start 144, 8 bit, little-endian, data-type-policy=OVERRIDE, base-type=uint8, compu {phys=raw}, range phys 0..255
          signal StatusCPDData1FBD_VL_CIRData15: start 152, 8 bit, little-endian, data-type-policy=OVERRIDE, base-type=uint8, compu {phys=raw}, range phys 0..255
          signal StatusCPDData1FBD_VL_CIRData16: start 160, 8 bit, little-endian, data-type-policy=OVERRIDE, base-type=uint8, compu {phys=raw}, range phys 0..255
          signal StatusCPDData1FBD_VL_CIRData17: start 168, 8 bit, little-endian, data-type-policy=OVERRIDE, base-type=uint8, compu {phys=raw}, range phys 0..255
          signal StatusCPDData1FBD_VL_CIRData18: start 176, 8 bit, little-endian, data-type-policy=OVERRIDE, base-type=uint8, compu {phys=raw}, range phys 0..255
          signal StatusCPDData1FBD_VL_CIRData19: start 184, 8 bit, little-endian, data-type-policy=OVERRIDE, base-type=uint8, compu {phys=raw}, range phys 0..255
          signal StatusCPDData1FBD_VL_CIRData20: start 192, 8 bit, little-endian, data-type-policy=OVERRIDE, base-type=uint8, compu {phys=raw}, range phys 0..255
          signal StatusCPDData1FBD_VL_CIRData21: start 200, 8 bit, little-endian, data-type-policy=OVERRIDE, base-type=uint8, compu {phys=raw}, range phys 0..255
          signal StatusCPDData1FBD_VL_CIRData22: start 208, 8 bit, little-endian, data-type-policy=OVERRIDE, base-type=uint8, compu {phys=raw}, range phys 0..255
          signal StatusCPDData1FBD_VL_CIRData23: start 216, 8 bit, little-endian, data-type-policy=OVERRIDE, base-type=uint8, compu {phys=raw}, range phys 0..255
          signal StatusCPDData1FBD_VL_CIRData24: start 224, 8 bit, little-endian, data-type-policy=OVERRIDE, base-type=uint8, compu {phys=raw}, range phys 0..255
          signal StatusCPDData1FBD_VL_CIRData25: start 232, 8 bit, little-endian, data-type-policy=OVERRIDE, base-type=uint8, compu {phys=raw}, range phys 0..255
          signal StatusCPDData1FBD_VL_CIRData26: start 240, 8 bit, little-endian, data-type-policy=OVERRIDE, base-type=uint8, compu {phys=raw}, range phys 0..255
          signal StatusCPDData1FBD_VL_CIRData27: start 248, 8 bit, little-endian, data-type-policy=OVERRIDE, base-type=uint8, compu {phys=raw}, range phys 0..255
          signal StatusCPDData1FBD_VL_CIRData28: start 256, 8 bit, little-endian, data-type-policy=OVERRIDE, base-type=uint8, compu {phys=raw}, range phys 0..255
          signal StatusCPDData1FBD_VL_CIRData29: start 264, 8 bit, little-endian, data-type-policy=OVERRIDE, base-type=uint8, compu {phys=raw}, range phys 0..255
          signal StatusCPDData1FBD_VL_CIRData30: start 272, 8 bit, little-endian, data-type-policy=OVERRIDE, base-type=uint8, compu {phys=raw}, range phys 0..255
          signal StatusCPDData1FBD_VL_CIRData31: start 280, 8 bit, little-endian, data-type-policy=OVERRIDE, base-type=uint8, compu {phys=raw}, range phys 0..255
          signal StatusCPDData1FBD_VL_CIRData32: start 288, 8 bit, little-endian, data-type-policy=OVERRIDE, base-type=uint8, compu {phys=raw}, range phys 0..255
          signal StatusCPDData1FBD_VL_CIRData33: start 296, 8 bit, little-endian, data-type-policy=OVERRIDE, base-type=uint8, compu {phys=raw}, range phys 0..255
          signal StatusCPDData1FBD_VL_CIRData34: start 304, 8 bit, little-endian, data-type-policy=OVERRIDE, base-type=uint8, compu {phys=raw}, range phys 0..255
          signal StatusCPDData1FBD_VL_CIRData35: start 312, 8 bit, little-endian, data-type-policy=OVERRIDE, base-type=uint8, compu {phys=raw}, range phys 0..255
          signal StatusCPDData1FBD_VL_CIRData36: start 320, 8 bit, little-endian, data-type-policy=OVERRIDE, base-type=uint8, compu {phys=raw}, range phys 0..255
          signal StatusCPDData1FBD_VL_CIRData37: start 328, 8 bit, little-endian, data-type-policy=OVERRIDE, base-type=uint8, compu {phys=raw}, range phys 0..255
          signal StatusCPDData1FBD_VL_CIRData38: start 336, 8 bit, little-endian, data-type-policy=OVERRIDE, base-type=uint8, compu {phys=raw}, range phys 0..255
          signal StatusCPDData1FBD_VL_CIRData39: start 344, 8 bit, little-endian, data-type-policy=OVERRIDE, base-type=uint8, compu {phys=raw}, range phys 0..255
          signal StatusCPDData1FBD_VL_CIRData40: start 352, 8 bit, little-endian, data-type-policy=OVERRIDE, base-type=uint8, compu {phys=raw}, range phys 0..255
          signal StatusCPDData1FBD_VL_CIRData41: start 360, 8 bit, little-endian, data-type-policy=OVERRIDE, base-type=uint8, compu {phys=raw}, range phys 0..255
          signal StatusCPDData1FBD_VL_CIRData42: start 368, 8 bit, little-endian, data-type-policy=OVERRIDE, base-type=uint8, compu {phys=raw}, range phys 0..255
          signal StatusCPDData1FBD_VL_CIRData43: start 376, 8 bit, little-endian, data-type-policy=OVERRIDE, base-type=uint8, compu {phys=raw}, range phys 0..255
          signal StatusCPDData1FBD_VL_CIRData44: start 384, 8 bit, little-endian, data-type-policy=OVERRIDE, base-type=uint8, compu {phys=raw}, range phys 0..255
          signal StatusCPDData1FBD_VL_CIRData45: start 392, 8 bit, little-endian, data-type-policy=OVERRIDE, base-type=uint8, compu {phys=raw}, range phys 0..255
          signal StatusCPDData1FBD_VL_CIRData46: start 400, 8 bit, little-endian, data-type-policy=OVERRIDE, base-type=uint8, compu {phys=raw}, range phys 0..255
          signal StatusCPDData1FBD_VL_CIRData47: start 408, 8 bit, little-endian, data-type-policy=OVERRIDE, base-type=uint8, compu {phys=raw}, range phys 0..255
          signal StatusCPDData1FBD_VL_CIRData48: start 416, 8 bit, little-endian, data-type-policy=OVERRIDE, base-type=uint8, compu {phys=raw}, range phys 0..255
          signal StatusCPDData1FBD_VL_CIRData49: start 424, 8 bit, little-endian, data-type-policy=OVERRIDE, base-type=uint8, compu {phys=raw}, range phys 0..255
          signal StatusCPDData1FBD_VL_CIRData50: start 432, 8 bit, little-endian, data-type-policy=OVERRIDE, base-type=uint8, compu {phys=raw}, range phys 0..255
          signal StatusCPDData1FBD_VL_CIRData51: start 440, 8 bit, little-endian, data-type-policy=OVERRIDE, base-type=uint8, compu {phys=raw}, range phys 0..255
          signal StatusCPDData1FBD_VL_CIRData52: start 448, 8 bit, little-endian, data-type-policy=OVERRIDE, base-type=uint8, compu {phys=raw}, range phys 0..255
          signal StatusCPDData1FBD_VL_CIRData53: start 456, 8 bit, little-endian, data-type-policy=OVERRIDE, base-type=uint8, compu {phys=raw}, range phys 0..255
          signal StatusCPDData1FBD_VL_CIRData54: start 464, 8 bit, little-endian, data-type-policy=OVERRIDE, base-type=uint8, compu {phys=raw}, range phys 0..255
          signal StatusCPDData1FBD_VL_CIRData55: start 472, 8 bit, little-endian, data-type-policy=OVERRIDE, base-type=uint8, compu {phys=raw}, range phys 0..255
          signal StatusCPDData1FBD_VL_CIRData56: start 480, 8 bit, little-endian, data-type-policy=OVERRIDE, base-type=uint8, compu {phys=raw}, range phys 0..255
          signal StatusCPDData1FBD_VL_CIRData57: start 488, 8 bit, little-endian, data-type-policy=OVERRIDE, base-type=uint8, compu {phys=raw}, range phys 0..255
          signal StatusCPDData1FBD_VL_CIRData58: start 496, 8 bit, little-endian, data-type-policy=OVERRIDE, base-type=uint8, compu {phys=raw}, range phys 0..255
          signal StatusCPDData1FBD_VL_CIRData59: start 504, 8 bit, little-endian, data-type-policy=OVERRIDE, base-type=uint8, compu {phys=raw}, range phys 0..255
      frame StatusCPDData1FBD_VM: id 0x14A, frame-length=64, can-addressing-mode=STANDARD, can-frame-rx-behavior=CAN-FD, can-frame-tx-behavior=CAN-FD
        pdu StatusCPDData1FBD_VM: length=64, unused-bit-pattern=0
          signal StatusCPDData1FBD_VM_MsgCounter: start 0, 8 bit, little-endian, data-type-policy=OVERRIDE, base-type=uint8, compu {phys=raw}, range phys 0..252
          signal StatusCPDData1FBD_VM_LinkID: start 8, 8 bit, little-endian, data-type-policy=OVERRIDE, base-type=uint8, compu {phys=raw}, range phys 0..252
          signal StatusCPDData1FBD_VM_AGCValue: start 16, 8 bit, little-endian, data-type-policy=OVERRIDE, base-type=uint8, compu {phys=raw}, range phys 0..252
          signal StatusCPDData1FBD_VM_Channel: start 24, 8 bit, little-endian, data-type-policy=OVERRIDE, base-type=uint8, compu {phys=raw}, range phys 0..252
          signal StatusCPDData1FBD_VM_CIRData00: start 32, 8 bit, little-endian, data-type-policy=OVERRIDE, base-type=uint8, compu {phys=raw}, range phys 0..255
          signal StatusCPDData1FBD_VM_CIRData01: start 40, 8 bit, little-endian, data-type-policy=OVERRIDE, base-type=uint8, compu {phys=raw}, range phys 0..255
          signal StatusCPDData1FBD_VM_CIRData02: start 48, 8 bit, little-endian, data-type-policy=OVERRIDE, base-type=uint8, compu {phys=raw}, range phys 0..255
          signal StatusCPDData1FBD_VM_CIRData03: start 56, 8 bit, little-endian, data-type-policy=OVERRIDE, base-type=uint8, compu {phys=raw}, range phys 0..255
          signal StatusCPDData1FBD_VM_CIRData04: start 64, 8 bit, little-endian, data-type-policy=OVERRIDE, base-type=uint8, compu {phys=raw}, range phys 0..255
          signal StatusCPDData1FBD_VM_CIRData05: start 72, 8 bit, little-endian, data-type-policy=OVERRIDE, base-type=uint8, compu {phys=raw}, range phys 0..255
          signal StatusCPDData1FBD_VM_CIRData06: start 80, 8 bit, little-endian, data-type-policy=OVERRIDE, base-type=uint8, compu {phys=raw}, range phys 0..255
          signal StatusCPDData1FBD_VM_CIRData07: start 88, 8 bit, little-endian, data-type-policy=OVERRIDE, base-type=uint8, compu {phys=raw}, range phys 0..255
          signal StatusCPDData1FBD_VM_CIRData08: start 96, 8 bit, little-endian, data-type-policy=OVERRIDE, base-type=uint8, compu {phys=raw}, range phys 0..255
          signal StatusCPDData1FBD_VM_CIRData09: start 104, 8 bit, little-endian, data-type-policy=OVERRIDE, base-type=uint8, compu {phys=raw}, range phys 0..255
          signal StatusCPDData1FBD_VM_CIRData10: start 112, 8 bit, little-endian, data-type-policy=OVERRIDE, base-type=uint8, compu {phys=raw}, range phys 0..255
          signal StatusCPDData1FBD_VM_CIRData11: start 120, 8 bit, little-endian, data-type-policy=OVERRIDE, base-type=uint8, compu {phys=raw}, range phys 0..255
          signal StatusCPDData1FBD_VM_CIRData12: start 128, 8 bit, little-endian, data-type-policy=OVERRIDE, base-type=uint8, compu {phys=raw}, range phys 0..255
          signal StatusCPDData1FBD_VM_CIRData13: start 136, 8 bit, little-endian, data-type-policy=OVERRIDE, base-type=uint8, compu {phys=raw}, range phys 0..255
          signal StatusCPDData1FBD_VM_CIRData14: start 144, 8 bit, little-endian, data-type-policy=OVERRIDE, base-type=uint8, compu {phys=raw}, range phys 0..255
          signal StatusCPDData1FBD_VM_CIRData15: start 152, 8 bit, little-endian, data-type-policy=OVERRIDE, base-type=uint8, compu {phys=raw}, range phys 0..255
          signal StatusCPDData1FBD_VM_CIRData16: start 160, 8 bit, little-endian, data-type-policy=OVERRIDE, base-type=uint8, compu {phys=raw}, range phys 0..255
          signal StatusCPDData1FBD_VM_CIRData17: start 168, 8 bit, little-endian, data-type-policy=OVERRIDE, base-type=uint8, compu {phys=raw}, range phys 0..255
          signal StatusCPDData1FBD_VM_CIRData18: start 176, 8 bit, little-endian, data-type-policy=OVERRIDE, base-type=uint8, compu {phys=raw}, range phys 0..255
          signal StatusCPDData1FBD_VM_CIRData19: start 184, 8 bit, little-endian, data-type-policy=OVERRIDE, base-type=uint8, compu {phys=raw}, range phys 0..255
          signal StatusCPDData1FBD_VM_CIRData20: start 192, 8 bit, little-endian, data-type-policy=OVERRIDE, base-type=uint8, compu {phys=raw}, range phys 0..255
          signal StatusCPDData1FBD_VM_CIRData21: start 200, 8 bit, little-endian, data-type-policy=OVERRIDE, base-type=uint8, compu {phys=raw}, range phys 0..255
          signal StatusCPDData1FBD_VM_CIRData22: start 208, 8 bit, little-endian, data-type-policy=OVERRIDE, base-type=uint8, compu {phys=raw}, range phys 0..255
          signal StatusCPDData1FBD_VM_CIRData23: start 216, 8 bit, little-endian, data-type-policy=OVERRIDE, base-type=uint8, compu {phys=raw}, range phys 0..255
          signal StatusCPDData1FBD_VM_CIRData24: start 224, 8 bit, little-endian, data-type-policy=OVERRIDE, base-type=uint8, compu {phys=raw}, range phys 0..255
          signal StatusCPDData1FBD_VM_CIRData25: start 232, 8 bit, little-endian, data-type-policy=OVERRIDE, base-type=uint8, compu {phys=raw}, range phys 0..255
          signal StatusCPDData1FBD_VM_CIRData26: start 240, 8 bit, little-endian, data-type-policy=OVERRIDE, base-type=uint8, compu {phys=raw}, range phys 0..255
          signal StatusCPDData1FBD_VM_CIRData27: start 248, 8 bit, little-endian, data-type-policy=OVERRIDE, base-type=uint8, compu {phys=raw}, range phys 0..255
          signal StatusCPDData1FBD_VM_CIRData28: start 256, 8 bit, little-endian, data-type-policy=OVERRIDE, base-type=uint8, compu {phys=raw}, range phys 0..255
          signal StatusCPDData1FBD_VM_CIRData29: start 264, 8 bit, little-endian, data-type-policy=OVERRIDE, base-type=uint8, compu {phys=raw}, range phys 0..255
          signal StatusCPDData1FBD_VM_CIRData30: start 272, 8 bit, little-endian, data-type-policy=OVERRIDE, base-type=uint8, compu {phys=raw}, range phys 0..255
          signal StatusCPDData1FBD_VM_CIRData31: start 280, 8 bit, little-endian, data-type-policy=OVERRIDE, base-type=uint8, compu {phys=raw}, range phys 0..255
          signal StatusCPDData1FBD_VM_CIRData32: start 288, 8 bit, little-endian, data-type-policy=OVERRIDE, base-type=uint8, compu {phys=raw}, range phys 0..255
          signal StatusCPDData1FBD_VM_CIRData33: start 296, 8 bit, little-endian, data-type-policy=OVERRIDE, base-type=uint8, compu {phys=raw}, range phys 0..255
          signal StatusCPDData1FBD_VM_CIRData34: start 304, 8 bit, little-endian, data-type-policy=OVERRIDE, base-type=uint8, compu {phys=raw}, range phys 0..255
          signal StatusCPDData1FBD_VM_CIRData35: start 312, 8 bit, little-endian, data-type-policy=OVERRIDE, base-type=uint8, compu {phys=raw}, range phys 0..255
          signal StatusCPDData1FBD_VM_CIRData36: start 320, 8 bit, little-endian, data-type-policy=OVERRIDE, base-type=uint8, compu {phys=raw}, range phys 0..255
          signal StatusCPDData1FBD_VM_CIRData37: start 328, 8 bit, little-endian, data-type-policy=OVERRIDE, base-type=uint8, compu {phys=raw}, range phys 0..255
          signal StatusCPDData1FBD_VM_CIRData38: start 336, 8 bit, little-endian, data-type-policy=OVERRIDE, base-type=uint8, compu {phys=raw}, range phys 0..255
          signal StatusCPDData1FBD_VM_CIRData39: start 344, 8 bit, little-endian, data-type-policy=OVERRIDE, base-type=uint8, compu {phys=raw}, range phys 0..255
          signal StatusCPDData1FBD_VM_CIRData40: start 352, 8 bit, little-endian, data-type-policy=OVERRIDE, base-type=uint8, compu {phys=raw}, range phys 0..255
          signal StatusCPDData1FBD_VM_CIRData41: start 360, 8 bit, little-endian, data-type-policy=OVERRIDE, base-type=uint8, compu {phys=raw}, range phys 0..255
          signal StatusCPDData1FBD_VM_CIRData42: start 368, 8 bit, little-endian, data-type-policy=OVERRIDE, base-type=uint8, compu {phys=raw}, range phys 0..255
          signal StatusCPDData1FBD_VM_CIRData43: start 376, 8 bit, little-endian, data-type-policy=OVERRIDE, base-type=uint8, compu {phys=raw}, range phys 0..255
          signal StatusCPDData1FBD_VM_CIRData44: start 384, 8 bit, little-endian, data-type-policy=OVERRIDE, base-type=uint8, compu {phys=raw}, range phys 0..255
          signal StatusCPDData1FBD_VM_CIRData45: start 392, 8 bit, little-endian, data-type-policy=OVERRIDE, base-type=uint8, compu {phys=raw}, range phys 0..255
          signal StatusCPDData1FBD_VM_CIRData46: start 400, 8 bit, little-endian, data-type-policy=OVERRIDE, base-type=uint8, compu {phys=raw}, range phys 0..255
          signal StatusCPDData1FBD_VM_CIRData47: start 408, 8 bit, little-endian, data-type-policy=OVERRIDE, base-type=uint8, compu {phys=raw}, range phys 0..255
          signal StatusCPDData1FBD_VM_CIRData48: start 416, 8 bit, little-endian, data-type-policy=OVERRIDE, base-type=uint8, compu {phys=raw}, range phys 0..255
          signal StatusCPDData1FBD_VM_CIRData49: start 424, 8 bit, little-endian, data-type-policy=OVERRIDE, base-type=uint8, compu {phys=raw}, range phys 0..255
          signal StatusCPDData1FBD_VM_CIRData50: start 432, 8 bit, little-endian, data-type-policy=OVERRIDE, base-type=uint8, compu {phys=raw}, range phys 0..255
          signal StatusCPDData1FBD_VM_CIRData51: start 440, 8 bit, little-endian, data-type-policy=OVERRIDE, base-type=uint8, compu {phys=raw}, range phys 0..255
          signal StatusCPDData1FBD_VM_CIRData52: start 448, 8 bit, little-endian, data-type-policy=OVERRIDE, base-type=uint8, compu {phys=raw}, range phys 0..255
          signal StatusCPDData1FBD_VM_CIRData53: start 456, 8 bit, little-endian, data-type-policy=OVERRIDE, base-type=uint8, compu {phys=raw}, range phys 0..255
          signal StatusCPDData1FBD_VM_CIRData54: start 464, 8 bit, little-endian, data-type-policy=OVERRIDE, base-type=uint8, compu {phys=raw}, range phys 0..255
          signal StatusCPDData1FBD_VM_CIRData55: start 472, 8 bit, little-endian, data-type-policy=OVERRIDE, base-type=uint8, compu {phys=raw}, range phys 0..255
          signal StatusCPDData1FBD_VM_CIRData56: start 480, 8 bit, little-endian, data-type-policy=OVERRIDE, base-type=uint8, compu {phys=raw}, range phys 0..255
          signal StatusCPDData1FBD_VM_CIRData57: start 488, 8 bit, little-endian, data-type-policy=OVERRIDE, base-type=uint8, compu {phys=raw}, range phys 0..255
          signal StatusCPDData1FBD_VM_CIRData58: start 496, 8 bit, little-endian, data-type-policy=OVERRIDE, base-type=uint8, compu {phys=raw}, range phys 0..255
          signal StatusCPDData1FBD_VM_CIRData59: start 504, 8 bit, little-endian, data-type-policy=OVERRIDE, base-type=uint8, compu {phys=raw}, range phys 0..255
      frame StatusCPDData1FBD_VR: id 0x14F, frame-length=64, can-addressing-mode=STANDARD, can-frame-rx-behavior=CAN-FD, can-frame-tx-behavior=CAN-FD
        pdu StatusCPDData1FBD_VR: length=64, unused-bit-pattern=0
          signal StatusCPDData1FBD_VR_MsgCounter: start 0, 8 bit, little-endian, data-type-policy=OVERRIDE, base-type=uint8, compu {phys=raw}, range phys 0..252
          signal StatusCPDData1FBD_VR_LinkID: start 8, 8 bit, little-endian, data-type-policy=OVERRIDE, base-type=uint8, compu {phys=raw}, range phys 0..252
          signal StatusCPDData1FBD_VR_AGCValue: start 16, 8 bit, little-endian, data-type-policy=OVERRIDE, base-type=uint8, compu {phys=raw}, range phys 0..252
          signal StatusCPDData1FBD_VR_Channel: start 24, 8 bit, little-endian, data-type-policy=OVERRIDE, base-type=uint8, compu {phys=raw}, range phys 0..252
          signal StatusCPDData1FBD_VR_CIRData00: start 32, 8 bit, little-endian, data-type-policy=OVERRIDE, base-type=uint8, compu {phys=raw}, range phys 0..255
          signal StatusCPDData1FBD_VR_CIRData01: start 40, 8 bit, little-endian, data-type-policy=OVERRIDE, base-type=uint8, compu {phys=raw}, range phys 0..255
          signal StatusCPDData1FBD_VR_CIRData02: start 48, 8 bit, little-endian, data-type-policy=OVERRIDE, base-type=uint8, compu {phys=raw}, range phys 0..255
          signal StatusCPDData1FBD_VR_CIRData03: start 56, 8 bit, little-endian, data-type-policy=OVERRIDE, base-type=uint8, compu {phys=raw}, range phys 0..255
          signal StatusCPDData1FBD_VR_CIRData04: start 64, 8 bit, little-endian, data-type-policy=OVERRIDE, base-type=uint8, compu {phys=raw}, range phys 0..255
          signal StatusCPDData1FBD_VR_CIRData05: start 72, 8 bit, little-endian, data-type-policy=OVERRIDE, base-type=uint8, compu {phys=raw}, range phys 0..255
          signal StatusCPDData1FBD_VR_CIRData06: start 80, 8 bit, little-endian, data-type-policy=OVERRIDE, base-type=uint8, compu {phys=raw}, range phys 0..255
          signal StatusCPDData1FBD_VR_CIRData07: start 88, 8 bit, little-endian, data-type-policy=OVERRIDE, base-type=uint8, compu {phys=raw}, range phys 0..255
          signal StatusCPDData1FBD_VR_CIRData08: start 96, 8 bit, little-endian, data-type-policy=OVERRIDE, base-type=uint8, compu {phys=raw}, range phys 0..255
          signal StatusCPDData1FBD_VR_CIRData09: start 104, 8 bit, little-endian, data-type-policy=OVERRIDE, base-type=uint8, compu {phys=raw}, range phys 0..255
          signal StatusCPDData1FBD_VR_CIRData10: start 112, 8 bit, little-endian, data-type-policy=OVERRIDE, base-type=uint8, compu {phys=raw}, range phys 0..255
          signal StatusCPDData1FBD_VR_CIRData11: start 120, 8 bit, little-endian, data-type-policy=OVERRIDE, base-type=uint8, compu {phys=raw}, range phys 0..255
          signal StatusCPDData1FBD_VR_CIRData12: start 128, 8 bit, little-endian, data-type-policy=OVERRIDE, base-type=uint8, compu {phys=raw}, range phys 0..255
          signal StatusCPDData1FBD_VR_CIRData13: start 136, 8 bit, little-endian, data-type-policy=OVERRIDE, base-type=uint8, compu {phys=raw}, range phys 0..255
          signal StatusCPDData1FBD_VR_CIRData14: start 144, 8 bit, little-endian, data-type-policy=OVERRIDE, base-type=uint8, compu {phys=raw}, range phys 0..255
          signal StatusCPDData1FBD_VR_CIRData15: start 152, 8 bit, little-endian, data-type-policy=OVERRIDE, base-type=uint8, compu {phys=raw}, range phys 0..255
          signal StatusCPDData1FBD_VR_CIRData16: start 160, 8 bit, little-endian, data-type-policy=OVERRIDE, base-type=uint8, compu {phys=raw}, range phys 0..255
          signal StatusCPDData1FBD_VR_CIRData17: start 168, 8 bit, little-endian, data-type-policy=OVERRIDE, base-type=uint8, compu {phys=raw}, range phys 0..255
          signal StatusCPDData1FBD_VR_CIRData18: start 176, 8 bit, little-endian, data-type-policy=OVERRIDE, base-type=uint8, compu {phys=raw}, range phys 0..255
          signal StatusCPDData1FBD_VR_CIRData19: start 184, 8 bit, little-endian, data-type-policy=OVERRIDE, base-type=uint8, compu {phys=raw}, range phys 0..255
          signal StatusCPDData1FBD_VR_CIRData20: start 192, 8 bit, little-endian, data-type-policy=OVERRIDE, base-type=uint8, compu {phys=raw}, range phys 0..255
          signal StatusCPDData1FBD_VR_CIRData21: start 200, 8 bit, little-endian, data-type-policy=OVERRIDE, base-type=uint8, compu {phys=raw}, range phys 0..255
          signal StatusCPDData1FBD_VR_CIRData22: start 208, 8 bit, little-endian, data-type-policy=OVERRIDE, base-type=uint8, compu {phys=raw}, range phys 0..255
          signal StatusCPDData1FBD_VR_CIRData23: start 216, 8 bit, little-endian, data-type-policy=OVERRIDE, base-type=uint8, compu {phys=raw}, range phys 0..255
          signal StatusCPDData1FBD_VR_CIRData24: start 224, 8 bit, little-endian, data-type-policy=OVERRIDE, base-type=uint8, compu {phys=raw}, range phys 0..255
          signal StatusCPDData1FBD_VR_CIRData25: start 232, 8 bit, little-endian, data-type-policy=OVERRIDE, base-type=uint8, compu {phys=raw}, range phys 0..255
          signal StatusCPDData1FBD_VR_CIRData26: start 240, 8 bit, little-endian, data-type-policy=OVERRIDE, base-type=uint8, compu {phys=raw}, range phys 0..255
          signal StatusCPDData1FBD_VR_CIRData27: start 248, 8 bit, little-endian, data-type-policy=OVERRIDE, base-type=uint8, compu {phys=raw}, range phys 0..255
          signal StatusCPDData1FBD_VR_CIRData28: start 256, 8 bit, little-endian, data-type-policy=OVERRIDE, base-type=uint8, compu {phys=raw}, range phys 0..255
          signal StatusCPDData1FBD_VR_CIRData29: start 264, 8 bit, little-endian, data-type-policy=OVERRIDE, base-type=uint8, compu {phys=raw}, range phys 0..255
          signal StatusCPDData1FBD_VR_CIRData30: start 272, 8 bit, little-endian, data-type-policy=OVERRIDE, base-type=uint8, compu {phys=raw}, range phys 0..255
          signal StatusCPDData1FBD_VR_CIRData31: start 280, 8 bit, little-endian, data-type-policy=OVERRIDE, base-type=uint8, compu {phys=raw}, range phys 0..255
          signal StatusCPDData1FBD_VR_CIRData32: start 288, 8 bit, little-endian, data-type-policy=OVERRIDE, base-type=uint8, compu {phys=raw}, range phys 0..255
          signal StatusCPDData1FBD_VR_CIRData33: start 296, 8 bit, little-endian, data-type-policy=OVERRIDE, base-type=uint8, compu {phys=raw}, range phys 0..255
          signal StatusCPDData1FBD_VR_CIRData34: start 304, 8 bit, little-endian, data-type-policy=OVERRIDE, base-type=uint8, compu {phys=raw}, range phys 0..255
          signal StatusCPDData1FBD_VR_CIRData35: start 312, 8 bit, little-endian, data-type-policy=OVERRIDE, base-type=uint8, compu {phys=raw}, range phys 0..255
          signal StatusCPDData1FBD_VR_CIRData36: start 320, 8 bit, little-endian, data-type-policy=OVERRIDE, base-type=uint8, compu {phys=raw}, range phys 0..255
          signal StatusCPDData1FBD_VR_CIRData37: start 328, 8 bit, little-endian, data-type-policy=OVERRIDE, base-type=uint8, compu {phys=raw}, range phys 0..255
          signal StatusCPDData1FBD_VR_CIRData38: start 336, 8 bit, little-endian, data-type-policy=OVERRIDE, base-type=uint8, compu {phys=raw}, range phys 0..255
          signal StatusCPDData1FBD_VR_CIRData39: start 344, 8 bit, little-endian, data-type-policy=OVERRIDE, base-type=uint8, compu {phys=raw}, range phys 0..255
          signal StatusCPDData1FBD_VR_CIRData40: start 352, 8 bit, little-endian, data-type-policy=OVERRIDE, base-type=uint8, compu {phys=raw}, range phys 0..255
          signal StatusCPDData1FBD_VR_CIRData41: start 360, 8 bit, little-endian, data-type-policy=OVERRIDE, base-type=uint8, compu {phys=raw}, range phys 0..255
          signal StatusCPDData1FBD_VR_CIRData42: start 368, 8 bit, little-endian, data-type-policy=OVERRIDE, base-type=uint8, compu {phys=raw}, range phys 0..255
          signal StatusCPDData1FBD_VR_CIRData43: start 376, 8 bit, little-endian, data-type-policy=OVERRIDE, base-type=uint8, compu {phys=raw}, range phys 0..255
          signal StatusCPDData1FBD_VR_CIRData44: start 384, 8 bit, little-endian, data-type-policy=OVERRIDE, base-type=uint8, compu {phys=raw}, range phys 0..255
          signal StatusCPDData1FBD_VR_CIRData45: start 392, 8 bit, little-endian, data-type-policy=OVERRIDE, base-type=uint8, compu {phys=raw}, range phys 0..255
          signal StatusCPDData1FBD_VR_CIRData46: start 400, 8 bit, little-endian, data-type-policy=OVERRIDE, base-type=uint8, compu {phys=raw}, range phys 0..255
          signal StatusCPDData1FBD_VR_CIRData47: start 408, 8 bit, little-endian, data-type-policy=OVERRIDE, base-type=uint8, compu {phys=raw}, range phys 0..255
          signal StatusCPDData1FBD_VR_CIRData48: start 416, 8 bit, little-endian, data-type-policy=OVERRIDE, base-type=uint8, compu {phys=raw}, range phys 0..255
          signal StatusCPDData1FBD_VR_CIRData49: start 424, 8 bit, little-endian, data-type-policy=OVERRIDE, base-type=uint8, compu {phys=raw}, range phys 0..255
          signal StatusCPDData1FBD_VR_CIRData50: start 432, 8 bit, little-endian, data-type-policy=OVERRIDE, base-type=uint8, compu {phys=raw}, range phys 0..255
          signal StatusCPDData1FBD_VR_CIRData51: start 440, 8 bit, little-endian, data-type-policy=OVERRIDE, base-type=uint8, compu {phys=raw}, range phys 0..255
          signal StatusCPDData1FBD_VR_CIRData52: start 448, 8 bit, little-endian, data-type-policy=OVERRIDE, base-type=uint8, compu {phys=raw}, range phys 0..255
          signal StatusCPDData1FBD_VR_CIRData53: start 456, 8 bit, little-endian, data-type-policy=OVERRIDE, base-type=uint8, compu {phys=raw}, range phys 0..255
          signal StatusCPDData1FBD_VR_CIRData54: start 464, 8 bit, little-endian, data-type-policy=OVERRIDE, base-type=uint8, compu {phys=raw}, range phys 0..255
          signal StatusCPDData1FBD_VR_CIRData55: start 472, 8 bit, little-endian, data-type-policy=OVERRIDE, base-type=uint8, compu {phys=raw}, range phys 0..255
          signal StatusCPDData1FBD_VR_CIRData56: start 480, 8 bit, little-endian, data-type-policy=OVERRIDE, base-type=uint8, compu {phys=raw}, range phys 0..255
          signal StatusCPDData1FBD_VR_CIRData57: start 488, 8 bit, little-endian, data-type-policy=OVERRIDE, base-type=uint8, compu {phys=raw}, range phys 0..255
          signal StatusCPDData1FBD_VR_CIRData58: start 496, 8 bit, little-endian, data-type-policy=OVERRIDE, base-type=uint8, compu {phys=raw}, range phys 0..255
          signal StatusCPDData1FBD_VR_CIRData59: start 504, 8 bit, little-endian, data-type-policy=OVERRIDE, base-type=uint8, compu {phys=raw}, range phys 0..255
      frame StatusCPDData2FBD_HL: id 0x15A, frame-length=64, can-addressing-mode=STANDARD, can-frame-rx-behavior=CAN-FD, can-frame-tx-behavior=CAN-FD
        pdu StatusCPDData2FBD_HL: length=64, unused-bit-pattern=0
          signal StatusCPDData2FBD_HL_MsgCounter: start 0, 8 bit, little-endian, data-type-policy=OVERRIDE, base-type=uint8, compu {phys=raw}, range phys 0..252
          signal StatusCPDData2FBD_HL_LinkID: start 8, 8 bit, little-endian, data-type-policy=OVERRIDE, base-type=uint8, compu {phys=raw}, range phys 0..252
          signal StatusCPDData2FBD_HL_CollisionCounter: start 16, 8 bit, little-endian, data-type-policy=OVERRIDE, base-type=uint8, compu {phys=raw}, range phys 0..252
          signal StatusCPDData2FBD_HL_CIRSetting: start 24, 8 bit, little-endian, data-type-policy=OVERRIDE, compu {phys=raw}
          signal StatusCPDData2FBD_HL_CIRData60: start 32, 8 bit, little-endian, data-type-policy=OVERRIDE, base-type=uint8, compu {phys=raw}, range phys 0..255
          signal StatusCPDData2FBD_HL_CIRData61: start 40, 8 bit, little-endian, data-type-policy=OVERRIDE, base-type=uint8, compu {phys=raw}, range phys 0..255
          signal StatusCPDData2FBD_HL_CIRData62: start 48, 8 bit, little-endian, data-type-policy=OVERRIDE, base-type=uint8, compu {phys=raw}, range phys 0..255
          signal StatusCPDData2FBD_HL_CIRData63: start 56, 8 bit, little-endian, data-type-policy=OVERRIDE, base-type=uint8, compu {phys=raw}, range phys 0..255
          signal StatusCPDData2FBD_HL_CIRData64: start 64, 8 bit, little-endian, data-type-policy=OVERRIDE, base-type=uint8, compu {phys=raw}, range phys 0..255
          signal StatusCPDData2FBD_HL_CIRData65: start 72, 8 bit, little-endian, data-type-policy=OVERRIDE, base-type=uint8, compu {phys=raw}, range phys 0..255
          signal StatusCPDData2FBD_HL_CIRData66: start 80, 8 bit, little-endian, data-type-policy=OVERRIDE, base-type=uint8, compu {phys=raw}, range phys 0..255
          signal StatusCPDData2FBD_HL_CIRData67: start 88, 8 bit, little-endian, data-type-policy=OVERRIDE, base-type=uint8, compu {phys=raw}, range phys 0..255
          signal StatusCPDData2FBD_HL_CIRData68: start 96, 8 bit, little-endian, data-type-policy=OVERRIDE, base-type=uint8, compu {phys=raw}, range phys 0..255
          signal StatusCPDData2FBD_HL_CIRData69: start 104, 8 bit, little-endian, data-type-policy=OVERRIDE, base-type=uint8, compu {phys=raw}, range phys 0..255
          signal StatusCPDData2FBD_HL_CIRData70: start 112, 8 bit, little-endian, data-type-policy=OVERRIDE, base-type=uint8, compu {phys=raw}, range phys 0..255
          signal StatusCPDData2FBD_HL_CIRData71: start 120, 8 bit, little-endian, data-type-policy=OVERRIDE, base-type=uint8, compu {phys=raw}, range phys 0..255
          signal StatusCPDData2FBD_HL_CIRData72: start 128, 8 bit, little-endian, data-type-policy=OVERRIDE, base-type=uint8, compu {phys=raw}, range phys 0..255
          signal StatusCPDData2FBD_HL_CIRData73: start 136, 8 bit, little-endian, data-type-policy=OVERRIDE, base-type=uint8, compu {phys=raw}, range phys 0..255
          signal StatusCPDData2FBD_HL_CIRData74: start 144, 8 bit, little-endian, data-type-policy=OVERRIDE, base-type=uint8, compu {phys=raw}, range phys 0..255
          signal StatusCPDData2FBD_HL_CIRData75: start 152, 8 bit, little-endian, data-type-policy=OVERRIDE, base-type=uint8, compu {phys=raw}, range phys 0..255
          signal StatusCPDData2FBD_HL_CIRData76: start 160, 8 bit, little-endian, data-type-policy=OVERRIDE, base-type=uint8, compu {phys=raw}, range phys 0..255
          signal StatusCPDData2FBD_HL_CIRData77: start 168, 8 bit, little-endian, data-type-policy=OVERRIDE, base-type=uint8, compu {phys=raw}, range phys 0..255
          signal StatusCPDData2FBD_HL_CIRData78: start 176, 8 bit, little-endian, data-type-policy=OVERRIDE, base-type=uint8, compu {phys=raw}, range phys 0..255
          signal StatusCPDData2FBD_HL_CIRData79: start 184, 8 bit, little-endian, data-type-policy=OVERRIDE, base-type=uint8, compu {phys=raw}, range phys 0..255
          signal StatusCPDData2FBD_HL_CIRData80: start 192, 8 bit, little-endian, data-type-policy=OVERRIDE, base-type=uint8, compu {phys=raw}, range phys 0..255
          signal StatusCPDData2FBD_HL_CIRData81: start 200, 8 bit, little-endian, data-type-policy=OVERRIDE, base-type=uint8, compu {phys=raw}, range phys 0..255
          signal StatusCPDData2FBD_HL_CIRData82: start 208, 8 bit, little-endian, data-type-policy=OVERRIDE, base-type=uint8, compu {phys=raw}, range phys 0..255
          signal StatusCPDData2FBD_HL_CIRData83: start 216, 8 bit, little-endian, data-type-policy=OVERRIDE, base-type=uint8, compu {phys=raw}, range phys 0..255
          signal StatusCPDData2FBD_HL_CIRData84: start 224, 8 bit, little-endian, data-type-policy=OVERRIDE, base-type=uint8, compu {phys=raw}, range phys 0..255
          signal StatusCPDData2FBD_HL_CIRData85: start 232, 8 bit, little-endian, data-type-policy=OVERRIDE, base-type=uint8, compu {phys=raw}, range phys 0..255
          signal StatusCPDData2FBD_HL_CIRData86: start 240, 8 bit, little-endian, data-type-policy=OVERRIDE, base-type=uint8, compu {phys=raw}, range phys 0..255
          signal StatusCPDData2FBD_HL_CIRData87: start 248, 8 bit, little-endian, data-type-policy=OVERRIDE, base-type=uint8, compu {phys=raw}, range phys 0..255
          signal StatusCPDData2FBD_HL_CIRData88: start 256, 8 bit, little-endian, data-type-policy=OVERRIDE, base-type=uint8, compu {phys=raw}, range phys 0..255
          signal StatusCPDData2FBD_HL_CIRData89: start 264, 8 bit, little-endian, data-type-policy=OVERRIDE, base-type=uint8, compu {phys=raw}, range phys 0..255
          signal StatusCPDData2FBD_HL_CIRData90: start 272, 8 bit, little-endian, data-type-policy=OVERRIDE, base-type=uint8, compu {phys=raw}, range phys 0..255
          signal StatusCPDData2FBD_HL_CIRData91: start 280, 8 bit, little-endian, data-type-policy=OVERRIDE, base-type=uint8, compu {phys=raw}, range phys 0..255
          signal StatusCPDData2FBD_HL_CIRData92: start 288, 8 bit, little-endian, data-type-policy=OVERRIDE, base-type=uint8, compu {phys=raw}, range phys 0..255
          signal StatusCPDData2FBD_HL_CIRData93: start 296, 8 bit, little-endian, data-type-policy=OVERRIDE, base-type=uint8, compu {phys=raw}, range phys 0..255
          signal StatusCPDData2FBD_HL_CIRData94: start 304, 8 bit, little-endian, data-type-policy=OVERRIDE, base-type=uint8, compu {phys=raw}, range phys 0..255
          signal StatusCPDData2FBD_HL_CIRData95: start 312, 8 bit, little-endian, data-type-policy=OVERRIDE, base-type=uint8, compu {phys=raw}, range phys 0..255
          signal StatusCPDData2FBD_HL_CIRData96: start 320, 8 bit, little-endian, data-type-policy=OVERRIDE, base-type=uint8, compu {phys=raw}, range phys 0..255
          signal StatusCPDData2FBD_HL_CIRData97: start 328, 8 bit, little-endian, data-type-policy=OVERRIDE, base-type=uint8, compu {phys=raw}, range phys 0..255
          signal StatusCPDData2FBD_HL_CIRData98: start 336, 8 bit, little-endian, data-type-policy=OVERRIDE, base-type=uint8, compu {phys=raw}, range phys 0..255
          signal StatusCPDData2FBD_HL_CIRData99: start 344, 8 bit, little-endian, data-type-policy=OVERRIDE, base-type=uint8, compu {phys=raw}, range phys 0..255
          signal StatusCPDData2FBD_HL_CIRData100: start 352, 8 bit, little-endian, data-type-policy=OVERRIDE, base-type=uint8, compu {phys=raw}, range phys 0..255
          signal StatusCPDData2FBD_HL_CIRData101: start 360, 8 bit, little-endian, data-type-policy=OVERRIDE, base-type=uint8, compu {phys=raw}, range phys 0..255
          signal StatusCPDData2FBD_HL_CIRData102: start 368, 8 bit, little-endian, data-type-policy=OVERRIDE, base-type=uint8, compu {phys=raw}, range phys 0..255
          signal StatusCPDData2FBD_HL_CIRData103: start 376, 8 bit, little-endian, data-type-policy=OVERRIDE, base-type=uint8, compu {phys=raw}, range phys 0..255
          signal StatusCPDData2FBD_HL_CIRData104: start 384, 8 bit, little-endian, data-type-policy=OVERRIDE, base-type=uint8, compu {phys=raw}, range phys 0..255
          signal StatusCPDData2FBD_HL_CIRData105: start 392, 8 bit, little-endian, data-type-policy=OVERRIDE, base-type=uint8, compu {phys=raw}, range phys 0..255
          signal StatusCPDData2FBD_HL_CIRData106: start 400, 8 bit, little-endian, data-type-policy=OVERRIDE, base-type=uint8, compu {phys=raw}, range phys 0..255
          signal StatusCPDData2FBD_HL_CIRData107: start 408, 8 bit, little-endian, data-type-policy=OVERRIDE, base-type=uint8, compu {phys=raw}, range phys 0..255
          signal StatusCPDData2FBD_HL_CIRData108: start 416, 8 bit, little-endian, data-type-policy=OVERRIDE, base-type=uint8, compu {phys=raw}, range phys 0..255
          signal StatusCPDData2FBD_HL_CIRData109: start 424, 8 bit, little-endian, data-type-policy=OVERRIDE, base-type=uint8, compu {phys=raw}, range phys 0..255
          signal StatusCPDData2FBD_HL_CIRData110: start 432, 8 bit, little-endian, data-type-policy=OVERRIDE, base-type=uint8, compu {phys=raw}, range phys 0..255
          signal StatusCPDData2FBD_HL_CIRData111: start 440, 8 bit, little-endian, data-type-policy=OVERRIDE, base-type=uint8, compu {phys=raw}, range phys 0..255
          signal StatusCPDData2FBD_HL_CIRData112: start 448, 8 bit, little-endian, data-type-policy=OVERRIDE, base-type=uint8, compu {phys=raw}, range phys 0..255
          signal StatusCPDData2FBD_HL_CIRData113: start 456, 8 bit, little-endian, data-type-policy=OVERRIDE, base-type=uint8, compu {phys=raw}, range phys 0..255
          signal StatusCPDData2FBD_HL_CIRData114: start 464, 8 bit, little-endian, data-type-policy=OVERRIDE, base-type=uint8, compu {phys=raw}, range phys 0..255
          signal StatusCPDData2FBD_HL_CIRData115: start 472, 8 bit, little-endian, data-type-policy=OVERRIDE, base-type=uint8, compu {phys=raw}, range phys 0..255
          signal StatusCPDData2FBD_HL_CIRData116: start 480, 8 bit, little-endian, data-type-policy=OVERRIDE, base-type=uint8, compu {phys=raw}, range phys 0..255
          signal StatusCPDData2FBD_HL_CIRData117: start 488, 8 bit, little-endian, data-type-policy=OVERRIDE, base-type=uint8, compu {phys=raw}, range phys 0..255
          signal StatusCPDData2FBD_HL_CIRData118: start 496, 8 bit, little-endian, data-type-policy=OVERRIDE, base-type=uint8, compu {phys=raw}, range phys 0..255
          signal StatusCPDData2FBD_HL_CIRData119: start 504, 8 bit, little-endian, data-type-policy=OVERRIDE, base-type=uint8, compu {phys=raw}, range phys 0..255
      frame StatusCPDData2FBD_HM: id 0x155, frame-length=64, can-addressing-mode=STANDARD, can-frame-rx-behavior=CAN-FD, can-frame-tx-behavior=CAN-FD
        pdu StatusCPDData2FBD_HM: length=64, unused-bit-pattern=0
          signal StatusCPDData2FBD_HM_MsgCounter: start 0, 8 bit, little-endian, data-type-policy=OVERRIDE, base-type=uint8, compu {phys=raw}, range phys 0..252
          signal StatusCPDData2FBD_HM_LinkID: start 8, 8 bit, little-endian, data-type-policy=OVERRIDE, base-type=uint8, compu {phys=raw}, range phys 0..252
          signal StatusCPDData2FBD_HM_CollisionCounter: start 16, 8 bit, little-endian, data-type-policy=OVERRIDE, base-type=uint8, compu {phys=raw}, range phys 0..252
          signal StatusCPDData2FBD_HM_CIRSetting: start 24, 8 bit, little-endian, data-type-policy=OVERRIDE, compu {phys=raw}
          signal StatusCPDData2FBD_HM_CIRData60: start 32, 8 bit, little-endian, data-type-policy=OVERRIDE, base-type=uint8, compu {phys=raw}, range phys 0..255
          signal StatusCPDData2FBD_HM_CIRData61: start 40, 8 bit, little-endian, data-type-policy=OVERRIDE, base-type=uint8, compu {phys=raw}, range phys 0..255
          signal StatusCPDData2FBD_HM_CIRData62: start 48, 8 bit, little-endian, data-type-policy=OVERRIDE, base-type=uint8, compu {phys=raw}, range phys 0..255
          signal StatusCPDData2FBD_HM_CIRData63: start 56, 8 bit, little-endian, data-type-policy=OVERRIDE, base-type=uint8, compu {phys=raw}, range phys 0..255
          signal StatusCPDData2FBD_HM_CIRData64: start 64, 8 bit, little-endian, data-type-policy=OVERRIDE, base-type=uint8, compu {phys=raw}, range phys 0..255
          signal StatusCPDData2FBD_HM_CIRData65: start 72, 8 bit, little-endian, data-type-policy=OVERRIDE, base-type=uint8, compu {phys=raw}, range phys 0..255
          signal StatusCPDData2FBD_HM_CIRData66: start 80, 8 bit, little-endian, data-type-policy=OVERRIDE, base-type=uint8, compu {phys=raw}, range phys 0..255
          signal StatusCPDData2FBD_HM_CIRData67: start 88, 8 bit, little-endian, data-type-policy=OVERRIDE, base-type=uint8, compu {phys=raw}, range phys 0..255
          signal StatusCPDData2FBD_HM_CIRData68: start 96, 8 bit, little-endian, data-type-policy=OVERRIDE, base-type=uint8, compu {phys=raw}, range phys 0..255
          signal StatusCPDData2FBD_HM_CIRData69: start 104, 8 bit, little-endian, data-type-policy=OVERRIDE, base-type=uint8, compu {phys=raw}, range phys 0..255
          signal StatusCPDData2FBD_HM_CIRData70: start 112, 8 bit, little-endian, data-type-policy=OVERRIDE, base-type=uint8, compu {phys=raw}, range phys 0..255
          signal StatusCPDData2FBD_HM_CIRData71: start 120, 8 bit, little-endian, data-type-policy=OVERRIDE, base-type=uint8, compu {phys=raw}, range phys 0..255
          signal StatusCPDData2FBD_HM_CIRData72: start 128, 8 bit, little-endian, data-type-policy=OVERRIDE, base-type=uint8, compu {phys=raw}, range phys 0..255
          signal StatusCPDData2FBD_HM_CIRData73: start 136, 8 bit, little-endian, data-type-policy=OVERRIDE, base-type=uint8, compu {phys=raw}, range phys 0..255
          signal StatusCPDData2FBD_HM_CIRData74: start 144, 8 bit, little-endian, data-type-policy=OVERRIDE, base-type=uint8, compu {phys=raw}, range phys 0..255
          signal StatusCPDData2FBD_HM_CIRData75: start 152, 8 bit, little-endian, data-type-policy=OVERRIDE, base-type=uint8, compu {phys=raw}, range phys 0..255
          signal StatusCPDData2FBD_HM_CIRData76: start 160, 8 bit, little-endian, data-type-policy=OVERRIDE, base-type=uint8, compu {phys=raw}, range phys 0..255
          signal StatusCPDData2FBD_HM_CIRData77: start 168, 8 bit, little-endian, data-type-policy=OVERRIDE, base-type=uint8, compu {phys=raw}, range phys 0..255
          signal StatusCPDData2FBD_HM_CIRData78: start 176, 8 bit, little-endian, data-type-policy=OVERRIDE, base-type=uint8, compu {phys=raw}, range phys 0..255
          signal StatusCPDData2FBD_HM_CIRData79: start 184, 8 bit, little-endian, data-type-policy=OVERRIDE, base-type=uint8, compu {phys=raw}, range phys 0..255
          signal StatusCPDData2FBD_HM_CIRData80: start 192, 8 bit, little-endian, data-type-policy=OVERRIDE, base-type=uint8, compu {phys=raw}, range phys 0..255
          signal StatusCPDData2FBD_HM_CIRData81: start 200, 8 bit, little-endian, data-type-policy=OVERRIDE, base-type=uint8, compu {phys=raw}, range phys 0..255
          signal StatusCPDData2FBD_HM_CIRData82: start 208, 8 bit, little-endian, data-type-policy=OVERRIDE, base-type=uint8, compu {phys=raw}, range phys 0..255
          signal StatusCPDData2FBD_HM_CIRData83: start 216, 8 bit, little-endian, data-type-policy=OVERRIDE, base-type=uint8, compu {phys=raw}, range phys 0..255
          signal StatusCPDData2FBD_HM_CIRData84: start 224, 8 bit, little-endian, data-type-policy=OVERRIDE, base-type=uint8, compu {phys=raw}, range phys 0..255
          signal StatusCPDData2FBD_HM_CIRData85: start 232, 8 bit, little-endian, data-type-policy=OVERRIDE, base-type=uint8, compu {phys=raw}, range phys 0..255
          signal StatusCPDData2FBD_HM_CIRData86: start 240, 8 bit, little-endian, data-type-policy=OVERRIDE, base-type=uint8, compu {phys=raw}, range phys 0..255
          signal StatusCPDData2FBD_HM_CIRData87: start 248, 8 bit, little-endian, data-type-policy=OVERRIDE, base-type=uint8, compu {phys=raw}, range phys 0..255
          signal StatusCPDData2FBD_HM_CIRData88: start 256, 8 bit, little-endian, data-type-policy=OVERRIDE, base-type=uint8, compu {phys=raw}, range phys 0..255
          signal StatusCPDData2FBD_HM_CIRData89: start 264, 8 bit, little-endian, data-type-policy=OVERRIDE, base-type=uint8, compu {phys=raw}, range phys 0..255
          signal StatusCPDData2FBD_HM_CIRData90: start 272, 8 bit, little-endian, data-type-policy=OVERRIDE, base-type=uint8, compu {phys=raw}, range phys 0..255
          signal StatusCPDData2FBD_HM_CIRData91: start 280, 8 bit, little-endian, data-type-policy=OVERRIDE, base-type=uint8, compu {phys=raw}, range phys 0..255
          signal StatusCPDData2FBD_HM_CIRData92: start 288, 8 bit, little-endian, data-type-policy=OVERRIDE, base-type=uint8, compu {phys=raw}, range phys 0..255
          signal StatusCPDData2FBD_HM_CIRData93: start 296, 8 bit, little-endian, data-type-policy=OVERRIDE, base-type=uint8, compu {phys=raw}, range phys 0..255
          signal StatusCPDData2FBD_HM_CIRData94: start 304, 8 bit, little-endian, data-type-policy=OVERRIDE, base-type=uint8, compu {phys=raw}, range phys 0..255
          signal StatusCPDData2FBD_HM_CIRData95: start 312, 8 bit, little-endian, data-type-policy=OVERRIDE, base-type=uint8, compu {phys=raw}, range phys 0..255
          signal StatusCPDData2FBD_HM_CIRData96: start 320, 8 bit, little-endian, data-type-policy=OVERRIDE, base-type=uint8, compu {phys=raw}, range phys 0..255
          signal StatusCPDData2FBD_HM_CIRData97: start 328, 8 bit, little-endian, data-type-policy=OVERRIDE, base-type=uint8, compu {phys=raw}, range phys 0..255
          signal StatusCPDData2FBD_HM_CIRData98: start 336, 8 bit, little-endian, data-type-policy=OVERRIDE, base-type=uint8, compu {phys=raw}, range phys 0..255
          signal StatusCPDData2FBD_HM_CIRData99: start 344, 8 bit, little-endian, data-type-policy=OVERRIDE, base-type=uint8, compu {phys=raw}, range phys 0..255
          signal StatusCPDData2FBD_HM_CIRData100: start 352, 8 bit, little-endian, data-type-policy=OVERRIDE, base-type=uint8, compu {phys=raw}, range phys 0..255
          signal StatusCPDData2FBD_HM_CIRData101: start 360, 8 bit, little-endian, data-type-policy=OVERRIDE, base-type=uint8, compu {phys=raw}, range phys 0..255
          signal StatusCPDData2FBD_HM_CIRData102: start 368, 8 bit, little-endian, data-type-policy=OVERRIDE, base-type=uint8, compu {phys=raw}, range phys 0..255
          signal StatusCPDData2FBD_HM_CIRData103: start 376, 8 bit, little-endian, data-type-policy=OVERRIDE, base-type=uint8, compu {phys=raw}, range phys 0..255
          signal StatusCPDData2FBD_HM_CIRData104: start 384, 8 bit, little-endian, data-type-policy=OVERRIDE, base-type=uint8, compu {phys=raw}, range phys 0..255
          signal StatusCPDData2FBD_HM_CIRData105: start 392, 8 bit, little-endian, data-type-policy=OVERRIDE, base-type=uint8, compu {phys=raw}, range phys 0..255
          signal StatusCPDData2FBD_HM_CIRData106: start 400, 8 bit, little-endian, data-type-policy=OVERRIDE, base-type=uint8, compu {phys=raw}, range phys 0..255
          signal StatusCPDData2FBD_HM_CIRData107: start 408, 8 bit, little-endian, data-type-policy=OVERRIDE, base-type=uint8, compu {phys=raw}, range phys 0..255
          signal StatusCPDData2FBD_HM_CIRData108: start 416, 8 bit, little-endian, data-type-policy=OVERRIDE, base-type=uint8, compu {phys=raw}, range phys 0..255
          signal StatusCPDData2FBD_HM_CIRData109: start 424, 8 bit, little-endian, data-type-policy=OVERRIDE, base-type=uint8, compu {phys=raw}, range phys 0..255
          signal StatusCPDData2FBD_HM_CIRData110: start 432, 8 bit, little-endian, data-type-policy=OVERRIDE, base-type=uint8, compu {phys=raw}, range phys 0..255
          signal StatusCPDData2FBD_HM_CIRData111: start 440, 8 bit, little-endian, data-type-policy=OVERRIDE, base-type=uint8, compu {phys=raw}, range phys 0..255
          signal StatusCPDData2FBD_HM_CIRData112: start 448, 8 bit, little-endian, data-type-policy=OVERRIDE, base-type=uint8, compu {phys=raw}, range phys 0..255
          signal StatusCPDData2FBD_HM_CIRData113: start 456, 8 bit, little-endian, data-type-policy=OVERRIDE, base-type=uint8, compu {phys=raw}, range phys 0..255
          signal StatusCPDData2FBD_HM_CIRData114: start 464, 8 bit, little-endian, data-type-policy=OVERRIDE, base-type=uint8, compu {phys=raw}, range phys 0..255
          signal StatusCPDData2FBD_HM_CIRData115: start 472, 8 bit, little-endian, data-type-policy=OVERRIDE, base-type=uint8, compu {phys=raw}, range phys 0..255
          signal StatusCPDData2FBD_HM_CIRData116: start 480, 8 bit, little-endian, data-type-policy=OVERRIDE, base-type=uint8, compu {phys=raw}, range phys 0..255
          signal StatusCPDData2FBD_HM_CIRData117: start 488, 8 bit, little-endian, data-type-policy=OVERRIDE, base-type=uint8, compu {phys=raw}, range phys 0..255
          signal StatusCPDData2FBD_HM_CIRData118: start 496, 8 bit, little-endian, data-type-policy=OVERRIDE, base-type=uint8, compu {phys=raw}, range phys 0..255
          signal StatusCPDData2FBD_HM_CIRData119: start 504, 8 bit, little-endian, data-type-policy=OVERRIDE, base-type=uint8, compu {phys=raw}, range phys 0..255
      frame StatusCPDData2FBD_HR: id 0x15B, frame-length=64, can-addressing-mode=STANDARD, can-frame-rx-behavior=CAN-FD, can-frame-tx-behavior=CAN-FD
        pdu StatusCPDData2FBD_HR: length=64, unused-bit-pattern=0
          signal StatusCPDData2FBD_HR_MsgCounter: start 0, 8 bit, little-endian, data-type-policy=OVERRIDE, base-type=uint8, compu {phys=raw}, range phys 0..252
          signal StatusCPDData2FBD_HR_LinkID: start 8, 8 bit, little-endian, data-type-policy=OVERRIDE, base-type=uint8, compu {phys=raw}, range phys 0..252
          signal StatusCPDData2FBD_HR_CollisionCounter: start 16, 8 bit, little-endian, data-type-policy=OVERRIDE, base-type=uint8, compu {phys=raw}, range phys 0..252
          signal StatusCPDData2FBD_HR_CIRSetting: start 24, 8 bit, little-endian, data-type-policy=OVERRIDE, compu {phys=raw}
          signal StatusCPDData2FBD_HR_CIRData60: start 32, 8 bit, little-endian, data-type-policy=OVERRIDE, base-type=uint8, compu {phys=raw}, range phys 0..255
          signal StatusCPDData2FBD_HR_CIRData61: start 40, 8 bit, little-endian, data-type-policy=OVERRIDE, base-type=uint8, compu {phys=raw}, range phys 0..255
          signal StatusCPDData2FBD_HR_CIRData62: start 48, 8 bit, little-endian, data-type-policy=OVERRIDE, base-type=uint8, compu {phys=raw}, range phys 0..255
          signal StatusCPDData2FBD_HR_CIRData63: start 56, 8 bit, little-endian, data-type-policy=OVERRIDE, base-type=uint8, compu {phys=raw}, range phys 0..255
          signal StatusCPDData2FBD_HR_CIRData64: start 64, 8 bit, little-endian, data-type-policy=OVERRIDE, base-type=uint8, compu {phys=raw}, range phys 0..255
          signal StatusCPDData2FBD_HR_CIRData65: start 72, 8 bit, little-endian, data-type-policy=OVERRIDE, base-type=uint8, compu {phys=raw}, range phys 0..255
          signal StatusCPDData2FBD_HR_CIRData66: start 80, 8 bit, little-endian, data-type-policy=OVERRIDE, base-type=uint8, compu {phys=raw}, range phys 0..255
          signal StatusCPDData2FBD_HR_CIRData67: start 88, 8 bit, little-endian, data-type-policy=OVERRIDE, base-type=uint8, compu {phys=raw}, range phys 0..255
          signal StatusCPDData2FBD_HR_CIRData68: start 96, 8 bit, little-endian, data-type-policy=OVERRIDE, base-type=uint8, compu {phys=raw}, range phys 0..255
          signal StatusCPDData2FBD_HR_CIRData69: start 104, 8 bit, little-endian, data-type-policy=OVERRIDE, base-type=uint8, compu {phys=raw}, range phys 0..255
          signal StatusCPDData2FBD_HR_CIRData70: start 112, 8 bit, little-endian, data-type-policy=OVERRIDE, base-type=uint8, compu {phys=raw}, range phys 0..255
          signal StatusCPDData2FBD_HR_CIRData71: start 120, 8 bit, little-endian, data-type-policy=OVERRIDE, base-type=uint8, compu {phys=raw}, range phys 0..255
          signal StatusCPDData2FBD_HR_CIRData72: start 128, 8 bit, little-endian, data-type-policy=OVERRIDE, base-type=uint8, compu {phys=raw}, range phys 0..255
          signal StatusCPDData2FBD_HR_CIRData73: start 136, 8 bit, little-endian, data-type-policy=OVERRIDE, base-type=uint8, compu {phys=raw}, range phys 0..255
          signal StatusCPDData2FBD_HR_CIRData74: start 144, 8 bit, little-endian, data-type-policy=OVERRIDE, base-type=uint8, compu {phys=raw}, range phys 0..255
          signal StatusCPDData2FBD_HR_CIRData75: start 152, 8 bit, little-endian, data-type-policy=OVERRIDE, base-type=uint8, compu {phys=raw}, range phys 0..255
          signal StatusCPDData2FBD_HR_CIRData76: start 160, 8 bit, little-endian, data-type-policy=OVERRIDE, base-type=uint8, compu {phys=raw}, range phys 0..255
          signal StatusCPDData2FBD_HR_CIRData77: start 168, 8 bit, little-endian, data-type-policy=OVERRIDE, base-type=uint8, compu {phys=raw}, range phys 0..255
          signal StatusCPDData2FBD_HR_CIRData78: start 176, 8 bit, little-endian, data-type-policy=OVERRIDE, base-type=uint8, compu {phys=raw}, range phys 0..255
          signal StatusCPDData2FBD_HR_CIRData79: start 184, 8 bit, little-endian, data-type-policy=OVERRIDE, base-type=uint8, compu {phys=raw}, range phys 0..255
          signal StatusCPDData2FBD_HR_CIRData80: start 192, 8 bit, little-endian, data-type-policy=OVERRIDE, base-type=uint8, compu {phys=raw}, range phys 0..255
          signal StatusCPDData2FBD_HR_CIRData81: start 200, 8 bit, little-endian, data-type-policy=OVERRIDE, base-type=uint8, compu {phys=raw}, range phys 0..255
          signal StatusCPDData2FBD_HR_CIRData82: start 208, 8 bit, little-endian, data-type-policy=OVERRIDE, base-type=uint8, compu {phys=raw}, range phys 0..255
          signal StatusCPDData2FBD_HR_CIRData83: start 216, 8 bit, little-endian, data-type-policy=OVERRIDE, base-type=uint8, compu {phys=raw}, range phys 0..255
          signal StatusCPDData2FBD_HR_CIRData84: start 224, 8 bit, little-endian, data-type-policy=OVERRIDE, base-type=uint8, compu {phys=raw}, range phys 0..255
          signal StatusCPDData2FBD_HR_CIRData85: start 232, 8 bit, little-endian, data-type-policy=OVERRIDE, base-type=uint8, compu {phys=raw}, range phys 0..255
          signal StatusCPDData2FBD_HR_CIRData86: start 240, 8 bit, little-endian, data-type-policy=OVERRIDE, base-type=uint8, compu {phys=raw}, range phys 0..255
          signal StatusCPDData2FBD_HR_CIRData87: start 248, 8 bit, little-endian, data-type-policy=OVERRIDE, base-type=uint8, compu {phys=raw}, range phys 0..255
          signal StatusCPDData2FBD_HR_CIRData88: start 256, 8 bit, little-endian, data-type-policy=OVERRIDE, base-type=uint8, compu {phys=raw}, range phys 0..255
          signal StatusCPDData2FBD_HR_CIRData89: start 264, 8 bit, little-endian, data-type-policy=OVERRIDE, base-type=uint8, compu {phys=raw}, range phys 0..255
          signal StatusCPDData2FBD_HR_CIRData90: start 272, 8 bit, little-endian, data-type-policy=OVERRIDE, base-type=uint8, compu {phys=raw}, range phys 0..255
          signal StatusCPDData2FBD_HR_CIRData91: start 280, 8 bit, little-endian, data-type-policy=OVERRIDE, base-type=uint8, compu {phys=raw}, range phys 0..255
          signal StatusCPDData2FBD_HR_CIRData92: start 288, 8 bit, little-endian, data-type-policy=OVERRIDE, base-type=uint8, compu {phys=raw}, range phys 0..255
          signal StatusCPDData2FBD_HR_CIRData93: start 296, 8 bit, little-endian, data-type-policy=OVERRIDE, base-type=uint8, compu {phys=raw}, range phys 0..255
          signal StatusCPDData2FBD_HR_CIRData94: start 304, 8 bit, little-endian, data-type-policy=OVERRIDE, base-type=uint8, compu {phys=raw}, range phys 0..255
          signal StatusCPDData2FBD_HR_CIRData95: start 312, 8 bit, little-endian, data-type-policy=OVERRIDE, base-type=uint8, compu {phys=raw}, range phys 0..255
          signal StatusCPDData2FBD_HR_CIRData96: start 320, 8 bit, little-endian, data-type-policy=OVERRIDE, base-type=uint8, compu {phys=raw}, range phys 0..255
          signal StatusCPDData2FBD_HR_CIRData97: start 328, 8 bit, little-endian, data-type-policy=OVERRIDE, base-type=uint8, compu {phys=raw}, range phys 0..255
          signal StatusCPDData2FBD_HR_CIRData98: start 336, 8 bit, little-endian, data-type-policy=OVERRIDE, base-type=uint8, compu {phys=raw}, range phys 0..255
          signal StatusCPDData2FBD_HR_CIRData99: start 344, 8 bit, little-endian, data-type-policy=OVERRIDE, base-type=uint8, compu {phys=raw}, range phys 0..255
          signal StatusCPDData2FBD_HR_CIRData100: start 352, 8 bit, little-endian, data-type-policy=OVERRIDE, base-type=uint8, compu {phys=raw}, range phys 0..255
          signal StatusCPDData2FBD_HR_CIRData101: start 360, 8 bit, little-endian, data-type-policy=OVERRIDE, base-type=uint8, compu {phys=raw}, range phys 0..255
          signal StatusCPDData2FBD_HR_CIRData102: start 368, 8 bit, little-endian, data-type-policy=OVERRIDE, base-type=uint8, compu {phys=raw}, range phys 0..255
          signal StatusCPDData2FBD_HR_CIRData103: start 376, 8 bit, little-endian, data-type-policy=OVERRIDE, base-type=uint8, compu {phys=raw}, range phys 0..255
          signal StatusCPDData2FBD_HR_CIRData104: start 384, 8 bit, little-endian, data-type-policy=OVERRIDE, base-type=uint8, compu {phys=raw}, range phys 0..255
          signal StatusCPDData2FBD_HR_CIRData105: start 392, 8 bit, little-endian, data-type-policy=OVERRIDE, base-type=uint8, compu {phys=raw}, range phys 0..255
          signal StatusCPDData2FBD_HR_CIRData106: start 400, 8 bit, little-endian, data-type-policy=OVERRIDE, base-type=uint8, compu {phys=raw}, range phys 0..255
          signal StatusCPDData2FBD_HR_CIRData107: start 408, 8 bit, little-endian, data-type-policy=OVERRIDE, base-type=uint8, compu {phys=raw}, range phys 0..255
          signal StatusCPDData2FBD_HR_CIRData108: start 416, 8 bit, little-endian, data-type-policy=OVERRIDE, base-type=uint8, compu {phys=raw}, range phys 0..255
          signal StatusCPDData2FBD_HR_CIRData109: start 424, 8 bit, little-endian, data-type-policy=OVERRIDE, base-type=uint8, compu {phys=raw}, range phys 0..255
          signal StatusCPDData2FBD_HR_CIRData110: start 432, 8 bit, little-endian, data-type-policy=OVERRIDE, base-type=uint8, compu {phys=raw}, range phys 0..255
          signal StatusCPDData2FBD_HR_CIRData111: start 440, 8 bit, little-endian, data-type-policy=OVERRIDE, base-type=uint8, compu {phys=raw}, range phys 0..255
          signal StatusCPDData2FBD_HR_CIRData112: start 448, 8 bit, little-endian, data-type-policy=OVERRIDE, base-type=uint8, compu {phys=raw}, range phys 0..255
          signal StatusCPDData2FBD_HR_CIRData113: start 456, 8 bit, little-endian, data-type-policy=OVERRIDE, base-type=uint8, compu {phys=raw}, range phys 0..255
          signal StatusCPDData2FBD_HR_CIRData114: start 464, 8 bit, little-endian, data-type-policy=OVERRIDE, base-type=uint8, compu {phys=raw}, range phys 0..255
          signal StatusCPDData2FBD_HR_CIRData115: start 472, 8 bit, little-endian, data-type-policy=OVERRIDE, base-type=uint8, compu {phys=raw}, range phys 0..255
          signal StatusCPDData2FBD_HR_CIRData116: start 480, 8 bit, little-endian, data-type-policy=OVERRIDE, base-type=uint8, compu {phys=raw}, range phys 0..255
          signal StatusCPDData2FBD_HR_CIRData117: start 488, 8 bit, little-endian, data-type-policy=OVERRIDE, base-type=uint8, compu {phys=raw}, range phys 0..255
          signal StatusCPDData2FBD_HR_CIRData118: start 496, 8 bit, little-endian, data-type-policy=OVERRIDE, base-type=uint8, compu {phys=raw}, range phys 0..255
          signal StatusCPDData2FBD_HR_CIRData119: start 504, 8 bit, little-endian, data-type-policy=OVERRIDE, base-type=uint8, compu {phys=raw}, range phys 0..255
      frame StatusCPDData2FBD_Miko: id 0x156, frame-length=64, can-addressing-mode=STANDARD, can-frame-rx-behavior=CAN-FD, can-frame-tx-behavior=CAN-FD
        pdu StatusCPDData2FBD_Miko: length=64, unused-bit-pattern=0
          signal StatusCPDData2FBD_Miko_MsgCounter: start 0, 8 bit, little-endian, data-type-policy=OVERRIDE, base-type=uint8, compu {phys=raw}, range phys 0..252
          signal StatusCPDData2FBD_Miko_LinkID: start 8, 8 bit, little-endian, data-type-policy=OVERRIDE, base-type=uint8, compu {phys=raw}, range phys 0..252
          signal StatusCPDData2FBD_Miko_CollisionCounter: start 16, 8 bit, little-endian, data-type-policy=OVERRIDE, base-type=uint8, compu {phys=raw}, range phys 0..252
          signal StatusCPDData2FBD_Miko_CIRSetting: start 24, 8 bit, little-endian, data-type-policy=OVERRIDE, compu {phys=raw}
          signal StatusCPDData2FBD_Miko_CIRData60: start 32, 8 bit, little-endian, data-type-policy=OVERRIDE, base-type=uint8, compu {phys=raw}, range phys 0..255
          signal StatusCPDData2FBD_Miko_CIRData61: start 40, 8 bit, little-endian, data-type-policy=OVERRIDE, base-type=uint8, compu {phys=raw}, range phys 0..255
          signal StatusCPDData2FBD_Miko_CIRData62: start 48, 8 bit, little-endian, data-type-policy=OVERRIDE, base-type=uint8, compu {phys=raw}, range phys 0..255
          signal StatusCPDData2FBD_Miko_CIRData63: start 56, 8 bit, little-endian, data-type-policy=OVERRIDE, base-type=uint8, compu {phys=raw}, range phys 0..255
          signal StatusCPDData2FBD_Miko_CIRData64: start 64, 8 bit, little-endian, data-type-policy=OVERRIDE, base-type=uint8, compu {phys=raw}, range phys 0..255
          signal StatusCPDData2FBD_Miko_CIRData65: start 72, 8 bit, little-endian, data-type-policy=OVERRIDE, base-type=uint8, compu {phys=raw}, range phys 0..255
          signal StatusCPDData2FBD_Miko_CIRData66: start 80, 8 bit, little-endian, data-type-policy=OVERRIDE, base-type=uint8, compu {phys=raw}, range phys 0..255
          signal StatusCPDData2FBD_Miko_CIRData67: start 88, 8 bit, little-endian, data-type-policy=OVERRIDE, base-type=uint8, compu {phys=raw}, range phys 0..255
          signal StatusCPDData2FBD_Miko_CIRData68: start 96, 8 bit, little-endian, data-type-policy=OVERRIDE, base-type=uint8, compu {phys=raw}, range phys 0..255
          signal StatusCPDData2FBD_Miko_CIRData69: start 104, 8 bit, little-endian, data-type-policy=OVERRIDE, base-type=uint8, compu {phys=raw}, range phys 0..255
          signal StatusCPDData2FBD_Miko_CIRData70: start 112, 8 bit, little-endian, data-type-policy=OVERRIDE, base-type=uint8, compu {phys=raw}, range phys 0..255
          signal StatusCPDData2FBD_Miko_CIRData71: start 120, 8 bit, little-endian, data-type-policy=OVERRIDE, base-type=uint8, compu {phys=raw}, range phys 0..255
          signal StatusCPDData2FBD_Miko_CIRData72: start 128, 8 bit, little-endian, data-type-policy=OVERRIDE, base-type=uint8, compu {phys=raw}, range phys 0..255
          signal StatusCPDData2FBD_Miko_CIRData73: start 136, 8 bit, little-endian, data-type-policy=OVERRIDE, base-type=uint8, compu {phys=raw}, range phys 0..255
          signal StatusCPDData2FBD_Miko_CIRData74: start 144, 8 bit, little-endian, data-type-policy=OVERRIDE, base-type=uint8, compu {phys=raw}, range phys 0..255
          signal StatusCPDData2FBD_Miko_CIRData75: start 152, 8 bit, little-endian, data-type-policy=OVERRIDE, base-type=uint8, compu {phys=raw}, range phys 0..255
          signal StatusCPDData2FBD_Miko_CIRData76: start 160, 8 bit, little-endian, data-type-policy=OVERRIDE, base-type=uint8, compu {phys=raw}, range phys 0..255
          signal StatusCPDData2FBD_Miko_CIRData77: start 168, 8 bit, little-endian, data-type-policy=OVERRIDE, base-type=uint8, compu {phys=raw}, range phys 0..255
          signal StatusCPDData2FBD_Miko_CIRData78: start 176, 8 bit, little-endian, data-type-policy=OVERRIDE, base-type=uint8, compu {phys=raw}, range phys 0..255
          signal StatusCPDData2FBD_Miko_CIRData79: start 184, 8 bit, little-endian, data-type-policy=OVERRIDE, base-type=uint8, compu {phys=raw}, range phys 0..255
          signal StatusCPDData2FBD_Miko_CIRData80: start 192, 8 bit, little-endian, data-type-policy=OVERRIDE, base-type=uint8, compu {phys=raw}, range phys 0..255
          signal StatusCPDData2FBD_Miko_CIRData81: start 200, 8 bit, little-endian, data-type-policy=OVERRIDE, base-type=uint8, compu {phys=raw}, range phys 0..255
          signal StatusCPDData2FBD_Miko_CIRData82: start 208, 8 bit, little-endian, data-type-policy=OVERRIDE, base-type=uint8, compu {phys=raw}, range phys 0..255
          signal StatusCPDData2FBD_Miko_CIRData83: start 216, 8 bit, little-endian, data-type-policy=OVERRIDE, base-type=uint8, compu {phys=raw}, range phys 0..255
          signal StatusCPDData2FBD_Miko_CIRData84: start 224, 8 bit, little-endian, data-type-policy=OVERRIDE, base-type=uint8, compu {phys=raw}, range phys 0..255
          signal StatusCPDData2FBD_Miko_CIRData85: start 232, 8 bit, little-endian, data-type-policy=OVERRIDE, base-type=uint8, compu {phys=raw}, range phys 0..255
          signal StatusCPDData2FBD_Miko_CIRData86: start 240, 8 bit, little-endian, data-type-policy=OVERRIDE, base-type=uint8, compu {phys=raw}, range phys 0..255
          signal StatusCPDData2FBD_Miko_CIRData87: start 248, 8 bit, little-endian, data-type-policy=OVERRIDE, base-type=uint8, compu {phys=raw}, range phys 0..255
          signal StatusCPDData2FBD_Miko_CIRData88: start 256, 8 bit, little-endian, data-type-policy=OVERRIDE, base-type=uint8, compu {phys=raw}, range phys 0..255
          signal StatusCPDData2FBD_Miko_CIRData89: start 264, 8 bit, little-endian, data-type-policy=OVERRIDE, base-type=uint8, compu {phys=raw}, range phys 0..255
          signal StatusCPDData2FBD_Miko_CIRData90: start 272, 8 bit, little-endian, data-type-policy=OVERRIDE, base-type=uint8, compu {phys=raw}, range phys 0..255
          signal StatusCPDData2FBD_Miko_CIRData91: start 280, 8 bit, little-endian, data-type-policy=OVERRIDE, base-type=uint8, compu {phys=raw}, range phys 0..255
          signal StatusCPDData2FBD_Miko_CIRData92: start 288, 8 bit, little-endian, data-type-policy=OVERRIDE, base-type=uint8, compu {phys=raw}, range phys 0..255
          signal StatusCPDData2FBD_Miko_CIRData93: start 296, 8 bit, little-endian, data-type-policy=OVERRIDE, base-type=uint8, compu {phys=raw}, range phys 0..255
          signal StatusCPDData2FBD_Miko_CIRData94: start 304, 8 bit, little-endian, data-type-policy=OVERRIDE, base-type=uint8, compu {phys=raw}, range phys 0..255
          signal StatusCPDData2FBD_Miko_CIRData95: start 312, 8 bit, little-endian, data-type-policy=OVERRIDE, base-type=uint8, compu {phys=raw}, range phys 0..255
          signal StatusCPDData2FBD_Miko_CIRData96: start 320, 8 bit, little-endian, data-type-policy=OVERRIDE, base-type=uint8, compu {phys=raw}, range phys 0..255
          signal StatusCPDData2FBD_Miko_CIRData97: start 328, 8 bit, little-endian, data-type-policy=OVERRIDE, base-type=uint8, compu {phys=raw}, range phys 0..255
          signal StatusCPDData2FBD_Miko_CIRData98: start 336, 8 bit, little-endian, data-type-policy=OVERRIDE, base-type=uint8, compu {phys=raw}, range phys 0..255
          signal StatusCPDData2FBD_Miko_CIRData99: start 344, 8 bit, little-endian, data-type-policy=OVERRIDE, base-type=uint8, compu {phys=raw}, range phys 0..255
          signal StatusCPDData2FBD_Miko_CIRData100: start 352, 8 bit, little-endian, data-type-policy=OVERRIDE, base-type=uint8, compu {phys=raw}, range phys 0..255
          signal StatusCPDData2FBD_Miko_CIRData101: start 360, 8 bit, little-endian, data-type-policy=OVERRIDE, base-type=uint8, compu {phys=raw}, range phys 0..255
          signal StatusCPDData2FBD_Miko_CIRData102: start 368, 8 bit, little-endian, data-type-policy=OVERRIDE, base-type=uint8, compu {phys=raw}, range phys 0..255
          signal StatusCPDData2FBD_Miko_CIRData103: start 376, 8 bit, little-endian, data-type-policy=OVERRIDE, base-type=uint8, compu {phys=raw}, range phys 0..255
          signal StatusCPDData2FBD_Miko_CIRData104: start 384, 8 bit, little-endian, data-type-policy=OVERRIDE, base-type=uint8, compu {phys=raw}, range phys 0..255
          signal StatusCPDData2FBD_Miko_CIRData105: start 392, 8 bit, little-endian, data-type-policy=OVERRIDE, base-type=uint8, compu {phys=raw}, range phys 0..255
          signal StatusCPDData2FBD_Miko_CIRData106: start 400, 8 bit, little-endian, data-type-policy=OVERRIDE, base-type=uint8, compu {phys=raw}, range phys 0..255
          signal StatusCPDData2FBD_Miko_CIRData107: start 408, 8 bit, little-endian, data-type-policy=OVERRIDE, base-type=uint8, compu {phys=raw}, range phys 0..255
          signal StatusCPDData2FBD_Miko_CIRData108: start 416, 8 bit, little-endian, data-type-policy=OVERRIDE, base-type=uint8, compu {phys=raw}, range phys 0..255
          signal StatusCPDData2FBD_Miko_CIRData109: start 424, 8 bit, little-endian, data-type-policy=OVERRIDE, base-type=uint8, compu {phys=raw}, range phys 0..255
          signal StatusCPDData2FBD_Miko_CIRData110: start 432, 8 bit, little-endian, data-type-policy=OVERRIDE, base-type=uint8, compu {phys=raw}, range phys 0..255
          signal StatusCPDData2FBD_Miko_CIRData111: start 440, 8 bit, little-endian, data-type-policy=OVERRIDE, base-type=uint8, compu {phys=raw}, range phys 0..255
          signal StatusCPDData2FBD_Miko_CIRData112: start 448, 8 bit, little-endian, data-type-policy=OVERRIDE, base-type=uint8, compu {phys=raw}, range phys 0..255
          signal StatusCPDData2FBD_Miko_CIRData113: start 456, 8 bit, little-endian, data-type-policy=OVERRIDE, base-type=uint8, compu {phys=raw}, range phys 0..255
          signal StatusCPDData2FBD_Miko_CIRData114: start 464, 8 bit, little-endian, data-type-policy=OVERRIDE, base-type=uint8, compu {phys=raw}, range phys 0..255
          signal StatusCPDData2FBD_Miko_CIRData115: start 472, 8 bit, little-endian, data-type-policy=OVERRIDE, base-type=uint8, compu {phys=raw}, range phys 0..255
          signal StatusCPDData2FBD_Miko_CIRData116: start 480, 8 bit, little-endian, data-type-policy=OVERRIDE, base-type=uint8, compu {phys=raw}, range phys 0..255
          signal StatusCPDData2FBD_Miko_CIRData117: start 488, 8 bit, little-endian, data-type-policy=OVERRIDE, base-type=uint8, compu {phys=raw}, range phys 0..255
          signal StatusCPDData2FBD_Miko_CIRData118: start 496, 8 bit, little-endian, data-type-policy=OVERRIDE, base-type=uint8, compu {phys=raw}, range phys 0..255
          signal StatusCPDData2FBD_Miko_CIRData119: start 504, 8 bit, little-endian, data-type-policy=OVERRIDE, base-type=uint8, compu {phys=raw}, range phys 0..255
      frame StatusCPDData2FBD_MM: id 0x342, frame-length=64, can-addressing-mode=STANDARD, can-frame-rx-behavior=CAN-FD, can-frame-tx-behavior=CAN-FD
        pdu StatusCPDData2FBD_MM: length=64, unused-bit-pattern=0
          signal StatusCPDData2FBD_MM_MsgCounter: start 0, 8 bit, little-endian, data-type-policy=OVERRIDE, base-type=uint8, compu {phys=raw}, range phys 0..252
          signal StatusCPDData2FBD_MM_LinkID: start 8, 8 bit, little-endian, data-type-policy=OVERRIDE, base-type=uint8, compu {phys=raw}, range phys 0..252
          signal StatusCPDData2FBD_MM_CollisionCounter: start 16, 8 bit, little-endian, data-type-policy=OVERRIDE, base-type=uint8, compu {phys=raw}, range phys 0..252
          signal StatusCPDData2FBD_MM_CIRSetting: start 24, 8 bit, little-endian, data-type-policy=OVERRIDE, compu {phys=raw}
          signal StatusCPDData2FBD_MM_CIRData60: start 32, 8 bit, little-endian, data-type-policy=OVERRIDE, base-type=uint8, compu {phys=raw}, range phys 0..255
          signal StatusCPDData2FBD_MM_CIRData61: start 40, 8 bit, little-endian, data-type-policy=OVERRIDE, base-type=uint8, compu {phys=raw}, range phys 0..255
          signal StatusCPDData2FBD_MM_CIRData62: start 48, 8 bit, little-endian, data-type-policy=OVERRIDE, base-type=uint8, compu {phys=raw}, range phys 0..255
          signal StatusCPDData2FBD_MM_CIRData63: start 56, 8 bit, little-endian, data-type-policy=OVERRIDE, base-type=uint8, compu {phys=raw}, range phys 0..255
          signal StatusCPDData2FBD_MM_CIRData64: start 64, 8 bit, little-endian, data-type-policy=OVERRIDE, base-type=uint8, compu {phys=raw}, range phys 0..255
          signal StatusCPDData2FBD_MM_CIRData65: start 72, 8 bit, little-endian, data-type-policy=OVERRIDE, base-type=uint8, compu {phys=raw}, range phys 0..255
          signal StatusCPDData2FBD_MM_CIRData66: start 80, 8 bit, little-endian, data-type-policy=OVERRIDE, base-type=uint8, compu {phys=raw}, range phys 0..255
          signal StatusCPDData2FBD_MM_CIRData67: start 88, 8 bit, little-endian, data-type-policy=OVERRIDE, base-type=uint8, compu {phys=raw}, range phys 0..255
          signal StatusCPDData2FBD_MM_CIRData68: start 96, 8 bit, little-endian, data-type-policy=OVERRIDE, base-type=uint8, compu {phys=raw}, range phys 0..255
          signal StatusCPDData2FBD_MM_CIRData69: start 104, 8 bit, little-endian, data-type-policy=OVERRIDE, base-type=uint8, compu {phys=raw}, range phys 0..255
          signal StatusCPDData2FBD_MM_CIRData70: start 112, 8 bit, little-endian, data-type-policy=OVERRIDE, base-type=uint8, compu {phys=raw}, range phys 0..255
          signal StatusCPDData2FBD_MM_CIRData71: start 120, 8 bit, little-endian, data-type-policy=OVERRIDE, base-type=uint8, compu {phys=raw}, range phys 0..255
          signal StatusCPDData2FBD_MM_CIRData72: start 128, 8 bit, little-endian, data-type-policy=OVERRIDE, base-type=uint8, compu {phys=raw}, range phys 0..255
          signal StatusCPDData2FBD_MM_CIRData73: start 136, 8 bit, little-endian, data-type-policy=OVERRIDE, base-type=uint8, compu {phys=raw}, range phys 0..255
          signal StatusCPDData2FBD_MM_CIRData74: start 144, 8 bit, little-endian, data-type-policy=OVERRIDE, base-type=uint8, compu {phys=raw}, range phys 0..255
          signal StatusCPDData2FBD_MM_CIRData75: start 152, 8 bit, little-endian, data-type-policy=OVERRIDE, base-type=uint8, compu {phys=raw}, range phys 0..255
          signal StatusCPDData2FBD_MM_CIRData76: start 160, 8 bit, little-endian, data-type-policy=OVERRIDE, base-type=uint8, compu {phys=raw}, range phys 0..255
          signal StatusCPDData2FBD_MM_CIRData77: start 168, 8 bit, little-endian, data-type-policy=OVERRIDE, base-type=uint8, compu {phys=raw}, range phys 0..255
          signal StatusCPDData2FBD_MM_CIRData78: start 176, 8 bit, little-endian, data-type-policy=OVERRIDE, base-type=uint8, compu {phys=raw}, range phys 0..255
          signal StatusCPDData2FBD_MM_CIRData79: start 184, 8 bit, little-endian, data-type-policy=OVERRIDE, base-type=uint8, compu {phys=raw}, range phys 0..255
          signal StatusCPDData2FBD_MM_CIRData80: start 192, 8 bit, little-endian, data-type-policy=OVERRIDE, base-type=uint8, compu {phys=raw}, range phys 0..255
          signal StatusCPDData2FBD_MM_CIRData81: start 200, 8 bit, little-endian, data-type-policy=OVERRIDE, base-type=uint8, compu {phys=raw}, range phys 0..255
          signal StatusCPDData2FBD_MM_CIRData82: start 208, 8 bit, little-endian, data-type-policy=OVERRIDE, base-type=uint8, compu {phys=raw}, range phys 0..255
          signal StatusCPDData2FBD_MM_CIRData83: start 216, 8 bit, little-endian, data-type-policy=OVERRIDE, base-type=uint8, compu {phys=raw}, range phys 0..255
          signal StatusCPDData2FBD_MM_CIRData84: start 224, 8 bit, little-endian, data-type-policy=OVERRIDE, base-type=uint8, compu {phys=raw}, range phys 0..255
          signal StatusCPDData2FBD_MM_CIRData85: start 232, 8 bit, little-endian, data-type-policy=OVERRIDE, base-type=uint8, compu {phys=raw}, range phys 0..255
          signal StatusCPDData2FBD_MM_CIRData86: start 240, 8 bit, little-endian, data-type-policy=OVERRIDE, base-type=uint8, compu {phys=raw}, range phys 0..255
          signal StatusCPDData2FBD_MM_CIRData87: start 248, 8 bit, little-endian, data-type-policy=OVERRIDE, base-type=uint8, compu {phys=raw}, range phys 0..255
          signal StatusCPDData2FBD_MM_CIRData88: start 256, 8 bit, little-endian, data-type-policy=OVERRIDE, base-type=uint8, compu {phys=raw}, range phys 0..255
          signal StatusCPDData2FBD_MM_CIRData89: start 264, 8 bit, little-endian, data-type-policy=OVERRIDE, base-type=uint8, compu {phys=raw}, range phys 0..255
          signal StatusCPDData2FBD_MM_CIRData90: start 272, 8 bit, little-endian, data-type-policy=OVERRIDE, base-type=uint8, compu {phys=raw}, range phys 0..255
          signal StatusCPDData2FBD_MM_CIRData91: start 280, 8 bit, little-endian, data-type-policy=OVERRIDE, base-type=uint8, compu {phys=raw}, range phys 0..255
          signal StatusCPDData2FBD_MM_CIRData92: start 288, 8 bit, little-endian, data-type-policy=OVERRIDE, base-type=uint8, compu {phys=raw}, range phys 0..255
          signal StatusCPDData2FBD_MM_CIRData93: start 296, 8 bit, little-endian, data-type-policy=OVERRIDE, base-type=uint8, compu {phys=raw}, range phys 0..255
          signal StatusCPDData2FBD_MM_CIRData94: start 304, 8 bit, little-endian, data-type-policy=OVERRIDE, base-type=uint8, compu {phys=raw}, range phys 0..255
          signal StatusCPDData2FBD_MM_CIRData95: start 312, 8 bit, little-endian, data-type-policy=OVERRIDE, base-type=uint8, compu {phys=raw}, range phys 0..255
          signal StatusCPDData2FBD_MM_CIRData96: start 320, 8 bit, little-endian, data-type-policy=OVERRIDE, base-type=uint8, compu {phys=raw}, range phys 0..255
          signal StatusCPDData2FBD_MM_CIRData97: start 328, 8 bit, little-endian, data-type-policy=OVERRIDE, base-type=uint8, compu {phys=raw}, range phys 0..255
          signal StatusCPDData2FBD_MM_CIRData98: start 336, 8 bit, little-endian, data-type-policy=OVERRIDE, base-type=uint8, compu {phys=raw}, range phys 0..255
          signal StatusCPDData2FBD_MM_CIRData99: start 344, 8 bit, little-endian, data-type-policy=OVERRIDE, base-type=uint8, compu {phys=raw}, range phys 0..255
          signal StatusCPDData2FBD_MM_CIRData100: start 352, 8 bit, little-endian, data-type-policy=OVERRIDE, base-type=uint8, compu {phys=raw}, range phys 0..255
          signal StatusCPDData2FBD_MM_CIRData101: start 360, 8 bit, little-endian, data-type-policy=OVERRIDE, base-type=uint8, compu {phys=raw}, range phys 0..255
          signal StatusCPDData2FBD_MM_CIRData102: start 368, 8 bit, little-endian, data-type-policy=OVERRIDE, base-type=uint8, compu {phys=raw}, range phys 0..255
          signal StatusCPDData2FBD_MM_CIRData103: start 376, 8 bit, little-endian, data-type-policy=OVERRIDE, base-type=uint8, compu {phys=raw}, range phys 0..255
          signal StatusCPDData2FBD_MM_CIRData104: start 384, 8 bit, little-endian, data-type-policy=OVERRIDE, base-type=uint8, compu {phys=raw}, range phys 0..255
          signal StatusCPDData2FBD_MM_CIRData105: start 392, 8 bit, little-endian, data-type-policy=OVERRIDE, base-type=uint8, compu {phys=raw}, range phys 0..255
          signal StatusCPDData2FBD_MM_CIRData106: start 400, 8 bit, little-endian, data-type-policy=OVERRIDE, base-type=uint8, compu {phys=raw}, range phys 0..255
          signal StatusCPDData2FBD_MM_CIRData107: start 408, 8 bit, little-endian, data-type-policy=OVERRIDE, base-type=uint8, compu {phys=raw}, range phys 0..255
          signal StatusCPDData2FBD_MM_CIRData108: start 416, 8 bit, little-endian, data-type-policy=OVERRIDE, base-type=uint8, compu {phys=raw}, range phys 0..255
          signal StatusCPDData2FBD_MM_CIRData109: start 424, 8 bit, little-endian, data-type-policy=OVERRIDE, base-type=uint8, compu {phys=raw}, range phys 0..255
          signal StatusCPDData2FBD_MM_CIRData110: start 432, 8 bit, little-endian, data-type-policy=OVERRIDE, base-type=uint8, compu {phys=raw}, range phys 0..255
          signal StatusCPDData2FBD_MM_CIRData111: start 440, 8 bit, little-endian, data-type-policy=OVERRIDE, base-type=uint8, compu {phys=raw}, range phys 0..255
          signal StatusCPDData2FBD_MM_CIRData112: start 448, 8 bit, little-endian, data-type-policy=OVERRIDE, base-type=uint8, compu {phys=raw}, range phys 0..255
          signal StatusCPDData2FBD_MM_CIRData113: start 456, 8 bit, little-endian, data-type-policy=OVERRIDE, base-type=uint8, compu {phys=raw}, range phys 0..255
          signal StatusCPDData2FBD_MM_CIRData114: start 464, 8 bit, little-endian, data-type-policy=OVERRIDE, base-type=uint8, compu {phys=raw}, range phys 0..255
          signal StatusCPDData2FBD_MM_CIRData115: start 472, 8 bit, little-endian, data-type-policy=OVERRIDE, base-type=uint8, compu {phys=raw}, range phys 0..255
          signal StatusCPDData2FBD_MM_CIRData116: start 480, 8 bit, little-endian, data-type-policy=OVERRIDE, base-type=uint8, compu {phys=raw}, range phys 0..255
          signal StatusCPDData2FBD_MM_CIRData117: start 488, 8 bit, little-endian, data-type-policy=OVERRIDE, base-type=uint8, compu {phys=raw}, range phys 0..255
          signal StatusCPDData2FBD_MM_CIRData118: start 496, 8 bit, little-endian, data-type-policy=OVERRIDE, base-type=uint8, compu {phys=raw}, range phys 0..255
          signal StatusCPDData2FBD_MM_CIRData119: start 504, 8 bit, little-endian, data-type-policy=OVERRIDE, base-type=uint8, compu {phys=raw}, range phys 0..255
      frame StatusCPDData2FBD_Trunk: id 0x157, frame-length=64, can-addressing-mode=STANDARD, can-frame-rx-behavior=CAN-FD, can-frame-tx-behavior=CAN-FD
        pdu StatusCPDData2FBD_Trunk: length=64, unused-bit-pattern=0
          signal StatusCPDData2FBD_Trunk_MsgCounter: start 0, 8 bit, little-endian, data-type-policy=OVERRIDE, base-type=uint8, compu {phys=raw}, range phys 0..252
          signal StatusCPDData2FBD_Trunk_LinkID: start 8, 8 bit, little-endian, data-type-policy=OVERRIDE, base-type=uint8, compu {phys=raw}, range phys 0..252
          signal StatusCPDData2FBD_Trunk_CollisionCounter: start 16, 8 bit, little-endian, data-type-policy=OVERRIDE, base-type=uint8, compu {phys=raw}, range phys 0..252
          signal StatusCPDData2FBD_Trunk_CIRSetting: start 24, 8 bit, little-endian, data-type-policy=OVERRIDE, compu {phys=raw}
          signal StatusCPDData2FBD_Trunk_CIRData60: start 32, 8 bit, little-endian, data-type-policy=OVERRIDE, base-type=uint8, compu {phys=raw}, range phys 0..255
          signal StatusCPDData2FBD_Trunk_CIRData61: start 40, 8 bit, little-endian, data-type-policy=OVERRIDE, base-type=uint8, compu {phys=raw}, range phys 0..255
          signal StatusCPDData2FBD_Trunk_CIRData62: start 48, 8 bit, little-endian, data-type-policy=OVERRIDE, base-type=uint8, compu {phys=raw}, range phys 0..255
          signal StatusCPDData2FBD_Trunk_CIRData63: start 56, 8 bit, little-endian, data-type-policy=OVERRIDE, base-type=uint8, compu {phys=raw}, range phys 0..255
          signal StatusCPDData2FBD_Trunk_CIRData64: start 64, 8 bit, little-endian, data-type-policy=OVERRIDE, base-type=uint8, compu {phys=raw}, range phys 0..255
          signal StatusCPDData2FBD_Trunk_CIRData65: start 72, 8 bit, little-endian, data-type-policy=OVERRIDE, base-type=uint8, compu {phys=raw}, range phys 0..255
          signal StatusCPDData2FBD_Trunk_CIRData66: start 80, 8 bit, little-endian, data-type-policy=OVERRIDE, base-type=uint8, compu {phys=raw}, range phys 0..255
          signal StatusCPDData2FBD_Trunk_CIRData67: start 88, 8 bit, little-endian, data-type-policy=OVERRIDE, base-type=uint8, compu {phys=raw}, range phys 0..255
          signal StatusCPDData2FBD_Trunk_CIRData68: start 96, 8 bit, little-endian, data-type-policy=OVERRIDE, base-type=uint8, compu {phys=raw}, range phys 0..255
          signal StatusCPDData2FBD_Trunk_CIRData69: start 104, 8 bit, little-endian, data-type-policy=OVERRIDE, base-type=uint8, compu {phys=raw}, range phys 0..255
          signal StatusCPDData2FBD_Trunk_CIRData70: start 112, 8 bit, little-endian, data-type-policy=OVERRIDE, base-type=uint8, compu {phys=raw}, range phys 0..255
          signal StatusCPDData2FBD_Trunk_CIRData71: start 120, 8 bit, little-endian, data-type-policy=OVERRIDE, base-type=uint8, compu {phys=raw}, range phys 0..255
          signal StatusCPDData2FBD_Trunk_CIRData72: start 128, 8 bit, little-endian, data-type-policy=OVERRIDE, base-type=uint8, compu {phys=raw}, range phys 0..255
          signal StatusCPDData2FBD_Trunk_CIRData73: start 136, 8 bit, little-endian, data-type-policy=OVERRIDE, base-type=uint8, compu {phys=raw}, range phys 0..255
          signal StatusCPDData2FBD_Trunk_CIRData74: start 144, 8 bit, little-endian, data-type-policy=OVERRIDE, base-type=uint8, compu {phys=raw}, range phys 0..255
          signal StatusCPDData2FBD_Trunk_CIRData75: start 152, 8 bit, little-endian, data-type-policy=OVERRIDE, base-type=uint8, compu {phys=raw}, range phys 0..255
          signal StatusCPDData2FBD_Trunk_CIRData76: start 160, 8 bit, little-endian, data-type-policy=OVERRIDE, base-type=uint8, compu {phys=raw}, range phys 0..255
          signal StatusCPDData2FBD_Trunk_CIRData77: start 168, 8 bit, little-endian, data-type-policy=OVERRIDE, base-type=uint8, compu {phys=raw}, range phys 0..255
          signal StatusCPDData2FBD_Trunk_CIRData78: start 176, 8 bit, little-endian, data-type-policy=OVERRIDE, base-type=uint8, compu {phys=raw}, range phys 0..255
          signal StatusCPDData2FBD_Trunk_CIRData79: start 184, 8 bit, little-endian, data-type-policy=OVERRIDE, base-type=uint8, compu {phys=raw}, range phys 0..255
          signal StatusCPDData2FBD_Trunk_CIRData80: start 192, 8 bit, little-endian, data-type-policy=OVERRIDE, base-type=uint8, compu {phys=raw}, range phys 0..255
          signal StatusCPDData2FBD_Trunk_CIRData81: start 200, 8 bit, little-endian, data-type-policy=OVERRIDE, base-type=uint8, compu {phys=raw}, range phys 0..255
          signal StatusCPDData2FBD_Trunk_CIRData82: start 208, 8 bit, little-endian, data-type-policy=OVERRIDE, base-type=uint8, compu {phys=raw}, range phys 0..255
          signal StatusCPDData2FBD_Trunk_CIRData83: start 216, 8 bit, little-endian, data-type-policy=OVERRIDE, base-type=uint8, compu {phys=raw}, range phys 0..255
          signal StatusCPDData2FBD_Trunk_CIRData84: start 224, 8 bit, little-endian, data-type-policy=OVERRIDE, base-type=uint8, compu {phys=raw}, range phys 0..255
          signal StatusCPDData2FBD_Trunk_CIRData85: start 232, 8 bit, little-endian, data-type-policy=OVERRIDE, base-type=uint8, compu {phys=raw}, range phys 0..255
          signal StatusCPDData2FBD_Trunk_CIRData86: start 240, 8 bit, little-endian, data-type-policy=OVERRIDE, base-type=uint8, compu {phys=raw}, range phys 0..255
          signal StatusCPDData2FBD_Trunk_CIRData87: start 248, 8 bit, little-endian, data-type-policy=OVERRIDE, base-type=uint8, compu {phys=raw}, range phys 0..255
          signal StatusCPDData2FBD_Trunk_CIRData88: start 256, 8 bit, little-endian, data-type-policy=OVERRIDE, base-type=uint8, compu {phys=raw}, range phys 0..255
          signal StatusCPDData2FBD_Trunk_CIRData89: start 264, 8 bit, little-endian, data-type-policy=OVERRIDE, base-type=uint8, compu {phys=raw}, range phys 0..255
          signal StatusCPDData2FBD_Trunk_CIRData90: start 272, 8 bit, little-endian, data-type-policy=OVERRIDE, base-type=uint8, compu {phys=raw}, range phys 0..255
          signal StatusCPDData2FBD_Trunk_CIRData91: start 280, 8 bit, little-endian, data-type-policy=OVERRIDE, base-type=uint8, compu {phys=raw}, range phys 0..255
          signal StatusCPDData2FBD_Trunk_CIRData92: start 288, 8 bit, little-endian, data-type-policy=OVERRIDE, base-type=uint8, compu {phys=raw}, range phys 0..255
          signal StatusCPDData2FBD_Trunk_CIRData93: start 296, 8 bit, little-endian, data-type-policy=OVERRIDE, base-type=uint8, compu {phys=raw}, range phys 0..255
          signal StatusCPDData2FBD_Trunk_CIRData94: start 304, 8 bit, little-endian, data-type-policy=OVERRIDE, base-type=uint8, compu {phys=raw}, range phys 0..255
          signal StatusCPDData2FBD_Trunk_CIRData95: start 312, 8 bit, little-endian, data-type-policy=OVERRIDE, base-type=uint8, compu {phys=raw}, range phys 0..255
          signal StatusCPDData2FBD_Trunk_CIRData96: start 320, 8 bit, little-endian, data-type-policy=OVERRIDE, base-type=uint8, compu {phys=raw}, range phys 0..255
          signal StatusCPDData2FBD_Trunk_CIRData97: start 328, 8 bit, little-endian, data-type-policy=OVERRIDE, base-type=uint8, compu {phys=raw}, range phys 0..255
          signal StatusCPDData2FBD_Trunk_CIRData98: start 336, 8 bit, little-endian, data-type-policy=OVERRIDE, base-type=uint8, compu {phys=raw}, range phys 0..255
          signal StatusCPDData2FBD_Trunk_CIRData99: start 344, 8 bit, little-endian, data-type-policy=OVERRIDE, base-type=uint8, compu {phys=raw}, range phys 0..255
          signal StatusCPDData2FBD_Trunk_CIRData100: start 352, 8 bit, little-endian, data-type-policy=OVERRIDE, base-type=uint8, compu {phys=raw}, range phys 0..255
          signal StatusCPDData2FBD_Trunk_CIRData101: start 360, 8 bit, little-endian, data-type-policy=OVERRIDE, base-type=uint8, compu {phys=raw}, range phys 0..255
          signal StatusCPDData2FBD_Trunk_CIRData102: start 368, 8 bit, little-endian, data-type-policy=OVERRIDE, base-type=uint8, compu {phys=raw}, range phys 0..255
          signal StatusCPDData2FBD_Trunk_CIRData103: start 376, 8 bit, little-endian, data-type-policy=OVERRIDE, base-type=uint8, compu {phys=raw}, range phys 0..255
          signal StatusCPDData2FBD_Trunk_CIRData104: start 384, 8 bit, little-endian, data-type-policy=OVERRIDE, base-type=uint8, compu {phys=raw}, range phys 0..255
          signal StatusCPDData2FBD_Trunk_CIRData105: start 392, 8 bit, little-endian, data-type-policy=OVERRIDE, base-type=uint8, compu {phys=raw}, range phys 0..255
          signal StatusCPDData2FBD_Trunk_CIRData106: start 400, 8 bit, little-endian, data-type-policy=OVERRIDE, base-type=uint8, compu {phys=raw}, range phys 0..255
          signal StatusCPDData2FBD_Trunk_CIRData107: start 408, 8 bit, little-endian, data-type-policy=OVERRIDE, base-type=uint8, compu {phys=raw}, range phys 0..255
          signal StatusCPDData2FBD_Trunk_CIRData108: start 416, 8 bit, little-endian, data-type-policy=OVERRIDE, base-type=uint8, compu {phys=raw}, range phys 0..255
          signal StatusCPDData2FBD_Trunk_CIRData109: start 424, 8 bit, little-endian, data-type-policy=OVERRIDE, base-type=uint8, compu {phys=raw}, range phys 0..255
          signal StatusCPDData2FBD_Trunk_CIRData110: start 432, 8 bit, little-endian, data-type-policy=OVERRIDE, base-type=uint8, compu {phys=raw}, range phys 0..255
          signal StatusCPDData2FBD_Trunk_CIRData111: start 440, 8 bit, little-endian, data-type-policy=OVERRIDE, base-type=uint8, compu {phys=raw}, range phys 0..255
          signal StatusCPDData2FBD_Trunk_CIRData112: start 448, 8 bit, little-endian, data-type-policy=OVERRIDE, base-type=uint8, compu {phys=raw}, range phys 0..255
          signal StatusCPDData2FBD_Trunk_CIRData113: start 456, 8 bit, little-endian, data-type-policy=OVERRIDE, base-type=uint8, compu {phys=raw}, range phys 0..255
          signal StatusCPDData2FBD_Trunk_CIRData114: start 464, 8 bit, little-endian, data-type-policy=OVERRIDE, base-type=uint8, compu {phys=raw}, range phys 0..255
          signal StatusCPDData2FBD_Trunk_CIRData115: start 472, 8 bit, little-endian, data-type-policy=OVERRIDE, base-type=uint8, compu {phys=raw}, range phys 0..255
          signal StatusCPDData2FBD_Trunk_CIRData116: start 480, 8 bit, little-endian, data-type-policy=OVERRIDE, base-type=uint8, compu {phys=raw}, range phys 0..255
          signal StatusCPDData2FBD_Trunk_CIRData117: start 488, 8 bit, little-endian, data-type-policy=OVERRIDE, base-type=uint8, compu {phys=raw}, range phys 0..255
          signal StatusCPDData2FBD_Trunk_CIRData118: start 496, 8 bit, little-endian, data-type-policy=OVERRIDE, base-type=uint8, compu {phys=raw}, range phys 0..255
          signal StatusCPDData2FBD_Trunk_CIRData119: start 504, 8 bit, little-endian, data-type-policy=OVERRIDE, base-type=uint8, compu {phys=raw}, range phys 0..255
      frame StatusCPDData2FBD_VL: id 0x158, frame-length=64, can-addressing-mode=STANDARD, can-frame-rx-behavior=CAN-FD, can-frame-tx-behavior=CAN-FD
        pdu StatusCPDData2FBD_VL: length=64, unused-bit-pattern=0
          signal StatusCPDData2FBD_VL_MsgCounter: start 0, 8 bit, little-endian, data-type-policy=OVERRIDE, base-type=uint8, compu {phys=raw}, range phys 0..252
          signal StatusCPDData2FBD_VL_LinkID: start 8, 8 bit, little-endian, data-type-policy=OVERRIDE, base-type=uint8, compu {phys=raw}, range phys 0..252
          signal StatusCPDData2FBD_VL_CollisionCounter: start 16, 8 bit, little-endian, data-type-policy=OVERRIDE, base-type=uint8, compu {phys=raw}, range phys 0..252
          signal StatusCPDData2FBD_VL_CIRSetting: start 24, 8 bit, little-endian, data-type-policy=OVERRIDE, compu {phys=raw}
          signal StatusCPDData2FBD_VL_CIRData60: start 32, 8 bit, little-endian, data-type-policy=OVERRIDE, base-type=uint8, compu {phys=raw}, range phys 0..255
          signal StatusCPDData2FBD_VL_CIRData61: start 40, 8 bit, little-endian, data-type-policy=OVERRIDE, base-type=uint8, compu {phys=raw}, range phys 0..255
          signal StatusCPDData2FBD_VL_CIRData62: start 48, 8 bit, little-endian, data-type-policy=OVERRIDE, base-type=uint8, compu {phys=raw}, range phys 0..255
          signal StatusCPDData2FBD_VL_CIRData63: start 56, 8 bit, little-endian, data-type-policy=OVERRIDE, base-type=uint8, compu {phys=raw}, range phys 0..255
          signal StatusCPDData2FBD_VL_CIRData64: start 64, 8 bit, little-endian, data-type-policy=OVERRIDE, base-type=uint8, compu {phys=raw}, range phys 0..255
          signal StatusCPDData2FBD_VL_CIRData65: start 72, 8 bit, little-endian, data-type-policy=OVERRIDE, base-type=uint8, compu {phys=raw}, range phys 0..255
          signal StatusCPDData2FBD_VL_CIRData66: start 80, 8 bit, little-endian, data-type-policy=OVERRIDE, base-type=uint8, compu {phys=raw}, range phys 0..255
          signal StatusCPDData2FBD_VL_CIRData67: start 88, 8 bit, little-endian, data-type-policy=OVERRIDE, base-type=uint8, compu {phys=raw}, range phys 0..255
          signal StatusCPDData2FBD_VL_CIRData68: start 96, 8 bit, little-endian, data-type-policy=OVERRIDE, base-type=uint8, compu {phys=raw}, range phys 0..255
          signal StatusCPDData2FBD_VL_CIRData69: start 104, 8 bit, little-endian, data-type-policy=OVERRIDE, base-type=uint8, compu {phys=raw}, range phys 0..255
          signal StatusCPDData2FBD_VL_CIRData70: start 112, 8 bit, little-endian, data-type-policy=OVERRIDE, base-type=uint8, compu {phys=raw}, range phys 0..255
          signal StatusCPDData2FBD_VL_CIRData71: start 120, 8 bit, little-endian, data-type-policy=OVERRIDE, base-type=uint8, compu {phys=raw}, range phys 0..255
          signal StatusCPDData2FBD_VL_CIRData72: start 128, 8 bit, little-endian, data-type-policy=OVERRIDE, base-type=uint8, compu {phys=raw}, range phys 0..255
          signal StatusCPDData2FBD_VL_CIRData73: start 136, 8 bit, little-endian, data-type-policy=OVERRIDE, base-type=uint8, compu {phys=raw}, range phys 0..255
          signal StatusCPDData2FBD_VL_CIRData74: start 144, 8 bit, little-endian, data-type-policy=OVERRIDE, base-type=uint8, compu {phys=raw}, range phys 0..255
          signal StatusCPDData2FBD_VL_CIRData75: start 152, 8 bit, little-endian, data-type-policy=OVERRIDE, base-type=uint8, compu {phys=raw}, range phys 0..255
          signal StatusCPDData2FBD_VL_CIRData76: start 160, 8 bit, little-endian, data-type-policy=OVERRIDE, base-type=uint8, compu {phys=raw}, range phys 0..255
          signal StatusCPDData2FBD_VL_CIRData77: start 168, 8 bit, little-endian, data-type-policy=OVERRIDE, base-type=uint8, compu {phys=raw}, range phys 0..255
          signal StatusCPDData2FBD_VL_CIRData78: start 176, 8 bit, little-endian, data-type-policy=OVERRIDE, base-type=uint8, compu {phys=raw}, range phys 0..255
          signal StatusCPDData2FBD_VL_CIRData79: start 184, 8 bit, little-endian, data-type-policy=OVERRIDE, base-type=uint8, compu {phys=raw}, range phys 0..255
          signal StatusCPDData2FBD_VL_CIRData80: start 192, 8 bit, little-endian, data-type-policy=OVERRIDE, base-type=uint8, compu {phys=raw}, range phys 0..255
          signal StatusCPDData2FBD_VL_CIRData81: start 200, 8 bit, little-endian, data-type-policy=OVERRIDE, base-type=uint8, compu {phys=raw}, range phys 0..255
          signal StatusCPDData2FBD_VL_CIRData82: start 208, 8 bit, little-endian, data-type-policy=OVERRIDE, base-type=uint8, compu {phys=raw}, range phys 0..255
          signal StatusCPDData2FBD_VL_CIRData83: start 216, 8 bit, little-endian, data-type-policy=OVERRIDE, base-type=uint8, compu {phys=raw}, range phys 0..255
          signal StatusCPDData2FBD_VL_CIRData84: start 224, 8 bit, little-endian, data-type-policy=OVERRIDE, base-type=uint8, compu {phys=raw}, range phys 0..255
          signal StatusCPDData2FBD_VL_CIRData85: start 232, 8 bit, little-endian, data-type-policy=OVERRIDE, base-type=uint8, compu {phys=raw}, range phys 0..255
          signal StatusCPDData2FBD_VL_CIRData86: start 240, 8 bit, little-endian, data-type-policy=OVERRIDE, base-type=uint8, compu {phys=raw}, range phys 0..255
          signal StatusCPDData2FBD_VL_CIRData87: start 248, 8 bit, little-endian, data-type-policy=OVERRIDE, base-type=uint8, compu {phys=raw}, range phys 0..255
          signal StatusCPDData2FBD_VL_CIRData88: start 256, 8 bit, little-endian, data-type-policy=OVERRIDE, base-type=uint8, compu {phys=raw}, range phys 0..255
          signal StatusCPDData2FBD_VL_CIRData89: start 264, 8 bit, little-endian, data-type-policy=OVERRIDE, base-type=uint8, compu {phys=raw}, range phys 0..255
          signal StatusCPDData2FBD_VL_CIRData90: start 272, 8 bit, little-endian, data-type-policy=OVERRIDE, base-type=uint8, compu {phys=raw}, range phys 0..255
          signal StatusCPDData2FBD_VL_CIRData91: start 280, 8 bit, little-endian, data-type-policy=OVERRIDE, base-type=uint8, compu {phys=raw}, range phys 0..255
          signal StatusCPDData2FBD_VL_CIRData92: start 288, 8 bit, little-endian, data-type-policy=OVERRIDE, base-type=uint8, compu {phys=raw}, range phys 0..255
          signal StatusCPDData2FBD_VL_CIRData93: start 296, 8 bit, little-endian, data-type-policy=OVERRIDE, base-type=uint8, compu {phys=raw}, range phys 0..255
          signal StatusCPDData2FBD_VL_CIRData94: start 304, 8 bit, little-endian, data-type-policy=OVERRIDE, base-type=uint8, compu {phys=raw}, range phys 0..255
          signal StatusCPDData2FBD_VL_CIRData95: start 312, 8 bit, little-endian, data-type-policy=OVERRIDE, base-type=uint8, compu {phys=raw}, range phys 0..255
          signal StatusCPDData2FBD_VL_CIRData96: start 320, 8 bit, little-endian, data-type-policy=OVERRIDE, base-type=uint8, compu {phys=raw}, range phys 0..255
          signal StatusCPDData2FBD_VL_CIRData97: start 328, 8 bit, little-endian, data-type-policy=OVERRIDE, base-type=uint8, compu {phys=raw}, range phys 0..255
          signal StatusCPDData2FBD_VL_CIRData98: start 336, 8 bit, little-endian, data-type-policy=OVERRIDE, base-type=uint8, compu {phys=raw}, range phys 0..255
          signal StatusCPDData2FBD_VL_CIRData99: start 344, 8 bit, little-endian, data-type-policy=OVERRIDE, base-type=uint8, compu {phys=raw}, range phys 0..255
          signal StatusCPDData2FBD_VL_CIRData100: start 352, 8 bit, little-endian, data-type-policy=OVERRIDE, base-type=uint8, compu {phys=raw}, range phys 0..255
          signal StatusCPDData2FBD_VL_CIRData101: start 360, 8 bit, little-endian, data-type-policy=OVERRIDE, base-type=uint8, compu {phys=raw}, range phys 0..255
          signal StatusCPDData2FBD_VL_CIRData102: start 368, 8 bit, little-endian, data-type-policy=OVERRIDE, base-type=uint8, compu {phys=raw}, range phys 0..255
          signal StatusCPDData2FBD_VL_CIRData103: start 376, 8 bit, little-endian, data-type-policy=OVERRIDE, base-type=uint8, compu {phys=raw}, range phys 0..255
          signal StatusCPDData2FBD_VL_CIRData104: start 384, 8 bit, little-endian, data-type-policy=OVERRIDE, base-type=uint8, compu {phys=raw}, range phys 0..255
          signal StatusCPDData2FBD_VL_CIRData105: start 392, 8 bit, little-endian, data-type-policy=OVERRIDE, base-type=uint8, compu {phys=raw}, range phys 0..255
          signal StatusCPDData2FBD_VL_CIRData106: start 400, 8 bit, little-endian, data-type-policy=OVERRIDE, base-type=uint8, compu {phys=raw}, range phys 0..255
          signal StatusCPDData2FBD_VL_CIRData107: start 408, 8 bit, little-endian, data-type-policy=OVERRIDE, base-type=uint8, compu {phys=raw}, range phys 0..255
          signal StatusCPDData2FBD_VL_CIRData108: start 416, 8 bit, little-endian, data-type-policy=OVERRIDE, base-type=uint8, compu {phys=raw}, range phys 0..255
          signal StatusCPDData2FBD_VL_CIRData109: start 424, 8 bit, little-endian, data-type-policy=OVERRIDE, base-type=uint8, compu {phys=raw}, range phys 0..255
          signal StatusCPDData2FBD_VL_CIRData110: start 432, 8 bit, little-endian, data-type-policy=OVERRIDE, base-type=uint8, compu {phys=raw}, range phys 0..255
          signal StatusCPDData2FBD_VL_CIRData111: start 440, 8 bit, little-endian, data-type-policy=OVERRIDE, base-type=uint8, compu {phys=raw}, range phys 0..255
          signal StatusCPDData2FBD_VL_CIRData112: start 448, 8 bit, little-endian, data-type-policy=OVERRIDE, base-type=uint8, compu {phys=raw}, range phys 0..255
          signal StatusCPDData2FBD_VL_CIRData113: start 456, 8 bit, little-endian, data-type-policy=OVERRIDE, base-type=uint8, compu {phys=raw}, range phys 0..255
          signal StatusCPDData2FBD_VL_CIRData114: start 464, 8 bit, little-endian, data-type-policy=OVERRIDE, base-type=uint8, compu {phys=raw}, range phys 0..255
          signal StatusCPDData2FBD_VL_CIRData115: start 472, 8 bit, little-endian, data-type-policy=OVERRIDE, base-type=uint8, compu {phys=raw}, range phys 0..255
          signal StatusCPDData2FBD_VL_CIRData116: start 480, 8 bit, little-endian, data-type-policy=OVERRIDE, base-type=uint8, compu {phys=raw}, range phys 0..255
          signal StatusCPDData2FBD_VL_CIRData117: start 488, 8 bit, little-endian, data-type-policy=OVERRIDE, base-type=uint8, compu {phys=raw}, range phys 0..255
          signal StatusCPDData2FBD_VL_CIRData118: start 496, 8 bit, little-endian, data-type-policy=OVERRIDE, base-type=uint8, compu {phys=raw}, range phys 0..255
          signal StatusCPDData2FBD_VL_CIRData119: start 504, 8 bit, little-endian, data-type-policy=OVERRIDE, base-type=uint8, compu {phys=raw}, range phys 0..255
      frame StatusCPDData2FBD_VM: id 0x154, frame-length=64, can-addressing-mode=STANDARD, can-frame-rx-behavior=CAN-FD, can-frame-tx-behavior=CAN-FD
        pdu StatusCPDData2FBD_VM: length=64, unused-bit-pattern=0
          signal StatusCPDData2FBD_VM_MsgCounter: start 0, 8 bit, little-endian, data-type-policy=OVERRIDE, base-type=uint8, compu {phys=raw}, range phys 0..252
          signal StatusCPDData2FBD_VM_LinkID: start 8, 8 bit, little-endian, data-type-policy=OVERRIDE, base-type=uint8, compu {phys=raw}, range phys 0..252
          signal StatusCPDData2FBD_VM_CollisionCounter: start 16, 8 bit, little-endian, data-type-policy=OVERRIDE, base-type=uint8, compu {phys=raw}, range phys 0..252
          signal StatusCPDData2FBD_VM_CIRSetting: start 24, 8 bit, little-endian, data-type-policy=OVERRIDE, compu {phys=raw}
          signal StatusCPDData2FBD_VM_CIRData60: start 32, 8 bit, little-endian, data-type-policy=OVERRIDE, base-type=uint8, compu {phys=raw}, range phys 0..255
          signal StatusCPDData2FBD_VM_CIRData61: start 40, 8 bit, little-endian, data-type-policy=OVERRIDE, base-type=uint8, compu {phys=raw}, range phys 0..255
          signal StatusCPDData2FBD_VM_CIRData62: start 48, 8 bit, little-endian, data-type-policy=OVERRIDE, base-type=uint8, compu {phys=raw}, range phys 0..255
          signal StatusCPDData2FBD_VM_CIRData63: start 56, 8 bit, little-endian, data-type-policy=OVERRIDE, base-type=uint8, compu {phys=raw}, range phys 0..255
          signal StatusCPDData2FBD_VM_CIRData64: start 64, 8 bit, little-endian, data-type-policy=OVERRIDE, base-type=uint8, compu {phys=raw}, range phys 0..255
          signal StatusCPDData2FBD_VM_CIRData65: start 72, 8 bit, little-endian, data-type-policy=OVERRIDE, base-type=uint8, compu {phys=raw}, range phys 0..255
          signal StatusCPDData2FBD_VM_CIRData66: start 80, 8 bit, little-endian, data-type-policy=OVERRIDE, base-type=uint8, compu {phys=raw}, range phys 0..255
          signal StatusCPDData2FBD_VM_CIRData67: start 88, 8 bit, little-endian, data-type-policy=OVERRIDE, base-type=uint8, compu {phys=raw}, range phys 0..255
          signal StatusCPDData2FBD_VM_CIRData68: start 96, 8 bit, little-endian, data-type-policy=OVERRIDE, base-type=uint8, compu {phys=raw}, range phys 0..255
          signal StatusCPDData2FBD_VM_CIRData69: start 104, 8 bit, little-endian, data-type-policy=OVERRIDE, base-type=uint8, compu {phys=raw}, range phys 0..255
          signal StatusCPDData2FBD_VM_CIRData70: start 112, 8 bit, little-endian, data-type-policy=OVERRIDE, base-type=uint8, compu {phys=raw}, range phys 0..255
          signal StatusCPDData2FBD_VM_CIRData71: start 120, 8 bit, little-endian, data-type-policy=OVERRIDE, base-type=uint8, compu {phys=raw}, range phys 0..255
          signal StatusCPDData2FBD_VM_CIRData72: start 128, 8 bit, little-endian, data-type-policy=OVERRIDE, base-type=uint8, compu {phys=raw}, range phys 0..255
          signal StatusCPDData2FBD_VM_CIRData73: start 136, 8 bit, little-endian, data-type-policy=OVERRIDE, base-type=uint8, compu {phys=raw}, range phys 0..255
          signal StatusCPDData2FBD_VM_CIRData74: start 144, 8 bit, little-endian, data-type-policy=OVERRIDE, base-type=uint8, compu {phys=raw}, range phys 0..255
          signal StatusCPDData2FBD_VM_CIRData75: start 152, 8 bit, little-endian, data-type-policy=OVERRIDE, base-type=uint8, compu {phys=raw}, range phys 0..255
          signal StatusCPDData2FBD_VM_CIRData76: start 160, 8 bit, little-endian, data-type-policy=OVERRIDE, base-type=uint8, compu {phys=raw}, range phys 0..255
          signal StatusCPDData2FBD_VM_CIRData77: start 168, 8 bit, little-endian, data-type-policy=OVERRIDE, base-type=uint8, compu {phys=raw}, range phys 0..255
          signal StatusCPDData2FBD_VM_CIRData78: start 176, 8 bit, little-endian, data-type-policy=OVERRIDE, base-type=uint8, compu {phys=raw}, range phys 0..255
          signal StatusCPDData2FBD_VM_CIRData79: start 184, 8 bit, little-endian, data-type-policy=OVERRIDE, base-type=uint8, compu {phys=raw}, range phys 0..255
          signal StatusCPDData2FBD_VM_CIRData80: start 192, 8 bit, little-endian, data-type-policy=OVERRIDE, base-type=uint8, compu {phys=raw}, range phys 0..255
          signal StatusCPDData2FBD_VM_CIRData81: start 200, 8 bit, little-endian, data-type-policy=OVERRIDE, base-type=uint8, compu {phys=raw}, range phys 0..255
          signal StatusCPDData2FBD_VM_CIRData82: start 208, 8 bit, little-endian, data-type-policy=OVERRIDE, base-type=uint8, compu {phys=raw}, range phys 0..255
          signal StatusCPDData2FBD_VM_CIRData83: start 216, 8 bit, little-endian, data-type-policy=OVERRIDE, base-type=uint8, compu {phys=raw}, range phys 0..255
          signal StatusCPDData2FBD_VM_CIRData84: start 224, 8 bit, little-endian, data-type-policy=OVERRIDE, base-type=uint8, compu {phys=raw}, range phys 0..255
          signal StatusCPDData2FBD_VM_CIRData85: start 232, 8 bit, little-endian, data-type-policy=OVERRIDE, base-type=uint8, compu {phys=raw}, range phys 0..255
          signal StatusCPDData2FBD_VM_CIRData86: start 240, 8 bit, little-endian, data-type-policy=OVERRIDE, base-type=uint8, compu {phys=raw}, range phys 0..255
          signal StatusCPDData2FBD_VM_CIRData87: start 248, 8 bit, little-endian, data-type-policy=OVERRIDE, base-type=uint8, compu {phys=raw}, range phys 0..255
          signal StatusCPDData2FBD_VM_CIRData88: start 256, 8 bit, little-endian, data-type-policy=OVERRIDE, base-type=uint8, compu {phys=raw}, range phys 0..255
          signal StatusCPDData2FBD_VM_CIRData89: start 264, 8 bit, little-endian, data-type-policy=OVERRIDE, base-type=uint8, compu {phys=raw}, range phys 0..255
          signal StatusCPDData2FBD_VM_CIRData90: start 272, 8 bit, little-endian, data-type-policy=OVERRIDE, base-type=uint8, compu {phys=raw}, range phys 0..255
          signal StatusCPDData2FBD_VM_CIRData91: start 280, 8 bit, little-endian, data-type-policy=OVERRIDE, base-type=uint8, compu {phys=raw}, range phys 0..255
          signal StatusCPDData2FBD_VM_CIRData92: start 288, 8 bit, little-endian, data-type-policy=OVERRIDE, base-type=uint8, compu {phys=raw}, range phys 0..255
          signal StatusCPDData2FBD_VM_CIRData93: start 296, 8 bit, little-endian, data-type-policy=OVERRIDE, base-type=uint8, compu {phys=raw}, range phys 0..255
          signal StatusCPDData2FBD_VM_CIRData94: start 304, 8 bit, little-endian, data-type-policy=OVERRIDE, base-type=uint8, compu {phys=raw}, range phys 0..255
          signal StatusCPDData2FBD_VM_CIRData95: start 312, 8 bit, little-endian, data-type-policy=OVERRIDE, base-type=uint8, compu {phys=raw}, range phys 0..255
          signal StatusCPDData2FBD_VM_CIRData96: start 320, 8 bit, little-endian, data-type-policy=OVERRIDE, base-type=uint8, compu {phys=raw}, range phys 0..255
          signal StatusCPDData2FBD_VM_CIRData97: start 328, 8 bit, little-endian, data-type-policy=OVERRIDE, base-type=uint8, compu {phys=raw}, range phys 0..255
          signal StatusCPDData2FBD_VM_CIRData98: start 336, 8 bit, little-endian, data-type-policy=OVERRIDE, base-type=uint8, compu {phys=raw}, range phys 0..255
          signal StatusCPDData2FBD_VM_CIRData99: start 344, 8 bit, little-endian, data-type-policy=OVERRIDE, base-type=uint8, compu {phys=raw}, range phys 0..255
          signal StatusCPDData2FBD_VM_CIRData100: start 352, 8 bit, little-endian, data-type-policy=OVERRIDE, base-type=uint8, compu {phys=raw}, range phys 0..255
          signal StatusCPDData2FBD_VM_CIRData101: start 360, 8 bit, little-endian, data-type-policy=OVERRIDE, base-type=uint8, compu {phys=raw}, range phys 0..255
          signal StatusCPDData2FBD_VM_CIRData102: start 368, 8 bit, little-endian, data-type-policy=OVERRIDE, base-type=uint8, compu {phys=raw}, range phys 0..255
          signal StatusCPDData2FBD_VM_CIRData103: start 376, 8 bit, little-endian, data-type-policy=OVERRIDE, base-type=uint8, compu {phys=raw}, range phys 0..255
          signal StatusCPDData2FBD_VM_CIRData104: start 384, 8 bit, little-endian, data-type-policy=OVERRIDE, base-type=uint8, compu {phys=raw}, range phys 0..255
          signal StatusCPDData2FBD_VM_CIRData105: start 392, 8 bit, little-endian, data-type-policy=OVERRIDE, base-type=uint8, compu {phys=raw}, range phys 0..255
          signal StatusCPDData2FBD_VM_CIRData106: start 400, 8 bit, little-endian, data-type-policy=OVERRIDE, base-type=uint8, compu {phys=raw}, range phys 0..255
          signal StatusCPDData2FBD_VM_CIRData107: start 408, 8 bit, little-endian, data-type-policy=OVERRIDE, base-type=uint8, compu {phys=raw}, range phys 0..255
          signal StatusCPDData2FBD_VM_CIRData108: start 416, 8 bit, little-endian, data-type-policy=OVERRIDE, base-type=uint8, compu {phys=raw}, range phys 0..255
          signal StatusCPDData2FBD_VM_CIRData109: start 424, 8 bit, little-endian, data-type-policy=OVERRIDE, base-type=uint8, compu {phys=raw}, range phys 0..255
          signal StatusCPDData2FBD_VM_CIRData110: start 432, 8 bit, little-endian, data-type-policy=OVERRIDE, base-type=uint8, compu {phys=raw}, range phys 0..255
          signal StatusCPDData2FBD_VM_CIRData111: start 440, 8 bit, little-endian, data-type-policy=OVERRIDE, base-type=uint8, compu {phys=raw}, range phys 0..255
          signal StatusCPDData2FBD_VM_CIRData112: start 448, 8 bit, little-endian, data-type-policy=OVERRIDE, base-type=uint8, compu {phys=raw}, range phys 0..255
          signal StatusCPDData2FBD_VM_CIRData113: start 456, 8 bit, little-endian, data-type-policy=OVERRIDE, base-type=uint8, compu {phys=raw}, range phys 0..255
          signal StatusCPDData2FBD_VM_CIRData114: start 464, 8 bit, little-endian, data-type-policy=OVERRIDE, base-type=uint8, compu {phys=raw}, range phys 0..255
          signal StatusCPDData2FBD_VM_CIRData115: start 472, 8 bit, little-endian, data-type-policy=OVERRIDE, base-type=uint8, compu {phys=raw}, range phys 0..255
          signal StatusCPDData2FBD_VM_CIRData116: start 480, 8 bit, little-endian, data-type-policy=OVERRIDE, base-type=uint8, compu {phys=raw}, range phys 0..255
          signal StatusCPDData2FBD_VM_CIRData117: start 488, 8 bit, little-endian, data-type-policy=OVERRIDE, base-type=uint8, compu {phys=raw}, range phys 0..255
          signal StatusCPDData2FBD_VM_CIRData118: start 496, 8 bit, little-endian, data-type-policy=OVERRIDE, base-type=uint8, compu {phys=raw}, range phys 0..255
          signal StatusCPDData2FBD_VM_CIRData119: start 504, 8 bit, little-endian, data-type-policy=OVERRIDE, base-type=uint8, compu {phys=raw}, range phys 0..255
      frame StatusCPDData2FBD_VR: id 0x159, frame-length=64, can-addressing-mode=STANDARD, can-frame-rx-behavior=CAN-FD, can-frame-tx-behavior=CAN-FD
        pdu StatusCPDData2FBD_VR: length=64, unused-bit-pattern=0
          signal StatusCPDData2FBD_VR_MsgCounter: start 0, 8 bit, little-endian, data-type-policy=OVERRIDE, base-type=uint8, compu {phys=raw}, range phys 0..252
          signal StatusCPDData2FBD_VR_LinkID: start 8, 8 bit, little-endian, data-type-policy=OVERRIDE, base-type=uint8, compu {phys=raw}, range phys 0..252
          signal StatusCPDData2FBD_VR_CollisionCounter: start 16, 8 bit, little-endian, data-type-policy=OVERRIDE, base-type=uint8, compu {phys=raw}, range phys 0..252
          signal StatusCPDData2FBD_VR_CIRSetting: start 24, 8 bit, little-endian, data-type-policy=OVERRIDE, compu {phys=raw}
          signal StatusCPDData2FBD_VR_CIRData60: start 32, 8 bit, little-endian, data-type-policy=OVERRIDE, base-type=uint8, compu {phys=raw}, range phys 0..255
          signal StatusCPDData2FBD_VR_CIRData61: start 40, 8 bit, little-endian, data-type-policy=OVERRIDE, base-type=uint8, compu {phys=raw}, range phys 0..255
          signal StatusCPDData2FBD_VR_CIRData62: start 48, 8 bit, little-endian, data-type-policy=OVERRIDE, base-type=uint8, compu {phys=raw}, range phys 0..255
          signal StatusCPDData2FBD_VR_CIRData63: start 56, 8 bit, little-endian, data-type-policy=OVERRIDE, base-type=uint8, compu {phys=raw}, range phys 0..255
          signal StatusCPDData2FBD_VR_CIRData64: start 64, 8 bit, little-endian, data-type-policy=OVERRIDE, base-type=uint8, compu {phys=raw}, range phys 0..255
          signal StatusCPDData2FBD_VR_CIRData65: start 72, 8 bit, little-endian, data-type-policy=OVERRIDE, base-type=uint8, compu {phys=raw}, range phys 0..255
          signal StatusCPDData2FBD_VR_CIRData66: start 80, 8 bit, little-endian, data-type-policy=OVERRIDE, base-type=uint8, compu {phys=raw}, range phys 0..255
          signal StatusCPDData2FBD_VR_CIRData67: start 88, 8 bit, little-endian, data-type-policy=OVERRIDE, base-type=uint8, compu {phys=raw}, range phys 0..255
          signal StatusCPDData2FBD_VR_CIRData68: start 96, 8 bit, little-endian, data-type-policy=OVERRIDE, base-type=uint8, compu {phys=raw}, range phys 0..255
          signal StatusCPDData2FBD_VR_CIRData69: start 104, 8 bit, little-endian, data-type-policy=OVERRIDE, base-type=uint8, compu {phys=raw}, range phys 0..255
          signal StatusCPDData2FBD_VR_CIRData70: start 112, 8 bit, little-endian, data-type-policy=OVERRIDE, base-type=uint8, compu {phys=raw}, range phys 0..255
          signal StatusCPDData2FBD_VR_CIRData71: start 120, 8 bit, little-endian, data-type-policy=OVERRIDE, base-type=uint8, compu {phys=raw}, range phys 0..255
          signal StatusCPDData2FBD_VR_CIRData72: start 128, 8 bit, little-endian, data-type-policy=OVERRIDE, base-type=uint8, compu {phys=raw}, range phys 0..255
          signal StatusCPDData2FBD_VR_CIRData73: start 136, 8 bit, little-endian, data-type-policy=OVERRIDE, base-type=uint8, compu {phys=raw}, range phys 0..255
          signal StatusCPDData2FBD_VR_CIRData74: start 144, 8 bit, little-endian, data-type-policy=OVERRIDE, base-type=uint8, compu {phys=raw}, range phys 0..255
          signal StatusCPDData2FBD_VR_CIRData75: start 152, 8 bit, little-endian, data-type-policy=OVERRIDE, base-type=uint8, compu {phys=raw}, range phys 0..255
          signal StatusCPDData2FBD_VR_CIRData76: start 160, 8 bit, little-endian, data-type-policy=OVERRIDE, base-type=uint8, compu {phys=raw}, range phys 0..255
          signal StatusCPDData2FBD_VR_CIRData77: start 168, 8 bit, little-endian, data-type-policy=OVERRIDE, base-type=uint8, compu {phys=raw}, range phys 0..255
          signal StatusCPDData2FBD_VR_CIRData78: start 176, 8 bit, little-endian, data-type-policy=OVERRIDE, base-type=uint8, compu {phys=raw}, range phys 0..255
          signal StatusCPDData2FBD_VR_CIRData79: start 184, 8 bit, little-endian, data-type-policy=OVERRIDE, base-type=uint8, compu {phys=raw}, range phys 0..255
          signal StatusCPDData2FBD_VR_CIRData80: start 192, 8 bit, little-endian, data-type-policy=OVERRIDE, base-type=uint8, compu {phys=raw}, range phys 0..255
          signal StatusCPDData2FBD_VR_CIRData81: start 200, 8 bit, little-endian, data-type-policy=OVERRIDE, base-type=uint8, compu {phys=raw}, range phys 0..255
          signal StatusCPDData2FBD_VR_CIRData82: start 208, 8 bit, little-endian, data-type-policy=OVERRIDE, base-type=uint8, compu {phys=raw}, range phys 0..255
          signal StatusCPDData2FBD_VR_CIRData83: start 216, 8 bit, little-endian, data-type-policy=OVERRIDE, base-type=uint8, compu {phys=raw}, range phys 0..255
          signal StatusCPDData2FBD_VR_CIRData84: start 224, 8 bit, little-endian, data-type-policy=OVERRIDE, base-type=uint8, compu {phys=raw}, range phys 0..255
          signal StatusCPDData2FBD_VR_CIRData85: start 232, 8 bit, little-endian, data-type-policy=OVERRIDE, base-type=uint8, compu {phys=raw}, range phys 0..255
          signal StatusCPDData2FBD_VR_CIRData86: start 240, 8 bit, little-endian, data-type-policy=OVERRIDE, base-type=uint8, compu {phys=raw}, range phys 0..255
          signal StatusCPDData2FBD_VR_CIRData87: start 248, 8 bit, little-endian, data-type-policy=OVERRIDE, base-type=uint8, compu {phys=raw}, range phys 0..255
          signal StatusCPDData2FBD_VR_CIRData88: start 256, 8 bit, little-endian, data-type-policy=OVERRIDE, base-type=uint8, compu {phys=raw}, range phys 0..255
          signal StatusCPDData2FBD_VR_CIRData89: start 264, 8 bit, little-endian, data-type-policy=OVERRIDE, base-type=uint8, compu {phys=raw}, range phys 0..255
          signal StatusCPDData2FBD_VR_CIRData90: start 272, 8 bit, little-endian, data-type-policy=OVERRIDE, base-type=uint8, compu {phys=raw}, range phys 0..255
          signal StatusCPDData2FBD_VR_CIRData91: start 280, 8 bit, little-endian, data-type-policy=OVERRIDE, base-type=uint8, compu {phys=raw}, range phys 0..255
          signal StatusCPDData2FBD_VR_CIRData92: start 288, 8 bit, little-endian, data-type-policy=OVERRIDE, base-type=uint8, compu {phys=raw}, range phys 0..255
          signal StatusCPDData2FBD_VR_CIRData93: start 296, 8 bit, little-endian, data-type-policy=OVERRIDE, base-type=uint8, compu {phys=raw}, range phys 0..255
          signal StatusCPDData2FBD_VR_CIRData94: start 304, 8 bit, little-endian, data-type-policy=OVERRIDE, base-type=uint8, compu {phys=raw}, range phys 0..255
          signal StatusCPDData2FBD_VR_CIRData95: start 312, 8 bit, little-endian, data-type-policy=OVERRIDE, base-type=uint8, compu {phys=raw}, range phys 0..255
          signal StatusCPDData2FBD_VR_CIRData96: start 320, 8 bit, little-endian, data-type-policy=OVERRIDE, base-type=uint8, compu {phys=raw}, range phys 0..255
          signal StatusCPDData2FBD_VR_CIRData97: start 328, 8 bit, little-endian, data-type-policy=OVERRIDE, base-type=uint8, compu {phys=raw}, range phys 0..255
          signal StatusCPDData2FBD_VR_CIRData98: start 336, 8 bit, little-endian, data-type-policy=OVERRIDE, base-type=uint8, compu {phys=raw}, range phys 0..255
          signal StatusCPDData2FBD_VR_CIRData99: start 344, 8 bit, little-endian, data-type-policy=OVERRIDE, base-type=uint8, compu {phys=raw}, range phys 0..255
          signal StatusCPDData2FBD_VR_CIRData100: start 352, 8 bit, little-endian, data-type-policy=OVERRIDE, base-type=uint8, compu {phys=raw}, range phys 0..255
          signal StatusCPDData2FBD_VR_CIRData101: start 360, 8 bit, little-endian, data-type-policy=OVERRIDE, base-type=uint8, compu {phys=raw}, range phys 0..255
          signal StatusCPDData2FBD_VR_CIRData102: start 368, 8 bit, little-endian, data-type-policy=OVERRIDE, base-type=uint8, compu {phys=raw}, range phys 0..255
          signal StatusCPDData2FBD_VR_CIRData103: start 376, 8 bit, little-endian, data-type-policy=OVERRIDE, base-type=uint8, compu {phys=raw}, range phys 0..255
          signal StatusCPDData2FBD_VR_CIRData104: start 384, 8 bit, little-endian, data-type-policy=OVERRIDE, base-type=uint8, compu {phys=raw}, range phys 0..255
          signal StatusCPDData2FBD_VR_CIRData105: start 392, 8 bit, little-endian, data-type-policy=OVERRIDE, base-type=uint8, compu {phys=raw}, range phys 0..255
          signal StatusCPDData2FBD_VR_CIRData106: start 400, 8 bit, little-endian, data-type-policy=OVERRIDE, base-type=uint8, compu {phys=raw}, range phys 0..255
          signal StatusCPDData2FBD_VR_CIRData107: start 408, 8 bit, little-endian, data-type-policy=OVERRIDE, base-type=uint8, compu {phys=raw}, range phys 0..255
          signal StatusCPDData2FBD_VR_CIRData108: start 416, 8 bit, little-endian, data-type-policy=OVERRIDE, base-type=uint8, compu {phys=raw}, range phys 0..255
          signal StatusCPDData2FBD_VR_CIRData109: start 424, 8 bit, little-endian, data-type-policy=OVERRIDE, base-type=uint8, compu {phys=raw}, range phys 0..255
          signal StatusCPDData2FBD_VR_CIRData110: start 432, 8 bit, little-endian, data-type-policy=OVERRIDE, base-type=uint8, compu {phys=raw}, range phys 0..255
          signal StatusCPDData2FBD_VR_CIRData111: start 440, 8 bit, little-endian, data-type-policy=OVERRIDE, base-type=uint8, compu {phys=raw}, range phys 0..255
          signal StatusCPDData2FBD_VR_CIRData112: start 448, 8 bit, little-endian, data-type-policy=OVERRIDE, base-type=uint8, compu {phys=raw}, range phys 0..255
          signal StatusCPDData2FBD_VR_CIRData113: start 456, 8 bit, little-endian, data-type-policy=OVERRIDE, base-type=uint8, compu {phys=raw}, range phys 0..255
          signal StatusCPDData2FBD_VR_CIRData114: start 464, 8 bit, little-endian, data-type-policy=OVERRIDE, base-type=uint8, compu {phys=raw}, range phys 0..255
          signal StatusCPDData2FBD_VR_CIRData115: start 472, 8 bit, little-endian, data-type-policy=OVERRIDE, base-type=uint8, compu {phys=raw}, range phys 0..255
          signal StatusCPDData2FBD_VR_CIRData116: start 480, 8 bit, little-endian, data-type-policy=OVERRIDE, base-type=uint8, compu {phys=raw}, range phys 0..255
          signal StatusCPDData2FBD_VR_CIRData117: start 488, 8 bit, little-endian, data-type-policy=OVERRIDE, base-type=uint8, compu {phys=raw}, range phys 0..255
          signal StatusCPDData2FBD_VR_CIRData118: start 496, 8 bit, little-endian, data-type-policy=OVERRIDE, base-type=uint8, compu {phys=raw}, range phys 0..255
          signal StatusCPDData2FBD_VR_CIRData119: start 504, 8 bit, little-endian, data-type-policy=OVERRIDE, base-type=uint8, compu {phys=raw}, range phys 0..255
      frame StatusCPDData3FBD_HL: id 0x164, frame-length=64, can-addressing-mode=STANDARD, can-frame-rx-behavior=CAN-FD, can-frame-tx-behavior=CAN-FD
        pdu StatusCPDData3FBD_HL: length=64, unused-bit-pattern=0
          signal StatusCPDData3FBD_HL_MsgCounter: start 0, 8 bit, little-endian, data-type-policy=OVERRIDE, base-type=uint8, compu {phys=raw}, range phys 0..252
          signal StatusCPDData3FBD_HL_LinkID: start 8, 8 bit, little-endian, data-type-policy=OVERRIDE, base-type=uint8, compu {phys=raw}, range phys 0..252
          signal StatusCPDData3FBD_HL_AGCValue: start 16, 8 bit, little-endian, data-type-policy=OVERRIDE, base-type=uint8, compu {phys=raw}, range phys 0..252
          signal StatusCPDData3FBD_HL_Channel: start 24, 8 bit, little-endian, data-type-policy=OVERRIDE, base-type=uint8, compu {phys=raw}, range phys 0..252
          signal StatusCPDData3FBD_HL_CIRData00: start 32, 8 bit, little-endian, data-type-policy=OVERRIDE, base-type=uint8, compu {phys=raw}, range phys 0..255
          signal StatusCPDData3FBD_HL_CIRData01: start 40, 8 bit, little-endian, data-type-policy=OVERRIDE, base-type=uint8, compu {phys=raw}, range phys 0..255
          signal StatusCPDData3FBD_HL_CIRData02: start 48, 8 bit, little-endian, data-type-policy=OVERRIDE, base-type=uint8, compu {phys=raw}, range phys 0..255
          signal StatusCPDData3FBD_HL_CIRData03: start 56, 8 bit, little-endian, data-type-policy=OVERRIDE, base-type=uint8, compu {phys=raw}, range phys 0..255
          signal StatusCPDData3FBD_HL_CIRData04: start 64, 8 bit, little-endian, data-type-policy=OVERRIDE, base-type=uint8, compu {phys=raw}, range phys 0..255
          signal StatusCPDData3FBD_HL_CIRData05: start 72, 8 bit, little-endian, data-type-policy=OVERRIDE, base-type=uint8, compu {phys=raw}, range phys 0..255
          signal StatusCPDData3FBD_HL_CIRData06: start 80, 8 bit, little-endian, data-type-policy=OVERRIDE, base-type=uint8, compu {phys=raw}, range phys 0..255
          signal StatusCPDData3FBD_HL_CIRData07: start 88, 8 bit, little-endian, data-type-policy=OVERRIDE, base-type=uint8, compu {phys=raw}, range phys 0..255
          signal StatusCPDData3FBD_HL_CIRData08: start 96, 8 bit, little-endian, data-type-policy=OVERRIDE, base-type=uint8, compu {phys=raw}, range phys 0..255
          signal StatusCPDData3FBD_HL_CIRData09: start 104, 8 bit, little-endian, data-type-policy=OVERRIDE, base-type=uint8, compu {phys=raw}, range phys 0..255
          signal StatusCPDData3FBD_HL_CIRData10: start 112, 8 bit, little-endian, data-type-policy=OVERRIDE, base-type=uint8, compu {phys=raw}, range phys 0..255
          signal StatusCPDData3FBD_HL_CIRData11: start 120, 8 bit, little-endian, data-type-policy=OVERRIDE, base-type=uint8, compu {phys=raw}, range phys 0..255
          signal StatusCPDData3FBD_HL_CIRData12: start 128, 8 bit, little-endian, data-type-policy=OVERRIDE, base-type=uint8, compu {phys=raw}, range phys 0..255
          signal StatusCPDData3FBD_HL_CIRData13: start 136, 8 bit, little-endian, data-type-policy=OVERRIDE, base-type=uint8, compu {phys=raw}, range phys 0..255
          signal StatusCPDData3FBD_HL_CIRData14: start 144, 8 bit, little-endian, data-type-policy=OVERRIDE, base-type=uint8, compu {phys=raw}, range phys 0..255
          signal StatusCPDData3FBD_HL_CIRData15: start 152, 8 bit, little-endian, data-type-policy=OVERRIDE, base-type=uint8, compu {phys=raw}, range phys 0..255
          signal StatusCPDData3FBD_HL_CIRData16: start 160, 8 bit, little-endian, data-type-policy=OVERRIDE, base-type=uint8, compu {phys=raw}, range phys 0..255
          signal StatusCPDData3FBD_HL_CIRData17: start 168, 8 bit, little-endian, data-type-policy=OVERRIDE, base-type=uint8, compu {phys=raw}, range phys 0..255
          signal StatusCPDData3FBD_HL_CIRData18: start 176, 8 bit, little-endian, data-type-policy=OVERRIDE, base-type=uint8, compu {phys=raw}, range phys 0..255
          signal StatusCPDData3FBD_HL_CIRData19: start 184, 8 bit, little-endian, data-type-policy=OVERRIDE, base-type=uint8, compu {phys=raw}, range phys 0..255
          signal StatusCPDData3FBD_HL_CIRData20: start 192, 8 bit, little-endian, data-type-policy=OVERRIDE, base-type=uint8, compu {phys=raw}, range phys 0..255
          signal StatusCPDData3FBD_HL_CIRData21: start 200, 8 bit, little-endian, data-type-policy=OVERRIDE, base-type=uint8, compu {phys=raw}, range phys 0..255
          signal StatusCPDData3FBD_HL_CIRData22: start 208, 8 bit, little-endian, data-type-policy=OVERRIDE, base-type=uint8, compu {phys=raw}, range phys 0..255
          signal StatusCPDData3FBD_HL_CIRData23: start 216, 8 bit, little-endian, data-type-policy=OVERRIDE, base-type=uint8, compu {phys=raw}, range phys 0..255
          signal StatusCPDData3FBD_HL_CIRData24: start 224, 8 bit, little-endian, data-type-policy=OVERRIDE, base-type=uint8, compu {phys=raw}, range phys 0..255
          signal StatusCPDData3FBD_HL_CIRData25: start 232, 8 bit, little-endian, data-type-policy=OVERRIDE, base-type=uint8, compu {phys=raw}, range phys 0..255
          signal StatusCPDData3FBD_HL_CIRData26: start 240, 8 bit, little-endian, data-type-policy=OVERRIDE, base-type=uint8, compu {phys=raw}, range phys 0..255
          signal StatusCPDData3FBD_HL_CIRData27: start 248, 8 bit, little-endian, data-type-policy=OVERRIDE, base-type=uint8, compu {phys=raw}, range phys 0..255
          signal StatusCPDData3FBD_HL_CIRData28: start 256, 8 bit, little-endian, data-type-policy=OVERRIDE, base-type=uint8, compu {phys=raw}, range phys 0..255
          signal StatusCPDData3FBD_HL_CIRData29: start 264, 8 bit, little-endian, data-type-policy=OVERRIDE, base-type=uint8, compu {phys=raw}, range phys 0..255
          signal StatusCPDData3FBD_HL_CIRData30: start 272, 8 bit, little-endian, data-type-policy=OVERRIDE, base-type=uint8, compu {phys=raw}, range phys 0..255
          signal StatusCPDData3FBD_HL_CIRData31: start 280, 8 bit, little-endian, data-type-policy=OVERRIDE, base-type=uint8, compu {phys=raw}, range phys 0..255
          signal StatusCPDData3FBD_HL_CIRData32: start 288, 8 bit, little-endian, data-type-policy=OVERRIDE, base-type=uint8, compu {phys=raw}, range phys 0..255
          signal StatusCPDData3FBD_HL_CIRData33: start 296, 8 bit, little-endian, data-type-policy=OVERRIDE, base-type=uint8, compu {phys=raw}, range phys 0..255
          signal StatusCPDData3FBD_HL_CIRData34: start 304, 8 bit, little-endian, data-type-policy=OVERRIDE, base-type=uint8, compu {phys=raw}, range phys 0..255
          signal StatusCPDData3FBD_HL_CIRData35: start 312, 8 bit, little-endian, data-type-policy=OVERRIDE, base-type=uint8, compu {phys=raw}, range phys 0..255
          signal StatusCPDData3FBD_HL_CIRData36: start 320, 8 bit, little-endian, data-type-policy=OVERRIDE, base-type=uint8, compu {phys=raw}, range phys 0..255
          signal StatusCPDData3FBD_HL_CIRData37: start 328, 8 bit, little-endian, data-type-policy=OVERRIDE, base-type=uint8, compu {phys=raw}, range phys 0..255
          signal StatusCPDData3FBD_HL_CIRData38: start 336, 8 bit, little-endian, data-type-policy=OVERRIDE, base-type=uint8, compu {phys=raw}, range phys 0..255
          signal StatusCPDData3FBD_HL_CIRData39: start 344, 8 bit, little-endian, data-type-policy=OVERRIDE, base-type=uint8, compu {phys=raw}, range phys 0..255
          signal StatusCPDData3FBD_HL_CIRData40: start 352, 8 bit, little-endian, data-type-policy=OVERRIDE, base-type=uint8, compu {phys=raw}, range phys 0..255
          signal StatusCPDData3FBD_HL_CIRData41: start 360, 8 bit, little-endian, data-type-policy=OVERRIDE, base-type=uint8, compu {phys=raw}, range phys 0..255
          signal StatusCPDData3FBD_HL_CIRData42: start 368, 8 bit, little-endian, data-type-policy=OVERRIDE, base-type=uint8, compu {phys=raw}, range phys 0..255
          signal StatusCPDData3FBD_HL_CIRData43: start 376, 8 bit, little-endian, data-type-policy=OVERRIDE, base-type=uint8, compu {phys=raw}, range phys 0..255
          signal StatusCPDData3FBD_HL_CIRData44: start 384, 8 bit, little-endian, data-type-policy=OVERRIDE, base-type=uint8, compu {phys=raw}, range phys 0..255
          signal StatusCPDData3FBD_HL_CIRData45: start 392, 8 bit, little-endian, data-type-policy=OVERRIDE, base-type=uint8, compu {phys=raw}, range phys 0..255
          signal StatusCPDData3FBD_HL_CIRData46: start 400, 8 bit, little-endian, data-type-policy=OVERRIDE, base-type=uint8, compu {phys=raw}, range phys 0..255
          signal StatusCPDData3FBD_HL_CIRData47: start 408, 8 bit, little-endian, data-type-policy=OVERRIDE, base-type=uint8, compu {phys=raw}, range phys 0..255
          signal StatusCPDData3FBD_HL_CIRData48: start 416, 8 bit, little-endian, data-type-policy=OVERRIDE, base-type=uint8, compu {phys=raw}, range phys 0..255
          signal StatusCPDData3FBD_HL_CIRData49: start 424, 8 bit, little-endian, data-type-policy=OVERRIDE, base-type=uint8, compu {phys=raw}, range phys 0..255
          signal StatusCPDData3FBD_HL_CIRData50: start 432, 8 bit, little-endian, data-type-policy=OVERRIDE, base-type=uint8, compu {phys=raw}, range phys 0..255
          signal StatusCPDData3FBD_HL_CIRData51: start 440, 8 bit, little-endian, data-type-policy=OVERRIDE, base-type=uint8, compu {phys=raw}, range phys 0..255
          signal StatusCPDData3FBD_HL_CIRData52: start 448, 8 bit, little-endian, data-type-policy=OVERRIDE, base-type=uint8, compu {phys=raw}, range phys 0..255
          signal StatusCPDData3FBD_HL_CIRData53: start 456, 8 bit, little-endian, data-type-policy=OVERRIDE, base-type=uint8, compu {phys=raw}, range phys 0..255
          signal StatusCPDData3FBD_HL_CIRData54: start 464, 8 bit, little-endian, data-type-policy=OVERRIDE, base-type=uint8, compu {phys=raw}, range phys 0..255
          signal StatusCPDData3FBD_HL_CIRData55: start 472, 8 bit, little-endian, data-type-policy=OVERRIDE, base-type=uint8, compu {phys=raw}, range phys 0..255
          signal StatusCPDData3FBD_HL_CIRData56: start 480, 8 bit, little-endian, data-type-policy=OVERRIDE, base-type=uint8, compu {phys=raw}, range phys 0..255
          signal StatusCPDData3FBD_HL_CIRData57: start 488, 8 bit, little-endian, data-type-policy=OVERRIDE, base-type=uint8, compu {phys=raw}, range phys 0..255
          signal StatusCPDData3FBD_HL_CIRData58: start 496, 8 bit, little-endian, data-type-policy=OVERRIDE, base-type=uint8, compu {phys=raw}, range phys 0..255
          signal StatusCPDData3FBD_HL_CIRData59: start 504, 8 bit, little-endian, data-type-policy=OVERRIDE, base-type=uint8, compu {phys=raw}, range phys 0..255
      frame StatusCPDData3FBD_HM: id 0x15F, frame-length=64, can-addressing-mode=STANDARD, can-frame-rx-behavior=CAN-FD, can-frame-tx-behavior=CAN-FD
        pdu StatusCPDData3FBD_HM: length=64, unused-bit-pattern=0
          signal StatusCPDData3FBD_HM_MsgCounter: start 0, 8 bit, little-endian, data-type-policy=OVERRIDE, base-type=uint8, compu {phys=raw}, range phys 0..252
          signal StatusCPDData3FBD_HM_LinkID: start 8, 8 bit, little-endian, data-type-policy=OVERRIDE, base-type=uint8, compu {phys=raw}, range phys 0..252
          signal StatusCPDData3FBD_HM_AGCValue: start 16, 8 bit, little-endian, data-type-policy=OVERRIDE, base-type=uint8, compu {phys=raw}, range phys 0..252
          signal StatusCPDData3FBD_HM_Channel: start 24, 8 bit, little-endian, data-type-policy=OVERRIDE, base-type=uint8, compu {phys=raw}, range phys 0..252
          signal StatusCPDData3FBD_HM_CIRData00: start 32, 8 bit, little-endian, data-type-policy=OVERRIDE, base-type=uint8, compu {phys=raw}, range phys 0..255
          signal StatusCPDData3FBD_HM_CIRData01: start 40, 8 bit, little-endian, data-type-policy=OVERRIDE, base-type=uint8, compu {phys=raw}, range phys 0..255
          signal StatusCPDData3FBD_HM_CIRData02: start 48, 8 bit, little-endian, data-type-policy=OVERRIDE, base-type=uint8, compu {phys=raw}, range phys 0..255
          signal StatusCPDData3FBD_HM_CIRData03: start 56, 8 bit, little-endian, data-type-policy=OVERRIDE, base-type=uint8, compu {phys=raw}, range phys 0..255
          signal StatusCPDData3FBD_HM_CIRData04: start 64, 8 bit, little-endian, data-type-policy=OVERRIDE, base-type=uint8, compu {phys=raw}, range phys 0..255
          signal StatusCPDData3FBD_HM_CIRData05: start 72, 8 bit, little-endian, data-type-policy=OVERRIDE, base-type=uint8, compu {phys=raw}, range phys 0..255
          signal StatusCPDData3FBD_HM_CIRData06: start 80, 8 bit, little-endian, data-type-policy=OVERRIDE, base-type=uint8, compu {phys=raw}, range phys 0..255
          signal StatusCPDData3FBD_HM_CIRData07: start 88, 8 bit, little-endian, data-type-policy=OVERRIDE, base-type=uint8, compu {phys=raw}, range phys 0..255
          signal StatusCPDData3FBD_HM_CIRData08: start 96, 8 bit, little-endian, data-type-policy=OVERRIDE, base-type=uint8, compu {phys=raw}, range phys 0..255
          signal StatusCPDData3FBD_HM_CIRData09: start 104, 8 bit, little-endian, data-type-policy=OVERRIDE, base-type=uint8, compu {phys=raw}, range phys 0..255
          signal StatusCPDData3FBD_HM_CIRData10: start 112, 8 bit, little-endian, data-type-policy=OVERRIDE, base-type=uint8, compu {phys=raw}, range phys 0..255
          signal StatusCPDData3FBD_HM_CIRData11: start 120, 8 bit, little-endian, data-type-policy=OVERRIDE, base-type=uint8, compu {phys=raw}, range phys 0..255
          signal StatusCPDData3FBD_HM_CIRData12: start 128, 8 bit, little-endian, data-type-policy=OVERRIDE, base-type=uint8, compu {phys=raw}, range phys 0..255
          signal StatusCPDData3FBD_HM_CIRData13: start 136, 8 bit, little-endian, data-type-policy=OVERRIDE, base-type=uint8, compu {phys=raw}, range phys 0..255
          signal StatusCPDData3FBD_HM_CIRData14: start 144, 8 bit, little-endian, data-type-policy=OVERRIDE, base-type=uint8, compu {phys=raw}, range phys 0..255
          signal StatusCPDData3FBD_HM_CIRData15: start 152, 8 bit, little-endian, data-type-policy=OVERRIDE, base-type=uint8, compu {phys=raw}, range phys 0..255
          signal StatusCPDData3FBD_HM_CIRData16: start 160, 8 bit, little-endian, data-type-policy=OVERRIDE, base-type=uint8, compu {phys=raw}, range phys 0..255
          signal StatusCPDData3FBD_HM_CIRData17: start 168, 8 bit, little-endian, data-type-policy=OVERRIDE, base-type=uint8, compu {phys=raw}, range phys 0..255
          signal StatusCPDData3FBD_HM_CIRData18: start 176, 8 bit, little-endian, data-type-policy=OVERRIDE, base-type=uint8, compu {phys=raw}, range phys 0..255
          signal StatusCPDData3FBD_HM_CIRData19: start 184, 8 bit, little-endian, data-type-policy=OVERRIDE, base-type=uint8, compu {phys=raw}, range phys 0..255
          signal StatusCPDData3FBD_HM_CIRData20: start 192, 8 bit, little-endian, data-type-policy=OVERRIDE, base-type=uint8, compu {phys=raw}, range phys 0..255
          signal StatusCPDData3FBD_HM_CIRData21: start 200, 8 bit, little-endian, data-type-policy=OVERRIDE, base-type=uint8, compu {phys=raw}, range phys 0..255
          signal StatusCPDData3FBD_HM_CIRData22: start 208, 8 bit, little-endian, data-type-policy=OVERRIDE, base-type=uint8, compu {phys=raw}, range phys 0..255
          signal StatusCPDData3FBD_HM_CIRData23: start 216, 8 bit, little-endian, data-type-policy=OVERRIDE, base-type=uint8, compu {phys=raw}, range phys 0..255
          signal StatusCPDData3FBD_HM_CIRData24: start 224, 8 bit, little-endian, data-type-policy=OVERRIDE, base-type=uint8, compu {phys=raw}, range phys 0..255
          signal StatusCPDData3FBD_HM_CIRData25: start 232, 8 bit, little-endian, data-type-policy=OVERRIDE, base-type=uint8, compu {phys=raw}, range phys 0..255
          signal StatusCPDData3FBD_HM_CIRData26: start 240, 8 bit, little-endian, data-type-policy=OVERRIDE, base-type=uint8, compu {phys=raw}, range phys 0..255
          signal StatusCPDData3FBD_HM_CIRData27: start 248, 8 bit, little-endian, data-type-policy=OVERRIDE, base-type=uint8, compu {phys=raw}, range phys 0..255
          signal StatusCPDData3FBD_HM_CIRData28: start 256, 8 bit, little-endian, data-type-policy=OVERRIDE, base-type=uint8, compu {phys=raw}, range phys 0..255
          signal StatusCPDData3FBD_HM_CIRData29: start 264, 8 bit, little-endian, data-type-policy=OVERRIDE, base-type=uint8, compu {phys=raw}, range phys 0..255
          signal StatusCPDData3FBD_HM_CIRData30: start 272, 8 bit, little-endian, data-type-policy=OVERRIDE, base-type=uint8, compu {phys=raw}, range phys 0..255
          signal StatusCPDData3FBD_HM_CIRData31: start 280, 8 bit, little-endian, data-type-policy=OVERRIDE, base-type=uint8, compu {phys=raw}, range phys 0..255
          signal StatusCPDData3FBD_HM_CIRData32: start 288, 8 bit, little-endian, data-type-policy=OVERRIDE, base-type=uint8, compu {phys=raw}, range phys 0..255
          signal StatusCPDData3FBD_HM_CIRData33: start 296, 8 bit, little-endian, data-type-policy=OVERRIDE, base-type=uint8, compu {phys=raw}, range phys 0..255
          signal StatusCPDData3FBD_HM_CIRData34: start 304, 8 bit, little-endian, data-type-policy=OVERRIDE, base-type=uint8, compu {phys=raw}, range phys 0..255
          signal StatusCPDData3FBD_HM_CIRData35: start 312, 8 bit, little-endian, data-type-policy=OVERRIDE, base-type=uint8, compu {phys=raw}, range phys 0..255
          signal StatusCPDData3FBD_HM_CIRData36: start 320, 8 bit, little-endian, data-type-policy=OVERRIDE, base-type=uint8, compu {phys=raw}, range phys 0..255
          signal StatusCPDData3FBD_HM_CIRData37: start 328, 8 bit, little-endian, data-type-policy=OVERRIDE, base-type=uint8, compu {phys=raw}, range phys 0..255
          signal StatusCPDData3FBD_HM_CIRData38: start 336, 8 bit, little-endian, data-type-policy=OVERRIDE, base-type=uint8, compu {phys=raw}, range phys 0..255
          signal StatusCPDData3FBD_HM_CIRData39: start 344, 8 bit, little-endian, data-type-policy=OVERRIDE, base-type=uint8, compu {phys=raw}, range phys 0..255
          signal StatusCPDData3FBD_HM_CIRData40: start 352, 8 bit, little-endian, data-type-policy=OVERRIDE, base-type=uint8, compu {phys=raw}, range phys 0..255
          signal StatusCPDData3FBD_HM_CIRData41: start 360, 8 bit, little-endian, data-type-policy=OVERRIDE, base-type=uint8, compu {phys=raw}, range phys 0..255
          signal StatusCPDData3FBD_HM_CIRData42: start 368, 8 bit, little-endian, data-type-policy=OVERRIDE, base-type=uint8, compu {phys=raw}, range phys 0..255
          signal StatusCPDData3FBD_HM_CIRData43: start 376, 8 bit, little-endian, data-type-policy=OVERRIDE, base-type=uint8, compu {phys=raw}, range phys 0..255
          signal StatusCPDData3FBD_HM_CIRData44: start 384, 8 bit, little-endian, data-type-policy=OVERRIDE, base-type=uint8, compu {phys=raw}, range phys 0..255
          signal StatusCPDData3FBD_HM_CIRData45: start 392, 8 bit, little-endian, data-type-policy=OVERRIDE, base-type=uint8, compu {phys=raw}, range phys 0..255
          signal StatusCPDData3FBD_HM_CIRData46: start 400, 8 bit, little-endian, data-type-policy=OVERRIDE, base-type=uint8, compu {phys=raw}, range phys 0..255
          signal StatusCPDData3FBD_HM_CIRData47: start 408, 8 bit, little-endian, data-type-policy=OVERRIDE, base-type=uint8, compu {phys=raw}, range phys 0..255
          signal StatusCPDData3FBD_HM_CIRData48: start 416, 8 bit, little-endian, data-type-policy=OVERRIDE, base-type=uint8, compu {phys=raw}, range phys 0..255
          signal StatusCPDData3FBD_HM_CIRData49: start 424, 8 bit, little-endian, data-type-policy=OVERRIDE, base-type=uint8, compu {phys=raw}, range phys 0..255
          signal StatusCPDData3FBD_HM_CIRData50: start 432, 8 bit, little-endian, data-type-policy=OVERRIDE, base-type=uint8, compu {phys=raw}, range phys 0..255
          signal StatusCPDData3FBD_HM_CIRData51: start 440, 8 bit, little-endian, data-type-policy=OVERRIDE, base-type=uint8, compu {phys=raw}, range phys 0..255
          signal StatusCPDData3FBD_HM_CIRData52: start 448, 8 bit, little-endian, data-type-policy=OVERRIDE, base-type=uint8, compu {phys=raw}, range phys 0..255
          signal StatusCPDData3FBD_HM_CIRData53: start 456, 8 bit, little-endian, data-type-policy=OVERRIDE, base-type=uint8, compu {phys=raw}, range phys 0..255
          signal StatusCPDData3FBD_HM_CIRData54: start 464, 8 bit, little-endian, data-type-policy=OVERRIDE, base-type=uint8, compu {phys=raw}, range phys 0..255
          signal StatusCPDData3FBD_HM_CIRData55: start 472, 8 bit, little-endian, data-type-policy=OVERRIDE, base-type=uint8, compu {phys=raw}, range phys 0..255
          signal StatusCPDData3FBD_HM_CIRData56: start 480, 8 bit, little-endian, data-type-policy=OVERRIDE, base-type=uint8, compu {phys=raw}, range phys 0..255
          signal StatusCPDData3FBD_HM_CIRData57: start 488, 8 bit, little-endian, data-type-policy=OVERRIDE, base-type=uint8, compu {phys=raw}, range phys 0..255
          signal StatusCPDData3FBD_HM_CIRData58: start 496, 8 bit, little-endian, data-type-policy=OVERRIDE, base-type=uint8, compu {phys=raw}, range phys 0..255
          signal StatusCPDData3FBD_HM_CIRData59: start 504, 8 bit, little-endian, data-type-policy=OVERRIDE, base-type=uint8, compu {phys=raw}, range phys 0..255
      frame StatusCPDData3FBD_HR: id 0x165, frame-length=64, can-addressing-mode=STANDARD, can-frame-rx-behavior=CAN-FD, can-frame-tx-behavior=CAN-FD
        pdu StatusCPDData3FBD_HR: length=64, unused-bit-pattern=0
          signal StatusCPDData3FBD_HR_MsgCounter: start 0, 8 bit, little-endian, data-type-policy=OVERRIDE, base-type=uint8, compu {phys=raw}, range phys 0..252
          signal StatusCPDData3FBD_HR_LinkID: start 8, 8 bit, little-endian, data-type-policy=OVERRIDE, base-type=uint8, compu {phys=raw}, range phys 0..252
          signal StatusCPDData3FBD_HR_AGCValue: start 16, 8 bit, little-endian, data-type-policy=OVERRIDE, base-type=uint8, compu {phys=raw}, range phys 0..252
          signal StatusCPDData3FBD_HR_Channel: start 24, 8 bit, little-endian, data-type-policy=OVERRIDE, base-type=uint8, compu {phys=raw}, range phys 0..252
          signal StatusCPDData3FBD_HR_CIRData00: start 32, 8 bit, little-endian, data-type-policy=OVERRIDE, base-type=uint8, compu {phys=raw}, range phys 0..255
          signal StatusCPDData3FBD_HR_CIRData01: start 40, 8 bit, little-endian, data-type-policy=OVERRIDE, base-type=uint8, compu {phys=raw}, range phys 0..255
          signal StatusCPDData3FBD_HR_CIRData02: start 48, 8 bit, little-endian, data-type-policy=OVERRIDE, base-type=uint8, compu {phys=raw}, range phys 0..255
          signal StatusCPDData3FBD_HR_CIRData03: start 56, 8 bit, little-endian, data-type-policy=OVERRIDE, base-type=uint8, compu {phys=raw}, range phys 0..255
          signal StatusCPDData3FBD_HR_CIRData04: start 64, 8 bit, little-endian, data-type-policy=OVERRIDE, base-type=uint8, compu {phys=raw}, range phys 0..255
          signal StatusCPDData3FBD_HR_CIRData05: start 72, 8 bit, little-endian, data-type-policy=OVERRIDE, base-type=uint8, compu {phys=raw}, range phys 0..255
          signal StatusCPDData3FBD_HR_CIRData06: start 80, 8 bit, little-endian, data-type-policy=OVERRIDE, base-type=uint8, compu {phys=raw}, range phys 0..255
          signal StatusCPDData3FBD_HR_CIRData07: start 88, 8 bit, little-endian, data-type-policy=OVERRIDE, base-type=uint8, compu {phys=raw}, range phys 0..255
          signal StatusCPDData3FBD_HR_CIRData08: start 96, 8 bit, little-endian, data-type-policy=OVERRIDE, base-type=uint8, compu {phys=raw}, range phys 0..255
          signal StatusCPDData3FBD_HR_CIRData09: start 104, 8 bit, little-endian, data-type-policy=OVERRIDE, base-type=uint8, compu {phys=raw}, range phys 0..255
          signal StatusCPDData3FBD_HR_CIRData10: start 112, 8 bit, little-endian, data-type-policy=OVERRIDE, base-type=uint8, compu {phys=raw}, range phys 0..255
          signal StatusCPDData3FBD_HR_CIRData11: start 120, 8 bit, little-endian, data-type-policy=OVERRIDE, base-type=uint8, compu {phys=raw}, range phys 0..255
          signal StatusCPDData3FBD_HR_CIRData12: start 128, 8 bit, little-endian, data-type-policy=OVERRIDE, base-type=uint8, compu {phys=raw}, range phys 0..255
          signal StatusCPDData3FBD_HR_CIRData13: start 136, 8 bit, little-endian, data-type-policy=OVERRIDE, base-type=uint8, compu {phys=raw}, range phys 0..255
          signal StatusCPDData3FBD_HR_CIRData14: start 144, 8 bit, little-endian, data-type-policy=OVERRIDE, base-type=uint8, compu {phys=raw}, range phys 0..255
          signal StatusCPDData3FBD_HR_CIRData15: start 152, 8 bit, little-endian, data-type-policy=OVERRIDE, base-type=uint8, compu {phys=raw}, range phys 0..255
          signal StatusCPDData3FBD_HR_CIRData16: start 160, 8 bit, little-endian, data-type-policy=OVERRIDE, base-type=uint8, compu {phys=raw}, range phys 0..255
          signal StatusCPDData3FBD_HR_CIRData17: start 168, 8 bit, little-endian, data-type-policy=OVERRIDE, base-type=uint8, compu {phys=raw}, range phys 0..255
          signal StatusCPDData3FBD_HR_CIRData18: start 176, 8 bit, little-endian, data-type-policy=OVERRIDE, base-type=uint8, compu {phys=raw}, range phys 0..255
          signal StatusCPDData3FBD_HR_CIRData19: start 184, 8 bit, little-endian, data-type-policy=OVERRIDE, base-type=uint8, compu {phys=raw}, range phys 0..255
          signal StatusCPDData3FBD_HR_CIRData20: start 192, 8 bit, little-endian, data-type-policy=OVERRIDE, base-type=uint8, compu {phys=raw}, range phys 0..255
          signal StatusCPDData3FBD_HR_CIRData21: start 200, 8 bit, little-endian, data-type-policy=OVERRIDE, base-type=uint8, compu {phys=raw}, range phys 0..255
          signal StatusCPDData3FBD_HR_CIRData22: start 208, 8 bit, little-endian, data-type-policy=OVERRIDE, base-type=uint8, compu {phys=raw}, range phys 0..255
          signal StatusCPDData3FBD_HR_CIRData23: start 216, 8 bit, little-endian, data-type-policy=OVERRIDE, base-type=uint8, compu {phys=raw}, range phys 0..255
          signal StatusCPDData3FBD_HR_CIRData24: start 224, 8 bit, little-endian, data-type-policy=OVERRIDE, base-type=uint8, compu {phys=raw}, range phys 0..255
          signal StatusCPDData3FBD_HR_CIRData25: start 232, 8 bit, little-endian, data-type-policy=OVERRIDE, base-type=uint8, compu {phys=raw}, range phys 0..255
          signal StatusCPDData3FBD_HR_CIRData26: start 240, 8 bit, little-endian, data-type-policy=OVERRIDE, base-type=uint8, compu {phys=raw}, range phys 0..255
          signal StatusCPDData3FBD_HR_CIRData27: start 248, 8 bit, little-endian, data-type-policy=OVERRIDE, base-type=uint8, compu {phys=raw}, range phys 0..255
          signal StatusCPDData3FBD_HR_CIRData28: start 256, 8 bit, little-endian, data-type-policy=OVERRIDE, base-type=uint8, compu {phys=raw}, range phys 0..255
          signal StatusCPDData3FBD_HR_CIRData29: start 264, 8 bit, little-endian, data-type-policy=OVERRIDE, base-type=uint8, compu {phys=raw}, range phys 0..255
          signal StatusCPDData3FBD_HR_CIRData30: start 272, 8 bit, little-endian, data-type-policy=OVERRIDE, base-type=uint8, compu {phys=raw}, range phys 0..255
          signal StatusCPDData3FBD_HR_CIRData31: start 280, 8 bit, little-endian, data-type-policy=OVERRIDE, base-type=uint8, compu {phys=raw}, range phys 0..255
          signal StatusCPDData3FBD_HR_CIRData32: start 288, 8 bit, little-endian, data-type-policy=OVERRIDE, base-type=uint8, compu {phys=raw}, range phys 0..255
          signal StatusCPDData3FBD_HR_CIRData33: start 296, 8 bit, little-endian, data-type-policy=OVERRIDE, base-type=uint8, compu {phys=raw}, range phys 0..255
          signal StatusCPDData3FBD_HR_CIRData34: start 304, 8 bit, little-endian, data-type-policy=OVERRIDE, base-type=uint8, compu {phys=raw}, range phys 0..255
          signal StatusCPDData3FBD_HR_CIRData35: start 312, 8 bit, little-endian, data-type-policy=OVERRIDE, base-type=uint8, compu {phys=raw}, range phys 0..255
          signal StatusCPDData3FBD_HR_CIRData36: start 320, 8 bit, little-endian, data-type-policy=OVERRIDE, base-type=uint8, compu {phys=raw}, range phys 0..255
          signal StatusCPDData3FBD_HR_CIRData37: start 328, 8 bit, little-endian, data-type-policy=OVERRIDE, base-type=uint8, compu {phys=raw}, range phys 0..255
          signal StatusCPDData3FBD_HR_CIRData38: start 336, 8 bit, little-endian, data-type-policy=OVERRIDE, base-type=uint8, compu {phys=raw}, range phys 0..255
          signal StatusCPDData3FBD_HR_CIRData39: start 344, 8 bit, little-endian, data-type-policy=OVERRIDE, base-type=uint8, compu {phys=raw}, range phys 0..255
          signal StatusCPDData3FBD_HR_CIRData40: start 352, 8 bit, little-endian, data-type-policy=OVERRIDE, base-type=uint8, compu {phys=raw}, range phys 0..255
          signal StatusCPDData3FBD_HR_CIRData41: start 360, 8 bit, little-endian, data-type-policy=OVERRIDE, base-type=uint8, compu {phys=raw}, range phys 0..255
          signal StatusCPDData3FBD_HR_CIRData42: start 368, 8 bit, little-endian, data-type-policy=OVERRIDE, base-type=uint8, compu {phys=raw}, range phys 0..255
          signal StatusCPDData3FBD_HR_CIRData43: start 376, 8 bit, little-endian, data-type-policy=OVERRIDE, base-type=uint8, compu {phys=raw}, range phys 0..255
          signal StatusCPDData3FBD_HR_CIRData44: start 384, 8 bit, little-endian, data-type-policy=OVERRIDE, base-type=uint8, compu {phys=raw}, range phys 0..255
          signal StatusCPDData3FBD_HR_CIRData45: start 392, 8 bit, little-endian, data-type-policy=OVERRIDE, base-type=uint8, compu {phys=raw}, range phys 0..255
          signal StatusCPDData3FBD_HR_CIRData46: start 400, 8 bit, little-endian, data-type-policy=OVERRIDE, base-type=uint8, compu {phys=raw}, range phys 0..255
          signal StatusCPDData3FBD_HR_CIRData47: start 408, 8 bit, little-endian, data-type-policy=OVERRIDE, base-type=uint8, compu {phys=raw}, range phys 0..255
          signal StatusCPDData3FBD_HR_CIRData48: start 416, 8 bit, little-endian, data-type-policy=OVERRIDE, base-type=uint8, compu {phys=raw}, range phys 0..255
          signal StatusCPDData3FBD_HR_CIRData49: start 424, 8 bit, little-endian, data-type-policy=OVERRIDE, base-type=uint8, compu {phys=raw}, range phys 0..255
          signal StatusCPDData3FBD_HR_CIRData50: start 432, 8 bit, little-endian, data-type-policy=OVERRIDE, base-type=uint8, compu {phys=raw}, range phys 0..255
          signal StatusCPDData3FBD_HR_CIRData51: start 440, 8 bit, little-endian, data-type-policy=OVERRIDE, base-type=uint8, compu {phys=raw}, range phys 0..255
          signal StatusCPDData3FBD_HR_CIRData52: start 448, 8 bit, little-endian, data-type-policy=OVERRIDE, base-type=uint8, compu {phys=raw}, range phys 0..255
          signal StatusCPDData3FBD_HR_CIRData53: start 456, 8 bit, little-endian, data-type-policy=OVERRIDE, base-type=uint8, compu {phys=raw}, range phys 0..255
          signal StatusCPDData3FBD_HR_CIRData54: start 464, 8 bit, little-endian, data-type-policy=OVERRIDE, base-type=uint8, compu {phys=raw}, range phys 0..255
          signal StatusCPDData3FBD_HR_CIRData55: start 472, 8 bit, little-endian, data-type-policy=OVERRIDE, base-type=uint8, compu {phys=raw}, range phys 0..255
          signal StatusCPDData3FBD_HR_CIRData56: start 480, 8 bit, little-endian, data-type-policy=OVERRIDE, base-type=uint8, compu {phys=raw}, range phys 0..255
          signal StatusCPDData3FBD_HR_CIRData57: start 488, 8 bit, little-endian, data-type-policy=OVERRIDE, base-type=uint8, compu {phys=raw}, range phys 0..255
          signal StatusCPDData3FBD_HR_CIRData58: start 496, 8 bit, little-endian, data-type-policy=OVERRIDE, base-type=uint8, compu {phys=raw}, range phys 0..255
          signal StatusCPDData3FBD_HR_CIRData59: start 504, 8 bit, little-endian, data-type-policy=OVERRIDE, base-type=uint8, compu {phys=raw}, range phys 0..255
      frame StatusCPDData3FBD_Miko: id 0x160, frame-length=64, can-addressing-mode=STANDARD, can-frame-rx-behavior=CAN-FD, can-frame-tx-behavior=CAN-FD
        pdu StatusCPDData3FBD_Miko: length=64, unused-bit-pattern=0
          signal StatusCPDData3FBD_Miko_MsgCounter: start 0, 8 bit, little-endian, data-type-policy=OVERRIDE, base-type=uint8, compu {phys=raw}, range phys 0..252
          signal StatusCPDData3FBD_Miko_LinkID: start 8, 8 bit, little-endian, data-type-policy=OVERRIDE, base-type=uint8, compu {phys=raw}, range phys 0..252
          signal StatusCPDData3FBD_Miko_AGCValue: start 16, 8 bit, little-endian, data-type-policy=OVERRIDE, base-type=uint8, compu {phys=raw}, range phys 0..252
          signal StatusCPDData3FBD_Miko_Channel: start 24, 8 bit, little-endian, data-type-policy=OVERRIDE, base-type=uint8, compu {phys=raw}, range phys 0..252
          signal StatusCPDData3FBD_Miko_CIRData00: start 32, 8 bit, little-endian, data-type-policy=OVERRIDE, base-type=uint8, compu {phys=raw}, range phys 0..255
          signal StatusCPDData3FBD_Miko_CIRData01: start 40, 8 bit, little-endian, data-type-policy=OVERRIDE, base-type=uint8, compu {phys=raw}, range phys 0..255
          signal StatusCPDData3FBD_Miko_CIRData02: start 48, 8 bit, little-endian, data-type-policy=OVERRIDE, base-type=uint8, compu {phys=raw}, range phys 0..255
          signal StatusCPDData3FBD_Miko_CIRData03: start 56, 8 bit, little-endian, data-type-policy=OVERRIDE, base-type=uint8, compu {phys=raw}, range phys 0..255
          signal StatusCPDData3FBD_Miko_CIRData04: start 64, 8 bit, little-endian, data-type-policy=OVERRIDE, base-type=uint8, compu {phys=raw}, range phys 0..255
          signal StatusCPDData3FBD_Miko_CIRData05: start 72, 8 bit, little-endian, data-type-policy=OVERRIDE, base-type=uint8, compu {phys=raw}, range phys 0..255
          signal StatusCPDData3FBD_Miko_CIRData06: start 80, 8 bit, little-endian, data-type-policy=OVERRIDE, base-type=uint8, compu {phys=raw}, range phys 0..255
          signal StatusCPDData3FBD_Miko_CIRData07: start 88, 8 bit, little-endian, data-type-policy=OVERRIDE, base-type=uint8, compu {phys=raw}, range phys 0..255
          signal StatusCPDData3FBD_Miko_CIRData08: start 96, 8 bit, little-endian, data-type-policy=OVERRIDE, base-type=uint8, compu {phys=raw}, range phys 0..255
          signal StatusCPDData3FBD_Miko_CIRData09: start 104, 8 bit, little-endian, data-type-policy=OVERRIDE, base-type=uint8, compu {phys=raw}, range phys 0..255
          signal StatusCPDData3FBD_Miko_CIRData10: start 112, 8 bit, little-endian, data-type-policy=OVERRIDE, base-type=uint8, compu {phys=raw}, range phys 0..255
          signal StatusCPDData3FBD_Miko_CIRData11: start 120, 8 bit, little-endian, data-type-policy=OVERRIDE, base-type=uint8, compu {phys=raw}, range phys 0..255
          signal StatusCPDData3FBD_Miko_CIRData12: start 128, 8 bit, little-endian, data-type-policy=OVERRIDE, base-type=uint8, compu {phys=raw}, range phys 0..255
          signal StatusCPDData3FBD_Miko_CIRData13: start 136, 8 bit, little-endian, data-type-policy=OVERRIDE, base-type=uint8, compu {phys=raw}, range phys 0..255
          signal StatusCPDData3FBD_Miko_CIRData14: start 144, 8 bit, little-endian, data-type-policy=OVERRIDE, base-type=uint8, compu {phys=raw}, range phys 0..255
          signal StatusCPDData3FBD_Miko_CIRData15: start 152, 8 bit, little-endian, data-type-policy=OVERRIDE, base-type=uint8, compu {phys=raw}, range phys 0..255
          signal StatusCPDData3FBD_Miko_CIRData16: start 160, 8 bit, little-endian, data-type-policy=OVERRIDE, base-type=uint8, compu {phys=raw}, range phys 0..255
          signal StatusCPDData3FBD_Miko_CIRData17: start 168, 8 bit, little-endian, data-type-policy=OVERRIDE, base-type=uint8, compu {phys=raw}, range phys 0..255
          signal StatusCPDData3FBD_Miko_CIRData18: start 176, 8 bit, little-endian, data-type-policy=OVERRIDE, base-type=uint8, compu {phys=raw}, range phys 0..255
          signal StatusCPDData3FBD_Miko_CIRData19: start 184, 8 bit, little-endian, data-type-policy=OVERRIDE, base-type=uint8, compu {phys=raw}, range phys 0..255
          signal StatusCPDData3FBD_Miko_CIRData20: start 192, 8 bit, little-endian, data-type-policy=OVERRIDE, base-type=uint8, compu {phys=raw}, range phys 0..255
          signal StatusCPDData3FBD_Miko_CIRData21: start 200, 8 bit, little-endian, data-type-policy=OVERRIDE, base-type=uint8, compu {phys=raw}, range phys 0..255
          signal StatusCPDData3FBD_Miko_CIRData22: start 208, 8 bit, little-endian, data-type-policy=OVERRIDE, base-type=uint8, compu {phys=raw}, range phys 0..255
          signal StatusCPDData3FBD_Miko_CIRData23: start 216, 8 bit, little-endian, data-type-policy=OVERRIDE, base-type=uint8, compu {phys=raw}, range phys 0..255
          signal StatusCPDData3FBD_Miko_CIRData24: start 224, 8 bit, little-endian, data-type-policy=OVERRIDE, base-type=uint8, compu {phys=raw}, range phys 0..255
          signal StatusCPDData3FBD_Miko_CIRData25: start 232, 8 bit, little-endian, data-type-policy=OVERRIDE, base-type=uint8, compu {phys=raw}, range phys 0..255
          signal StatusCPDData3FBD_Miko_CIRData26: start 240, 8 bit, little-endian, data-type-policy=OVERRIDE, base-type=uint8, compu {phys=raw}, range phys 0..255
          signal StatusCPDData3FBD_Miko_CIRData27: start 248, 8 bit, little-endian, data-type-policy=OVERRIDE, base-type=uint8, compu {phys=raw}, range phys 0..255
          signal StatusCPDData3FBD_Miko_CIRData28: start 256, 8 bit, little-endian, data-type-policy=OVERRIDE, base-type=uint8, compu {phys=raw}, range phys 0..255
          signal StatusCPDData3FBD_Miko_CIRData29: start 264, 8 bit, little-endian, data-type-policy=OVERRIDE, base-type=uint8, compu {phys=raw}, range phys 0..255
          signal StatusCPDData3FBD_Miko_CIRData30: start 272, 8 bit, little-endian, data-type-policy=OVERRIDE, base-type=uint8, compu {phys=raw}, range phys 0..255
          signal StatusCPDData3FBD_Miko_CIRData31: start 280, 8 bit, little-endian, data-type-policy=OVERRIDE, base-type=uint8, compu {phys=raw}, range phys 0..255
          signal StatusCPDData3FBD_Miko_CIRData32: start 288, 8 bit, little-endian, data-type-policy=OVERRIDE, base-type=uint8, compu {phys=raw}, range phys 0..255
          signal StatusCPDData3FBD_Miko_CIRData33: start 296, 8 bit, little-endian, data-type-policy=OVERRIDE, base-type=uint8, compu {phys=raw}, range phys 0..255
          signal StatusCPDData3FBD_Miko_CIRData34: start 304, 8 bit, little-endian, data-type-policy=OVERRIDE, base-type=uint8, compu {phys=raw}, range phys 0..255
          signal StatusCPDData3FBD_Miko_CIRData35: start 312, 8 bit, little-endian, data-type-policy=OVERRIDE, base-type=uint8, compu {phys=raw}, range phys 0..255
          signal StatusCPDData3FBD_Miko_CIRData36: start 320, 8 bit, little-endian, data-type-policy=OVERRIDE, base-type=uint8, compu {phys=raw}, range phys 0..255
          signal StatusCPDData3FBD_Miko_CIRData37: start 328, 8 bit, little-endian, data-type-policy=OVERRIDE, base-type=uint8, compu {phys=raw}, range phys 0..255
          signal StatusCPDData3FBD_Miko_CIRData38: start 336, 8 bit, little-endian, data-type-policy=OVERRIDE, base-type=uint8, compu {phys=raw}, range phys 0..255
          signal StatusCPDData3FBD_Miko_CIRData39: start 344, 8 bit, little-endian, data-type-policy=OVERRIDE, base-type=uint8, compu {phys=raw}, range phys 0..255
          signal StatusCPDData3FBD_Miko_CIRData40: start 352, 8 bit, little-endian, data-type-policy=OVERRIDE, base-type=uint8, compu {phys=raw}, range phys 0..255
          signal StatusCPDData3FBD_Miko_CIRData41: start 360, 8 bit, little-endian, data-type-policy=OVERRIDE, base-type=uint8, compu {phys=raw}, range phys 0..255
          signal StatusCPDData3FBD_Miko_CIRData42: start 368, 8 bit, little-endian, data-type-policy=OVERRIDE, base-type=uint8, compu {phys=raw}, range phys 0..255
          signal StatusCPDData3FBD_Miko_CIRData43: start 376, 8 bit, little-endian, data-type-policy=OVERRIDE, base-type=uint8, compu {phys=raw}, range phys 0..255
          signal StatusCPDData3FBD_Miko_CIRData44: start 384, 8 bit, little-endian, data-type-policy=OVERRIDE, base-type=uint8, compu {phys=raw}, range phys 0..255
          signal StatusCPDData3FBD_Miko_CIRData45: start 392, 8 bit, little-endian, data-type-policy=OVERRIDE, base-type=uint8, compu {phys=raw}, range phys 0..255
          signal StatusCPDData3FBD_Miko_CIRData46: start 400, 8 bit, little-endian, data-type-policy=OVERRIDE, base-type=uint8, compu {phys=raw}, range phys 0..255
          signal StatusCPDData3FBD_Miko_CIRData47: start 408, 8 bit, little-endian, data-type-policy=OVERRIDE, base-type=uint8, compu {phys=raw}, range phys 0..255
          signal StatusCPDData3FBD_Miko_CIRData48: start 416, 8 bit, little-endian, data-type-policy=OVERRIDE, base-type=uint8, compu {phys=raw}, range phys 0..255
          signal StatusCPDData3FBD_Miko_CIRData49: start 424, 8 bit, little-endian, data-type-policy=OVERRIDE, base-type=uint8, compu {phys=raw}, range phys 0..255
          signal StatusCPDData3FBD_Miko_CIRData50: start 432, 8 bit, little-endian, data-type-policy=OVERRIDE, base-type=uint8, compu {phys=raw}, range phys 0..255
          signal StatusCPDData3FBD_Miko_CIRData51: start 440, 8 bit, little-endian, data-type-policy=OVERRIDE, base-type=uint8, compu {phys=raw}, range phys 0..255
          signal StatusCPDData3FBD_Miko_CIRData52: start 448, 8 bit, little-endian, data-type-policy=OVERRIDE, base-type=uint8, compu {phys=raw}, range phys 0..255
          signal StatusCPDData3FBD_Miko_CIRData53: start 456, 8 bit, little-endian, data-type-policy=OVERRIDE, base-type=uint8, compu {phys=raw}, range phys 0..255
          signal StatusCPDData3FBD_Miko_CIRData54: start 464, 8 bit, little-endian, data-type-policy=OVERRIDE, base-type=uint8, compu {phys=raw}, range phys 0..255
          signal StatusCPDData3FBD_Miko_CIRData55: start 472, 8 bit, little-endian, data-type-policy=OVERRIDE, base-type=uint8, compu {phys=raw}, range phys 0..255
          signal StatusCPDData3FBD_Miko_CIRData56: start 480, 8 bit, little-endian, data-type-policy=OVERRIDE, base-type=uint8, compu {phys=raw}, range phys 0..255
          signal StatusCPDData3FBD_Miko_CIRData57: start 488, 8 bit, little-endian, data-type-policy=OVERRIDE, base-type=uint8, compu {phys=raw}, range phys 0..255
          signal StatusCPDData3FBD_Miko_CIRData58: start 496, 8 bit, little-endian, data-type-policy=OVERRIDE, base-type=uint8, compu {phys=raw}, range phys 0..255
          signal StatusCPDData3FBD_Miko_CIRData59: start 504, 8 bit, little-endian, data-type-policy=OVERRIDE, base-type=uint8, compu {phys=raw}, range phys 0..255
      frame StatusCPDData3FBD_MM: id 0x343, frame-length=64, can-addressing-mode=STANDARD, can-frame-rx-behavior=CAN-FD, can-frame-tx-behavior=CAN-FD
        pdu StatusCPDData3FBD_MM: length=64, unused-bit-pattern=0
          signal StatusCPDData3FBD_MM_MsgCounter: start 0, 8 bit, little-endian, data-type-policy=OVERRIDE, base-type=uint8, compu {phys=raw}, range phys 0..252
          signal StatusCPDData3FBD_MM_LinkID: start 8, 8 bit, little-endian, data-type-policy=OVERRIDE, base-type=uint8, compu {phys=raw}, range phys 0..252
          signal StatusCPDData3FBD_MM_AGCValue: start 16, 8 bit, little-endian, data-type-policy=OVERRIDE, base-type=uint8, compu {phys=raw}, range phys 0..252
          signal StatusCPDData3FBD_MM_Channel: start 24, 8 bit, little-endian, data-type-policy=OVERRIDE, base-type=uint8, compu {phys=raw}, range phys 0..252
          signal StatusCPDData3FBD_MM_CIRData00: start 32, 8 bit, little-endian, data-type-policy=OVERRIDE, base-type=uint8, compu {phys=raw}, range phys 0..255
          signal StatusCPDData3FBD_MM_CIRData01: start 40, 8 bit, little-endian, data-type-policy=OVERRIDE, base-type=uint8, compu {phys=raw}, range phys 0..255
          signal StatusCPDData3FBD_MM_CIRData02: start 48, 8 bit, little-endian, data-type-policy=OVERRIDE, base-type=uint8, compu {phys=raw}, range phys 0..255
          signal StatusCPDData3FBD_MM_CIRData03: start 56, 8 bit, little-endian, data-type-policy=OVERRIDE, base-type=uint8, compu {phys=raw}, range phys 0..255
          signal StatusCPDData3FBD_MM_CIRData04: start 64, 8 bit, little-endian, data-type-policy=OVERRIDE, base-type=uint8, compu {phys=raw}, range phys 0..255
          signal StatusCPDData3FBD_MM_CIRData05: start 72, 8 bit, little-endian, data-type-policy=OVERRIDE, base-type=uint8, compu {phys=raw}, range phys 0..255
          signal StatusCPDData3FBD_MM_CIRData06: start 80, 8 bit, little-endian, data-type-policy=OVERRIDE, base-type=uint8, compu {phys=raw}, range phys 0..255
          signal StatusCPDData3FBD_MM_CIRData07: start 88, 8 bit, little-endian, data-type-policy=OVERRIDE, base-type=uint8, compu {phys=raw}, range phys 0..255
          signal StatusCPDData3FBD_MM_CIRData08: start 96, 8 bit, little-endian, data-type-policy=OVERRIDE, base-type=uint8, compu {phys=raw}, range phys 0..255
          signal StatusCPDData3FBD_MM_CIRData09: start 104, 8 bit, little-endian, data-type-policy=OVERRIDE, base-type=uint8, compu {phys=raw}, range phys 0..255
          signal StatusCPDData3FBD_MM_CIRData10: start 112, 8 bit, little-endian, data-type-policy=OVERRIDE, base-type=uint8, compu {phys=raw}, range phys 0..255
          signal StatusCPDData3FBD_MM_CIRData11: start 120, 8 bit, little-endian, data-type-policy=OVERRIDE, base-type=uint8, compu {phys=raw}, range phys 0..255
          signal StatusCPDData3FBD_MM_CIRData12: start 128, 8 bit, little-endian, data-type-policy=OVERRIDE, base-type=uint8, compu {phys=raw}, range phys 0..255
          signal StatusCPDData3FBD_MM_CIRData13: start 136, 8 bit, little-endian, data-type-policy=OVERRIDE, base-type=uint8, compu {phys=raw}, range phys 0..255
          signal StatusCPDData3FBD_MM_CIRData14: start 144, 8 bit, little-endian, data-type-policy=OVERRIDE, base-type=uint8, compu {phys=raw}, range phys 0..255
          signal StatusCPDData3FBD_MM_CIRData15: start 152, 8 bit, little-endian, data-type-policy=OVERRIDE, base-type=uint8, compu {phys=raw}, range phys 0..255
          signal StatusCPDData3FBD_MM_CIRData16: start 160, 8 bit, little-endian, data-type-policy=OVERRIDE, base-type=uint8, compu {phys=raw}, range phys 0..255
          signal StatusCPDData3FBD_MM_CIRData17: start 168, 8 bit, little-endian, data-type-policy=OVERRIDE, base-type=uint8, compu {phys=raw}, range phys 0..255
          signal StatusCPDData3FBD_MM_CIRData18: start 176, 8 bit, little-endian, data-type-policy=OVERRIDE, base-type=uint8, compu {phys=raw}, range phys 0..255
          signal StatusCPDData3FBD_MM_CIRData19: start 184, 8 bit, little-endian, data-type-policy=OVERRIDE, base-type=uint8, compu {phys=raw}, range phys 0..255
          signal StatusCPDData3FBD_MM_CIRData20: start 192, 8 bit, little-endian, data-type-policy=OVERRIDE, base-type=uint8, compu {phys=raw}, range phys 0..255
          signal StatusCPDData3FBD_MM_CIRData21: start 200, 8 bit, little-endian, data-type-policy=OVERRIDE, base-type=uint8, compu {phys=raw}, range phys 0..255
          signal StatusCPDData3FBD_MM_CIRData22: start 208, 8 bit, little-endian, data-type-policy=OVERRIDE, base-type=uint8, compu {phys=raw}, range phys 0..255
          signal StatusCPDData3FBD_MM_CIRData23: start 216, 8 bit, little-endian, data-type-policy=OVERRIDE, base-type=uint8, compu {phys=raw}, range phys 0..255
          signal StatusCPDData3FBD_MM_CIRData24: start 224, 8 bit, little-endian, data-type-policy=OVERRIDE, base-type=uint8, compu {phys=raw}, range phys 0..255
          signal StatusCPDData3FBD_MM_CIRData25: start 232, 8 bit, little-endian, data-type-policy=OVERRIDE, base-type=uint8, compu {phys=raw}, range phys 0..255
          signal StatusCPDData3FBD_MM_CIRData26: start 240, 8 bit, little-endian, data-type-policy=OVERRIDE, base-type=uint8, compu {phys=raw}, range phys 0..255
          signal StatusCPDData3FBD_MM_CIRData27: start 248, 8 bit, little-endian, data-type-policy=OVERRIDE, base-type=uint8, compu {phys=raw}, range phys 0..255
          signal StatusCPDData3FBD_MM_CIRData28: start 256, 8 bit, little-endian, data-type-policy=OVERRIDE, base-type=uint8, compu {phys=raw}, range phys 0..255
          signal StatusCPDData3FBD_MM_CIRData29: start 264, 8 bit, little-endian, data-type-policy=OVERRIDE, base-type=uint8, compu {phys=raw}, range phys 0..255
          signal StatusCPDData3FBD_MM_CIRData30: start 272, 8 bit, little-endian, data-type-policy=OVERRIDE, base-type=uint8, compu {phys=raw}, range phys 0..255
          signal StatusCPDData3FBD_MM_CIRData31: start 280, 8 bit, little-endian, data-type-policy=OVERRIDE, base-type=uint8, compu {phys=raw}, range phys 0..255
          signal StatusCPDData3FBD_MM_CIRData32: start 288, 8 bit, little-endian, data-type-policy=OVERRIDE, base-type=uint8, compu {phys=raw}, range phys 0..255
          signal StatusCPDData3FBD_MM_CIRData33: start 296, 8 bit, little-endian, data-type-policy=OVERRIDE, base-type=uint8, compu {phys=raw}, range phys 0..255
          signal StatusCPDData3FBD_MM_CIRData34: start 304, 8 bit, little-endian, data-type-policy=OVERRIDE, base-type=uint8, compu {phys=raw}, range phys 0..255
          signal StatusCPDData3FBD_MM_CIRData35: start 312, 8 bit, little-endian, data-type-policy=OVERRIDE, base-type=uint8, compu {phys=raw}, range phys 0..255
          signal StatusCPDData3FBD_MM_CIRData36: start 320, 8 bit, little-endian, data-type-policy=OVERRIDE, base-type=uint8, compu {phys=raw}, range phys 0..255
          signal StatusCPDData3FBD_MM_CIRData37: start 328, 8 bit, little-endian, data-type-policy=OVERRIDE, base-type=uint8, compu {phys=raw}, range phys 0..255
          signal StatusCPDData3FBD_MM_CIRData38: start 336, 8 bit, little-endian, data-type-policy=OVERRIDE, base-type=uint8, compu {phys=raw}, range phys 0..255
          signal StatusCPDData3FBD_MM_CIRData39: start 344, 8 bit, little-endian, data-type-policy=OVERRIDE, base-type=uint8, compu {phys=raw}, range phys 0..255
          signal StatusCPDData3FBD_MM_CIRData40: start 352, 8 bit, little-endian, data-type-policy=OVERRIDE, base-type=uint8, compu {phys=raw}, range phys 0..255
          signal StatusCPDData3FBD_MM_CIRData41: start 360, 8 bit, little-endian, data-type-policy=OVERRIDE, base-type=uint8, compu {phys=raw}, range phys 0..255
          signal StatusCPDData3FBD_MM_CIRData42: start 368, 8 bit, little-endian, data-type-policy=OVERRIDE, base-type=uint8, compu {phys=raw}, range phys 0..255
          signal StatusCPDData3FBD_MM_CIRData43: start 376, 8 bit, little-endian, data-type-policy=OVERRIDE, base-type=uint8, compu {phys=raw}, range phys 0..255
          signal StatusCPDData3FBD_MM_CIRData44: start 384, 8 bit, little-endian, data-type-policy=OVERRIDE, base-type=uint8, compu {phys=raw}, range phys 0..255
          signal StatusCPDData3FBD_MM_CIRData45: start 392, 8 bit, little-endian, data-type-policy=OVERRIDE, base-type=uint8, compu {phys=raw}, range phys 0..255
          signal StatusCPDData3FBD_MM_CIRData46: start 400, 8 bit, little-endian, data-type-policy=OVERRIDE, base-type=uint8, compu {phys=raw}, range phys 0..255
          signal StatusCPDData3FBD_MM_CIRData47: start 408, 8 bit, little-endian, data-type-policy=OVERRIDE, base-type=uint8, compu {phys=raw}, range phys 0..255
          signal StatusCPDData3FBD_MM_CIRData48: start 416, 8 bit, little-endian, data-type-policy=OVERRIDE, base-type=uint8, compu {phys=raw}, range phys 0..255
          signal StatusCPDData3FBD_MM_CIRData49: start 424, 8 bit, little-endian, data-type-policy=OVERRIDE, base-type=uint8, compu {phys=raw}, range phys 0..255
          signal StatusCPDData3FBD_MM_CIRData50: start 432, 8 bit, little-endian, data-type-policy=OVERRIDE, base-type=uint8, compu {phys=raw}, range phys 0..255
          signal StatusCPDData3FBD_MM_CIRData51: start 440, 8 bit, little-endian, data-type-policy=OVERRIDE, base-type=uint8, compu {phys=raw}, range phys 0..255
          signal StatusCPDData3FBD_MM_CIRData52: start 448, 8 bit, little-endian, data-type-policy=OVERRIDE, base-type=uint8, compu {phys=raw}, range phys 0..255
          signal StatusCPDData3FBD_MM_CIRData53: start 456, 8 bit, little-endian, data-type-policy=OVERRIDE, base-type=uint8, compu {phys=raw}, range phys 0..255
          signal StatusCPDData3FBD_MM_CIRData54: start 464, 8 bit, little-endian, data-type-policy=OVERRIDE, base-type=uint8, compu {phys=raw}, range phys 0..255
          signal StatusCPDData3FBD_MM_CIRData55: start 472, 8 bit, little-endian, data-type-policy=OVERRIDE, base-type=uint8, compu {phys=raw}, range phys 0..255
          signal StatusCPDData3FBD_MM_CIRData56: start 480, 8 bit, little-endian, data-type-policy=OVERRIDE, base-type=uint8, compu {phys=raw}, range phys 0..255
          signal StatusCPDData3FBD_MM_CIRData57: start 488, 8 bit, little-endian, data-type-policy=OVERRIDE, base-type=uint8, compu {phys=raw}, range phys 0..255
          signal StatusCPDData3FBD_MM_CIRData58: start 496, 8 bit, little-endian, data-type-policy=OVERRIDE, base-type=uint8, compu {phys=raw}, range phys 0..255
          signal StatusCPDData3FBD_MM_CIRData59: start 504, 8 bit, little-endian, data-type-policy=OVERRIDE, base-type=uint8, compu {phys=raw}, range phys 0..255
