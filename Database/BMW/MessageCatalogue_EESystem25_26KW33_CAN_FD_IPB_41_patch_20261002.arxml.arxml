[part 10 of 11: package /CANAnalyzer/CommunicationClusters]
AUTOSAR XML (schema 00051)
package /CANAnalyzer/CommunicationClusters  (continued)
  can cluster CAN_FD_IPB_41  (continued)
    can physical channel Channel  (continued)
      frame TPBLEParameter_FBD_MM_FBD_VM: id 0x38E, frame-length=64, can-addressing-mode=STANDARD, can-frame-rx-behavior=CAN-FD, can-frame-tx-behavior=CAN-FD
        pdu TPBLEParameter_FBD_MM_FBD_VM: length=64, unused-bit-pattern=0
          signal TPBLEParameter_FBD_MM_FBD_VM_Byte00: start 0, 8 bit, little-endian, data-type-policy=OVERRIDE, base-type=uint8, compu {phys=raw}, range phys 0..255
          signal TPBLEParameter_FBD_MM_FBD_VM_Byte01: start 8, 8 bit, little-endian, data-type-policy=OVERRIDE, base-type=uint8, compu {phys=raw}, range phys 0..255
          signal TPBLEParameter_FBD_MM_FBD_VM_Byte02: start 16, 8 bit, little-endian, data-type-policy=OVERRIDE, base-type=uint8, compu {phys=raw}, range phys 0..255
          signal TPBLEParameter_FBD_MM_FBD_VM_Byte03: start 24, 8 bit, little-endian, data-type-policy=OVERRIDE, base-type=uint8, compu {phys=raw}, range phys 0..255
          signal TPBLEParameter_FBD_MM_FBD_VM_Byte04: start 32, 8 bit, little-endian, data-type-policy=OVERRIDE, base-type=uint8, compu {phys=raw}, range phys 0..255
          signal TPBLEParameter_FBD_MM_FBD_VM_Byte05: start 40, 8 bit, little-endian, data-type-policy=OVERRIDE, base-type=uint8, compu {phys=raw}, range phys 0..255
          signal TPBLEParameter_FBD_MM_FBD_VM_Byte06: start 48, 8 bit, little-endian, data-type-policy=OVERRIDE, base-type=uint8, compu {phys=raw}, range phys 0..255
          signal TPBLEParameter_FBD_MM_FBD_VM_Byte07: start 56, 8 bit, little-endian, data-type-policy=OVERRIDE, base-type=uint8, compu {phys=raw}, range phys 0..255
          signal TPBLEParameter_FBD_MM_FBD_VM_Byte08: start 64, 8 bit, little-endian, data-type-policy=OVERRIDE, base-type=uint8, compu {phys=raw}, range phys 0..255
          signal TPBLEParameter_FBD_MM_FBD_VM_Byte09: start 72, 8 bit, little-endian, data-type-policy=OVERRIDE, base-type=uint8, compu {phys=raw}, range phys 0..255
          signal TPBLEParameter_FBD_MM_FBD_VM_Byte10: start 80, 8 bit, little-endian, data-type-policy=OVERRIDE, base-type=uint8, compu {phys=raw}, range phys 0..255
          signal TPBLEParameter_FBD_MM_FBD_VM_Byte11: start 88, 8 bit, little-endian, data-type-policy=OVERRIDE, base-type=uint8, compu {phys=raw}, range phys 0..255
          signal TPBLEParameter_FBD_MM_FBD_VM_Byte12: start 96, 8 bit, little-endian, data-type-policy=OVERRIDE, base-type=uint8, compu {phys=raw}, range phys 0..255
          signal TPBLEParameter_FBD_MM_FBD_VM_Byte13: start 104, 8 bit, little-endian, data-type-policy=OVERRIDE, base-type=uint8, compu {phys=raw}, range phys 0..255
          signal TPBLEParameter_FBD_MM_FBD_VM_Byte14: start 112, 8 bit, little-endian, data-type-policy=OVERRIDE, base-type=uint8, compu {phys=raw}, range phys 0..255
          signal TPBLEParameter_FBD_MM_FBD_VM_Byte15: start 120, 8 bit, little-endian, data-type-policy=OVERRIDE, base-type=uint8, compu {phys=raw}, range phys 0..255
          signal TPBLEParameter_FBD_MM_FBD_VM_Byte16: start 128, 8 bit, little-endian, data-type-policy=OVERRIDE, base-type=uint8, compu {phys=raw}, range phys 0..255
          signal TPBLEParameter_FBD_MM_FBD_VM_Byte17: start 136, 8 bit, little-endian, data-type-policy=OVERRIDE, base-type=uint8, compu {phys=raw}, range phys 0..255
          signal TPBLEParameter_FBD_MM_FBD_VM_Byte18: start 144, 8 bit, little-endian, data-type-policy=OVERRIDE, base-type=uint8, compu {phys=raw}, range phys 0..255
          signal TPBLEParameter_FBD_MM_FBD_VM_Byte19: start 152, 8 bit, little-endian, data-type-policy=OVERRIDE, base-type=uint8, compu {phys=raw}, range phys 0..255
          signal TPBLEParameter_FBD_MM_FBD_VM_Byte20: start 160, 8 bit, little-endian, data-type-policy=OVERRIDE, base-type=uint8, compu {phys=raw}, range phys 0..255
          signal TPBLEParameter_FBD_MM_FBD_VM_Byte21: start 168, 8 bit, little-endian, data-type-policy=OVERRIDE, base-type=uint8, compu {phys=raw}, range phys 0..255
          signal TPBLEParameter_FBD_MM_FBD_VM_Byte22: start 176, 8 bit, little-endian, data-type-policy=OVERRIDE, base-type=uint8, compu {phys=raw}, range phys 0..255
          signal TPBLEParameter_FBD_MM_FBD_VM_Byte23: start 184, 8 bit, little-endian, data-type-policy=OVERRIDE, base-type=uint8, compu {phys=raw}, range phys 0..255
          signal TPBLEParameter_FBD_MM_FBD_VM_Byte24: start 192, 8 bit, little-endian, data-type-policy=OVERRIDE, base-type=uint8, compu {phys=raw}, range phys 0..255
          signal TPBLEParameter_FBD_MM_FBD_VM_Byte25: start 200, 8 bit, little-endian, data-type-policy=OVERRIDE, base-type=uint8, compu {phys=raw}, range phys 0..255
          signal TPBLEParameter_FBD_MM_FBD_VM_Byte26: start 208, 8 bit, little-endian, data-type-policy=OVERRIDE, base-type=uint8, compu {phys=raw}, range phys 0..255
          signal TPBLEParameter_FBD_MM_FBD_VM_Byte27: start 216, 8 bit, little-endian, data-type-policy=OVERRIDE, base-type=uint8, compu {phys=raw}, range phys 0..255
          signal TPBLEParameter_FBD_MM_FBD_VM_Byte28: start 224, 8 bit, little-endian, data-type-policy=OVERRIDE, base-type=uint8, compu {phys=raw}, range phys 0..255
          signal TPBLEParameter_FBD_MM_FBD_VM_Byte29: start 232, 8 bit, little-endian, data-type-policy=OVERRIDE, base-type=uint8, compu {phys=raw}, range phys 0..255
          signal TPBLEParameter_FBD_MM_FBD_VM_Byte30: start 240, 8 bit, little-endian, data-type-policy=OVERRIDE, base-type=uint8, compu {phys=raw}, range phys 0..255
          signal TPBLEParameter_FBD_MM_FBD_VM_Byte31: start 248, 8 bit, little-endian, data-type-policy=OVERRIDE, base-type=uint8, compu {phys=raw}, range phys 0..255
          signal TPBLEParameter_FBD_MM_FBD_VM_Byte32: start 256, 8 bit, little-endian, data-type-policy=OVERRIDE, base-type=uint8, compu {phys=raw}, range phys 0..255
          signal TPBLEParameter_FBD_MM_FBD_VM_Byte33: start 264, 8 bit, little-endian, data-type-policy=OVERRIDE, base-type=uint8, compu {phys=raw}, range phys 0..255
          signal TPBLEParameter_FBD_MM_FBD_VM_Byte34: start 272, 8 bit, little-endian, data-type-policy=OVERRIDE, base-type=uint8, compu {phys=raw}, range phys 0..255
          signal TPBLEParameter_FBD_MM_FBD_VM_Byte35: start 280, 8 bit, little-endian, data-type-policy=OVERRIDE, base-type=uint8, compu {phys=raw}, range phys 0..255
          signal TPBLEParameter_FBD_MM_FBD_VM_Byte36: start 288, 8 bit, little-endian, data-type-policy=OVERRIDE, base-type=uint8, compu {phys=raw}, range phys 0..255
          signal TPBLEParameter_FBD_MM_FBD_VM_Byte37: start 296, 8 bit, little-endian, data-type-policy=OVERRIDE, base-type=uint8, compu {phys=raw}, range phys 0..255
          signal TPBLEParameter_FBD_MM_FBD_VM_Byte38: start 304, 8 bit, little-endian, data-type-policy=OVERRIDE, base-type=uint8, compu {phys=raw}, range phys 0..255
          signal TPBLEParameter_FBD_MM_FBD_VM_Byte39: start 312, 8 bit, little-endian, data-type-policy=OVERRIDE, base-type=uint8, compu {phys=raw}, range phys 0..255
          signal TPBLEParameter_FBD_MM_FBD_VM_Byte40: start 320, 8 bit, little-endian, data-type-policy=OVERRIDE, base-type=uint8, compu {phys=raw}, range phys 0..255
          signal TPBLEParameter_FBD_MM_FBD_VM_Byte41: start 328, 8 bit, little-endian, data-type-policy=OVERRIDE, base-type=uint8, compu {phys=raw}, range phys 0..255
          signal TPBLEParameter_FBD_MM_FBD_VM_Byte42: start 336, 8 bit, little-endian, data-type-policy=OVERRIDE, base-type=uint8, compu {phys=raw}, range phys 0..255
          signal TPBLEParameter_FBD_MM_FBD_VM_Byte43: start 344, 8 bit, little-endian, data-type-policy=OVERRIDE, base-type=uint8, compu {phys=raw}, range phys 0..255
          signal TPBLEParameter_FBD_MM_FBD_VM_Byte44: start 352, 8 bit, little-endian, data-type-policy=OVERRIDE, base-type=uint8, compu {phys=raw}, range phys 0..255
          signal TPBLEParameter_FBD_MM_FBD_VM_Byte45: start 360, 8 bit, little-endian, data-type-policy=OVERRIDE, base-type=uint8, compu {phys=raw}, range phys 0..255
          signal TPBLEParameter_FBD_MM_FBD_VM_Byte46: start 368, 8 bit, little-endian, data-type-policy=OVERRIDE, base-type=uint8, compu {phys=raw}, range phys 0..255
          signal TPBLEParameter_FBD_MM_FBD_VM_Byte47: start 376, 8 bit, little-endian, data-type-policy=OVERRIDE, base-type=uint8, compu {phys=raw}, range phys 0..255
          signal TPBLEParameter_FBD_MM_FBD_VM_Byte48: start 384, 8 bit, little-endian, data-type-policy=OVERRIDE, base-type=uint8, compu {phys=raw}, range phys 0..255
          signal TPBLEParameter_FBD_MM_FBD_VM_Byte49: start 392, 8 bit, little-endian, data-type-policy=OVERRIDE, base-type=uint8, compu {phys=raw}, range phys 0..255
          signal TPBLEParameter_FBD_MM_FBD_VM_Byte50: start 400, 8 bit, little-endian, data-type-policy=OVERRIDE, base-type=uint8, compu {phys=raw}, range phys 0..255
          signal TPBLEParameter_FBD_MM_FBD_VM_Byte51: start 408, 8 bit, little-endian, data-type-policy=OVERRIDE, base-type=uint8, compu {phys=raw}, range phys 0..255
          signal TPBLEParameter_FBD_MM_FBD_VM_Byte52: start 416, 8 bit, little-endian, data-type-policy=OVERRIDE, base-type=uint8, compu {phys=raw}, range phys 0..255
          signal TPBLEParameter_FBD_MM_FBD_VM_Byte53: start 424, 8 bit, little-endian, data-type-policy=OVERRIDE, base-type=uint8, compu {phys=raw}, range phys 0..255
          signal TPBLEParameter_FBD_MM_FBD_VM_Byte54: start 432, 8 bit, little-endian, data-type-policy=OVERRIDE, base-type=uint8, compu {phys=raw}, range phys 0..255
          signal TPBLEParameter_FBD_MM_FBD_VM_Byte55: start 440, 8 bit, little-endian, data-type-policy=OVERRIDE, base-type=uint8, compu {phys=raw}, range phys 0..255
          signal TPBLEParameter_FBD_MM_FBD_VM_Byte56: start 448, 8 bit, little-endian, data-type-policy=OVERRIDE, base-type=uint8, compu {phys=raw}, range phys 0..255
          signal TPBLEParameter_FBD_MM_FBD_VM_Byte57: start 456, 8 bit, little-endian, data-type-policy=OVERRIDE, base-type=uint8, compu {phys=raw}, range phys 0..255
          signal TPBLEParameter_FBD_MM_FBD_VM_Byte58: start 464, 8 bit, little-endian, data-type-policy=OVERRIDE, base-type=uint8, compu {phys=raw}, range phys 0..255
          signal TPBLEParameter_FBD_MM_FBD_VM_Byte59: start 472, 8 bit, little-endian, data-type-policy=OVERRIDE, base-type=uint8, compu {phys=raw}, range phys 0..255
          signal TPBLEParameter_FBD_MM_FBD_VM_Byte60: start 480, 8 bit, little-endian, data-type-policy=OVERRIDE, base-type=uint8, compu {phys=raw}, range phys 0..255
          signal TPBLEParameter_FBD_MM_FBD_VM_Byte61: start 488, 8 bit, little-endian, data-type-policy=OVERRIDE, base-type=uint8, compu {phys=raw}, range phys 0..255
          signal TPBLEParameter_FBD_MM_FBD_VM_Byte62: start 496, 8 bit, little-endian, data-type-policy=OVERRIDE, base-type=uint8, compu {phys=raw}, range phys 0..255
          signal TPBLEParameter_FBD_MM_FBD_VM_Byte63: start 504, 8 bit, little-endian, data-type-policy=OVERRIDE, base-type=uint8, compu {phys=raw}, range phys 0..255
      frame TPBLEParameter_FBD_SML_FBD_SMR: id 0x3A0, frame-length=64, can-addressing-mode=STANDARD, can-frame-rx-behavior=CAN-FD, can-frame-tx-behavior=CAN-FD
        pdu TPBLEParameter_FBD_SML_FBD_SMR: length=64, unused-bit-pattern=0
          signal TPBLEParameter_FBD_SML_FBD_SMR_Byte00: start 0, 8 bit, little-endian, data-type-policy=OVERRIDE, base-type=uint8, compu {phys=raw}, range phys 0..255
          signal TPBLEParameter_FBD_SML_FBD_SMR_Byte01: start 8, 8 bit, little-endian, data-type-policy=OVERRIDE, base-type=uint8, compu {phys=raw}, range phys 0..255
          signal TPBLEParameter_FBD_SML_FBD_SMR_Byte02: start 16, 8 bit, little-endian, data-type-policy=OVERRIDE, base-type=uint8, compu {phys=raw}, range phys 0..255
          signal TPBLEParameter_FBD_SML_FBD_SMR_Byte03: start 24, 8 bit, little-endian, data-type-policy=OVERRIDE, base-type=uint8, compu {phys=raw}, range phys 0..255
          signal TPBLEParameter_FBD_SML_FBD_SMR_Byte04: start 32, 8 bit, little-endian, data-type-policy=OVERRIDE, base-type=uint8, compu {phys=raw}, range phys 0..255
          signal TPBLEParameter_FBD_SML_FBD_SMR_Byte05: start 40, 8 bit, little-endian, data-type-policy=OVERRIDE, base-type=uint8, compu {phys=raw}, range phys 0..255
          signal TPBLEParameter_FBD_SML_FBD_SMR_Byte06: start 48, 8 bit, little-endian, data-type-policy=OVERRIDE, base-type=uint8, compu {phys=raw}, range phys 0..255
          signal TPBLEParameter_FBD_SML_FBD_SMR_Byte07: start 56, 8 bit, little-endian, data-type-policy=OVERRIDE, base-type=uint8, compu {phys=raw}, range phys 0..255
          signal TPBLEParameter_FBD_SML_FBD_SMR_Byte08: start 64, 8 bit, little-endian, data-type-policy=OVERRIDE, base-type=uint8, compu {phys=raw}, range phys 0..255
          signal TPBLEParameter_FBD_SML_FBD_SMR_Byte09: start 72, 8 bit, little-endian, data-type-policy=OVERRIDE, base-type=uint8, compu {phys=raw}, range phys 0..255
          signal TPBLEParameter_FBD_SML_FBD_SMR_Byte10: start 80, 8 bit, little-endian, data-type-policy=OVERRIDE, base-type=uint8, compu {phys=raw}, range phys 0..255
          signal TPBLEParameter_FBD_SML_FBD_SMR_Byte11: start 88, 8 bit, little-endian, data-type-policy=OVERRIDE, base-type=uint8, compu {phys=raw}, range phys 0..255
          signal TPBLEParameter_FBD_SML_FBD_SMR_Byte12: start 96, 8 bit, little-endian, data-type-policy=OVERRIDE, base-type=uint8, compu {phys=raw}, range phys 0..255
          signal TPBLEParameter_FBD_SML_FBD_SMR_Byte13: start 104, 8 bit, little-endian, data-type-policy=OVERRIDE, base-type=uint8, compu {phys=raw}, range phys 0..255
          signal TPBLEParameter_FBD_SML_FBD_SMR_Byte14: start 112, 8 bit, little-endian, data-type-policy=OVERRIDE, base-type=uint8, compu {phys=raw}, range phys 0..255
          signal TPBLEParameter_FBD_SML_FBD_SMR_Byte15: start 120, 8 bit, little-endian, data-type-policy=OVERRIDE, base-type=uint8, compu {phys=raw}, range phys 0..255
          signal TPBLEParameter_FBD_SML_FBD_SMR_Byte16: start 128, 8 bit, little-endian, data-type-policy=OVERRIDE, base-type=uint8, compu {phys=raw}, range phys 0..255
          signal TPBLEParameter_FBD_SML_FBD_SMR_Byte17: start 136, 8 bit, little-endian, data-type-policy=OVERRIDE, base-type=uint8, compu {phys=raw}, range phys 0..255
          signal TPBLEParameter_FBD_SML_FBD_SMR_Byte18: start 144, 8 bit, little-endian, data-type-policy=OVERRIDE, base-type=uint8, compu {phys=raw}, range phys 0..255
          signal TPBLEParameter_FBD_SML_FBD_SMR_Byte19: start 152, 8 bit, little-endian, data-type-policy=OVERRIDE, base-type=uint8, compu {phys=raw}, range phys 0..255
          signal TPBLEParameter_FBD_SML_FBD_SMR_Byte20: start 160, 8 bit, little-endian, data-type-policy=OVERRIDE, base-type=uint8, compu {phys=raw}, range phys 0..255
          signal TPBLEParameter_FBD_SML_FBD_SMR_Byte21: start 168, 8 bit, little-endian, data-type-policy=OVERRIDE, base-type=uint8, compu {phys=raw}, range phys 0..255
          signal TPBLEParameter_FBD_SML_FBD_SMR_Byte22: start 176, 8 bit, little-endian, data-type-policy=OVERRIDE, base-type=uint8, compu {phys=raw}, range phys 0..255
          signal TPBLEParameter_FBD_SML_FBD_SMR_Byte23: start 184, 8 bit, little-endian, data-type-policy=OVERRIDE, base-type=uint8, compu {phys=raw}, range phys 0..255
          signal TPBLEParameter_FBD_SML_FBD_SMR_Byte24: start 192, 8 bit, little-endian, data-type-policy=OVERRIDE, base-type=uint8, compu {phys=raw}, range phys 0..255
          signal TPBLEParameter_FBD_SML_FBD_SMR_Byte25: start 200, 8 bit, little-endian, data-type-policy=OVERRIDE, base-type=uint8, compu {phys=raw}, range phys 0..255
          signal TPBLEParameter_FBD_SML_FBD_SMR_Byte26: start 208, 8 bit, little-endian, data-type-policy=OVERRIDE, base-type=uint8, compu {phys=raw}, range phys 0..255
          signal TPBLEParameter_FBD_SML_FBD_SMR_Byte27: start 216, 8 bit, little-endian, data-type-policy=OVERRIDE, base-type=uint8, compu {phys=raw}, range phys 0..255
          signal TPBLEParameter_FBD_SML_FBD_SMR_Byte28: start 224, 8 bit, little-endian, data-type-policy=OVERRIDE, base-type=uint8, compu {phys=raw}, range phys 0..255
          signal TPBLEParameter_FBD_SML_FBD_SMR_Byte29: start 232, 8 bit, little-endian, data-type-policy=OVERRIDE, base-type=uint8, compu {phys=raw}, range phys 0..255
          signal TPBLEParameter_FBD_SML_FBD_SMR_Byte30: start 240, 8 bit, little-endian, data-type-policy=OVERRIDE, base-type=uint8, compu {phys=raw}, range phys 0..255
          signal TPBLEParameter_FBD_SML_FBD_SMR_Byte31: start 248, 8 bit, little-endian, data-type-policy=OVERRIDE, base-type=uint8, compu {phys=raw}, range phys 0..255
          signal TPBLEParameter_FBD_SML_FBD_SMR_Byte32: start 256, 8 bit, little-endian, data-type-policy=OVERRIDE, base-type=uint8, compu {phys=raw}, range phys 0..255
          signal TPBLEParameter_FBD_SML_FBD_SMR_Byte33: start 264, 8 bit, little-endian, data-type-policy=OVERRIDE, base-type=uint8, compu {phys=raw}, range phys 0..255
          signal TPBLEParameter_FBD_SML_FBD_SMR_Byte34: start 272, 8 bit, little-endian, data-type-policy=OVERRIDE, base-type=uint8, compu {phys=raw}, range phys 0..255
          signal TPBLEParameter_FBD_SML_FBD_SMR_Byte35: start 280, 8 bit, little-endian, data-type-policy=OVERRIDE, base-type=uint8, compu {phys=raw}, range phys 0..255
          signal TPBLEParameter_FBD_SML_FBD_SMR_Byte36: start 288, 8 bit, little-endian, data-type-policy=OVERRIDE, base-type=uint8, compu {phys=raw}, range phys 0..255
          signal TPBLEParameter_FBD_SML_FBD_SMR_Byte37: start 296, 8 bit, little-endian, data-type-policy=OVERRIDE, base-type=uint8, compu {phys=raw}, range phys 0..255
          signal TPBLEParameter_FBD_SML_FBD_SMR_Byte38: start 304, 8 bit, little-endian, data-type-policy=OVERRIDE, base-type=uint8, compu {phys=raw}, range phys 0..255
          signal TPBLEParameter_FBD_SML_FBD_SMR_Byte39: start 312, 8 bit, little-endian, data-type-policy=OVERRIDE, base-type=uint8, compu {phys=raw}, range phys 0..255
          signal TPBLEParameter_FBD_SML_FBD_SMR_Byte40: start 320, 8 bit, little-endian, data-type-policy=OVERRIDE, base-type=uint8, compu {phys=raw}, range phys 0..255
          signal TPBLEParameter_FBD_SML_FBD_SMR_Byte41: start 328, 8 bit, little-endian, data-type-policy=OVERRIDE, base-type=uint8, compu {phys=raw}, range phys 0..255
          signal TPBLEParameter_FBD_SML_FBD_SMR_Byte42: start 336, 8 bit, little-endian, data-type-policy=OVERRIDE, base-type=uint8, compu {phys=raw}, range phys 0..255
          signal TPBLEParameter_FBD_SML_FBD_SMR_Byte43: start 344, 8 bit, little-endian, data-type-policy=OVERRIDE, base-type=uint8, compu {phys=raw}, range phys 0..255
          signal TPBLEParameter_FBD_SML_FBD_SMR_Byte44: start 352, 8 bit, little-endian, data-type-policy=OVERRIDE, base-type=uint8, compu {phys=raw}, range phys 0..255
          signal TPBLEParameter_FBD_SML_FBD_SMR_Byte45: start 360, 8 bit, little-endian, data-type-policy=OVERRIDE, base-type=uint8, compu {phys=raw}, range phys 0..255
          signal TPBLEParameter_FBD_SML_FBD_SMR_Byte46: start 368, 8 bit, little-endian, data-type-policy=OVERRIDE, base-type=uint8, compu {phys=raw}, range phys 0..255
          signal TPBLEParameter_FBD_SML_FBD_SMR_Byte47: start 376, 8 bit, little-endian, data-type-policy=OVERRIDE, base-type=uint8, compu {phys=raw}, range phys 0..255
          signal TPBLEParameter_FBD_SML_FBD_SMR_Byte48: start 384, 8 bit, little-endian, data-type-policy=OVERRIDE, base-type=uint8, compu {phys=raw}, range phys 0..255
          signal TPBLEParameter_FBD_SML_FBD_SMR_Byte49: start 392, 8 bit, little-endian, data-type-policy=OVERRIDE, base-type=uint8, compu {phys=raw}, range phys 0..255
          signal TPBLEParameter_FBD_SML_FBD_SMR_Byte50: start 400, 8 bit, little-endian, data-type-policy=OVERRIDE, base-type=uint8, compu {phys=raw}, range phys 0..255
          signal TPBLEParameter_FBD_SML_FBD_SMR_Byte51: start 408, 8 bit, little-endian, data-type-policy=OVERRIDE, base-type=uint8, compu {phys=raw}, range phys 0..255
          signal TPBLEParameter_FBD_SML_FBD_SMR_Byte52: start 416, 8 bit, little-endian, data-type-policy=OVERRIDE, base-type=uint8, compu {phys=raw}, range phys 0..255
          signal TPBLEParameter_FBD_SML_FBD_SMR_Byte53: start 424, 8 bit, little-endian, data-type-policy=OVERRIDE, base-type=uint8, compu {phys=raw}, range phys 0..255
          signal TPBLEParameter_FBD_SML_FBD_SMR_Byte54: start 432, 8 bit, little-endian, data-type-policy=OVERRIDE, base-type=uint8, compu {phys=raw}, range phys 0..255
          signal TPBLEParameter_FBD_SML_FBD_SMR_Byte55: start 440, 8 bit, little-endian, data-type-policy=OVERRIDE, base-type=uint8, compu {phys=raw}, range phys 0..255
          signal TPBLEParameter_FBD_SML_FBD_SMR_Byte56: start 448, 8 bit, little-endian, data-type-policy=OVERRIDE, base-type=uint8, compu {phys=raw}, range phys 0..255
          signal TPBLEParameter_FBD_SML_FBD_SMR_Byte57: start 456, 8 bit, little-endian, data-type-policy=OVERRIDE, base-type=uint8, compu {phys=raw}, range phys 0..255
          signal TPBLEParameter_FBD_SML_FBD_SMR_Byte58: start 464, 8 bit, little-endian, data-type-policy=OVERRIDE, base-type=uint8, compu {phys=raw}, range phys 0..255
          signal TPBLEParameter_FBD_SML_FBD_SMR_Byte59: start 472, 8 bit, little-endian, data-type-policy=OVERRIDE, base-type=uint8, compu {phys=raw}, range phys 0..255
          signal TPBLEParameter_FBD_SML_FBD_SMR_Byte60: start 480, 8 bit, little-endian, data-type-policy=OVERRIDE, base-type=uint8, compu {phys=raw}, range phys 0..255
          signal TPBLEParameter_FBD_SML_FBD_SMR_Byte61: start 488, 8 bit, little-endian, data-type-policy=OVERRIDE, base-type=uint8, compu {phys=raw}, range phys 0..255
          signal TPBLEParameter_FBD_SML_FBD_SMR_Byte62: start 496, 8 bit, little-endian, data-type-policy=OVERRIDE, base-type=uint8, compu {phys=raw}, range phys 0..255
          signal TPBLEParameter_FBD_SML_FBD_SMR_Byte63: start 504, 8 bit, little-endian, data-type-policy=OVERRIDE, base-type=uint8, compu {phys=raw}, range phys 0..255
      frame TPBLEParameter_FBD_SMR_FBD_SML: id 0x3A1, frame-length=64, can-addressing-mode=STANDARD, can-frame-rx-behavior=CAN-FD, can-frame-tx-behavior=CAN-FD
        pdu TPBLEParameter_FBD_SMR_FBD_SML: length=64, unused-bit-pattern=0
          signal TPBLEParameter_FBD_SMR_FBD_SML_Byte00: start 0, 8 bit, little-endian, data-type-policy=OVERRIDE, base-type=uint8, compu {phys=raw}, range phys 0..255
          signal TPBLEParameter_FBD_SMR_FBD_SML_Byte01: start 8, 8 bit, little-endian, data-type-policy=OVERRIDE, base-type=uint8, compu {phys=raw}, range phys 0..255
          signal TPBLEParameter_FBD_SMR_FBD_SML_Byte02: start 16, 8 bit, little-endian, data-type-policy=OVERRIDE, base-type=uint8, compu {phys=raw}, range phys 0..255
          signal TPBLEParameter_FBD_SMR_FBD_SML_Byte03: start 24, 8 bit, little-endian, data-type-policy=OVERRIDE, base-type=uint8, compu {phys=raw}, range phys 0..255
          signal TPBLEParameter_FBD_SMR_FBD_SML_Byte04: start 32, 8 bit, little-endian, data-type-policy=OVERRIDE, base-type=uint8, compu {phys=raw}, range phys 0..255
          signal TPBLEParameter_FBD_SMR_FBD_SML_Byte05: start 40, 8 bit, little-endian, data-type-policy=OVERRIDE, base-type=uint8, compu {phys=raw}, range phys 0..255
          signal TPBLEParameter_FBD_SMR_FBD_SML_Byte06: start 48, 8 bit, little-endian, data-type-policy=OVERRIDE, base-type=uint8, compu {phys=raw}, range phys 0..255
          signal TPBLEParameter_FBD_SMR_FBD_SML_Byte07: start 56, 8 bit, little-endian, data-type-policy=OVERRIDE, base-type=uint8, compu {phys=raw}, range phys 0..255
          signal TPBLEParameter_FBD_SMR_FBD_SML_Byte08: start 64, 8 bit, little-endian, data-type-policy=OVERRIDE, base-type=uint8, compu {phys=raw}, range phys 0..255
          signal TPBLEParameter_FBD_SMR_FBD_SML_Byte09: start 72, 8 bit, little-endian, data-type-policy=OVERRIDE, base-type=uint8, compu {phys=raw}, range phys 0..255
          signal TPBLEParameter_FBD_SMR_FBD_SML_Byte10: start 80, 8 bit, little-endian, data-type-policy=OVERRIDE, base-type=uint8, compu {phys=raw}, range phys 0..255
          signal TPBLEParameter_FBD_SMR_FBD_SML_Byte11: start 88, 8 bit, little-endian, data-type-policy=OVERRIDE, base-type=uint8, compu {phys=raw}, range phys 0..255
          signal TPBLEParameter_FBD_SMR_FBD_SML_Byte12: start 96, 8 bit, little-endian, data-type-policy=OVERRIDE, base-type=uint8, compu {phys=raw}, range phys 0..255
          signal TPBLEParameter_FBD_SMR_FBD_SML_Byte13: start 104, 8 bit, little-endian, data-type-policy=OVERRIDE, base-type=uint8, compu {phys=raw}, range phys 0..255
          signal TPBLEParameter_FBD_SMR_FBD_SML_Byte14: start 112, 8 bit, little-endian, data-type-policy=OVERRIDE, base-type=uint8, compu {phys=raw}, range phys 0..255
          signal TPBLEParameter_FBD_SMR_FBD_SML_Byte15: start 120, 8 bit, little-endian, data-type-policy=OVERRIDE, base-type=uint8, compu {phys=raw}, range phys 0..255
          signal TPBLEParameter_FBD_SMR_FBD_SML_Byte16: start 128, 8 bit, little-endian, data-type-policy=OVERRIDE, base-type=uint8, compu {phys=raw}, range phys 0..255
          signal TPBLEParameter_FBD_SMR_FBD_SML_Byte17: start 136, 8 bit, little-endian, data-type-policy=OVERRIDE, base-type=uint8, compu {phys=raw}, range phys 0..255
          signal TPBLEParameter_FBD_SMR_FBD_SML_Byte18: start 144, 8 bit, little-endian, data-type-policy=OVERRIDE, base-type=uint8, compu {phys=raw}, range phys 0..255
          signal TPBLEParameter_FBD_SMR_FBD_SML_Byte19: start 152, 8 bit, little-endian, data-type-policy=OVERRIDE, base-type=uint8, compu {phys=raw}, range phys 0..255
          signal TPBLEParameter_FBD_SMR_FBD_SML_Byte20: start 160, 8 bit, little-endian, data-type-policy=OVERRIDE, base-type=uint8, compu {phys=raw}, range phys 0..255
          signal TPBLEParameter_FBD_SMR_FBD_SML_Byte21: start 168, 8 bit, little-endian, data-type-policy=OVERRIDE, base-type=uint8, compu {phys=raw}, range phys 0..255
          signal TPBLEParameter_FBD_SMR_FBD_SML_Byte22: start 176, 8 bit, little-endian, data-type-policy=OVERRIDE, base-type=uint8, compu {phys=raw}, range phys 0..255
          signal TPBLEParameter_FBD_SMR_FBD_SML_Byte23: start 184, 8 bit, little-endian, data-type-policy=OVERRIDE, base-type=uint8, compu {phys=raw}, range phys 0..255
          signal TPBLEParameter_FBD_SMR_FBD_SML_Byte24: start 192, 8 bit, little-endian, data-type-policy=OVERRIDE, base-type=uint8, compu {phys=raw}, range phys 0..255
          signal TPBLEParameter_FBD_SMR_FBD_SML_Byte25: start 200, 8 bit, little-endian, data-type-policy=OVERRIDE, base-type=uint8, compu {phys=raw}, range phys 0..255
          signal TPBLEParameter_FBD_SMR_FBD_SML_Byte26: start 208, 8 bit, little-endian, data-type-policy=OVERRIDE, base-type=uint8, compu {phys=raw}, range phys 0..255
          signal TPBLEParameter_FBD_SMR_FBD_SML_Byte27: start 216, 8 bit, little-endian, data-type-policy=OVERRIDE, base-type=uint8, compu {phys=raw}, range phys 0..255
          signal TPBLEParameter_FBD_SMR_FBD_SML_Byte28: start 224, 8 bit, little-endian, data-type-policy=OVERRIDE, base-type=uint8, compu {phys=raw}, range phys 0..255
          signal TPBLEParameter_FBD_SMR_FBD_SML_Byte29: start 232, 8 bit, little-endian, data-type-policy=OVERRIDE, base-type=uint8, compu {phys=raw}, range phys 0..255
          signal TPBLEParameter_FBD_SMR_FBD_SML_Byte30: start 240, 8 bit, little-endian, data-type-policy=OVERRIDE, base-type=uint8, compu {phys=raw}, range phys 0..255
          signal TPBLEParameter_FBD_SMR_FBD_SML_Byte31: start 248, 8 bit, little-endian, data-type-policy=OVERRIDE, base-type=uint8, compu {phys=raw}, range phys 0..255
          signal TPBLEParameter_FBD_SMR_FBD_SML_Byte32: start 256, 8 bit, little-endian, data-type-policy=OVERRIDE, base-type=uint8, compu {phys=raw}, range phys 0..255
          signal TPBLEParameter_FBD_SMR_FBD_SML_Byte33: start 264, 8 bit, little-endian, data-type-policy=OVERRIDE, base-type=uint8, compu {phys=raw}, range phys 0..255
          signal TPBLEParameter_FBD_SMR_FBD_SML_Byte34: start 272, 8 bit, little-endian, data-type-policy=OVERRIDE, base-type=uint8, compu {phys=raw}, range phys 0..255
          signal TPBLEParameter_FBD_SMR_FBD_SML_Byte35: start 280, 8 bit, little-endian, data-type-policy=OVERRIDE, base-type=uint8, compu {phys=raw}, range phys 0..255
          signal TPBLEParameter_FBD_SMR_FBD_SML_Byte36: start 288, 8 bit, little-endian, data-type-policy=OVERRIDE, base-type=uint8, compu {phys=raw}, range phys 0..255
          signal TPBLEParameter_FBD_SMR_FBD_SML_Byte37: start 296, 8 bit, little-endian, data-type-policy=OVERRIDE, base-type=uint8, compu {phys=raw}, range phys 0..255
          signal TPBLEParameter_FBD_SMR_FBD_SML_Byte38: start 304, 8 bit, little-endian, data-type-policy=OVERRIDE, base-type=uint8, compu {phys=raw}, range phys 0..255
          signal TPBLEParameter_FBD_SMR_FBD_SML_Byte39: start 312, 8 bit, little-endian, data-type-policy=OVERRIDE, base-type=uint8, compu {phys=raw}, range phys 0..255
          signal TPBLEParameter_FBD_SMR_FBD_SML_Byte40: start 320, 8 bit, little-endian, data-type-policy=OVERRIDE, base-type=uint8, compu {phys=raw}, range phys 0..255
          signal TPBLEParameter_FBD_SMR_FBD_SML_Byte41: start 328, 8 bit, little-endian, data-type-policy=OVERRIDE, base-type=uint8, compu {phys=raw}, range phys 0..255
          signal TPBLEParameter_FBD_SMR_FBD_SML_Byte42: start 336, 8 bit, little-endian, data-type-policy=OVERRIDE, base-type=uint8, compu {phys=raw}, range phys 0..255
          signal TPBLEParameter_FBD_SMR_FBD_SML_Byte43: start 344, 8 bit, little-endian, data-type-policy=OVERRIDE, base-type=uint8, compu {phys=raw}, range phys 0..255
          signal TPBLEParameter_FBD_SMR_FBD_SML_Byte44: start 352, 8 bit, little-endian, data-type-policy=OVERRIDE, base-type=uint8, compu {phys=raw}, range phys 0..255
          signal TPBLEParameter_FBD_SMR_FBD_SML_Byte45: start 360, 8 bit, little-endian, data-type-policy=OVERRIDE, base-type=uint8, compu {phys=raw}, range phys 0..255
          signal TPBLEParameter_FBD_SMR_FBD_SML_Byte46: start 368, 8 bit, little-endian, data-type-policy=OVERRIDE, base-type=uint8, compu {phys=raw}, range phys 0..255
          signal TPBLEParameter_FBD_SMR_FBD_SML_Byte47: start 376, 8 bit, little-endian, data-type-policy=OVERRIDE, base-type=uint8, compu {phys=raw}, range phys 0..255
          signal TPBLEParameter_FBD_SMR_FBD_SML_Byte48: start 384, 8 bit, little-endian, data-type-policy=OVERRIDE, base-type=uint8, compu {phys=raw}, range phys 0..255
          signal TPBLEParameter_FBD_SMR_FBD_SML_Byte49: start 392, 8 bit, little-endian, data-type-policy=OVERRIDE, base-type=uint8, compu {phys=raw}, range phys 0..255
          signal TPBLEParameter_FBD_SMR_FBD_SML_Byte50: start 400, 8 bit, little-endian, data-type-policy=OVERRIDE, base-type=uint8, compu {phys=raw}, range phys 0..255
          signal TPBLEParameter_FBD_SMR_FBD_SML_Byte51: start 408, 8 bit, little-endian, data-type-policy=OVERRIDE, base-type=uint8, compu {phys=raw}, range phys 0..255
          signal TPBLEParameter_FBD_SMR_FBD_SML_Byte52: start 416, 8 bit, little-endian, data-type-policy=OVERRIDE, base-type=uint8, compu {phys=raw}, range phys 0..255
          signal TPBLEParameter_FBD_SMR_FBD_SML_Byte53: start 424, 8 bit, little-endian, data-type-policy=OVERRIDE, base-type=uint8, compu {phys=raw}, range phys 0..255
          signal TPBLEParameter_FBD_SMR_FBD_SML_Byte54: start 432, 8 bit, little-endian, data-type-policy=OVERRIDE, base-type=uint8, compu {phys=raw}, range phys 0..255
          signal TPBLEParameter_FBD_SMR_FBD_SML_Byte55: start 440, 8 bit, little-endian, data-type-policy=OVERRIDE, base-type=uint8, compu {phys=raw}, range phys 0..255
          signal TPBLEParameter_FBD_SMR_FBD_SML_Byte56: start 448, 8 bit, little-endian, data-type-policy=OVERRIDE, base-type=uint8, compu {phys=raw}, range phys 0..255
          signal TPBLEParameter_FBD_SMR_FBD_SML_Byte57: start 456, 8 bit, little-endian, data-type-policy=OVERRIDE, base-type=uint8, compu {phys=raw}, range phys 0..255
          signal TPBLEParameter_FBD_SMR_FBD_SML_Byte58: start 464, 8 bit, little-endian, data-type-policy=OVERRIDE, base-type=uint8, compu {phys=raw}, range phys 0..255
          signal TPBLEParameter_FBD_SMR_FBD_SML_Byte59: start 472, 8 bit, little-endian, data-type-policy=OVERRIDE, base-type=uint8, compu {phys=raw}, range phys 0..255
          signal TPBLEParameter_FBD_SMR_FBD_SML_Byte60: start 480, 8 bit, little-endian, data-type-policy=OVERRIDE, base-type=uint8, compu {phys=raw}, range phys 0..255
          signal TPBLEParameter_FBD_SMR_FBD_SML_Byte61: start 488, 8 bit, little-endian, data-type-policy=OVERRIDE, base-type=uint8, compu {phys=raw}, range phys 0..255
          signal TPBLEParameter_FBD_SMR_FBD_SML_Byte62: start 496, 8 bit, little-endian, data-type-policy=OVERRIDE, base-type=uint8, compu {phys=raw}, range phys 0..255
          signal TPBLEParameter_FBD_SMR_FBD_SML_Byte63: start 504, 8 bit, little-endian, data-type-policy=OVERRIDE, base-type=uint8, compu {phys=raw}, range phys 0..255
      frame TPBLEParameter_FBD_Trunk_FBD_VM: id 0x391, frame-length=64, can-addressing-mode=STANDARD, can-frame-rx-behavior=CAN-FD, can-frame-tx-behavior=CAN-FD
        pdu TPBLEParameter_FBD_Trunk_FBD_VM: length=64, unused-bit-pattern=0
          signal TPBLEParameter_FBD_Trunk_FBD_VM_Byte00: start 0, 8 bit, little-endian, data-type-policy=OVERRIDE, base-type=uint8, compu {phys=raw}, range phys 0..255
          signal TPBLEParameter_FBD_Trunk_FBD_VM_Byte01: start 8, 8 bit, little-endian, data-type-policy=OVERRIDE, base-type=uint8, compu {phys=raw}, range phys 0..255
          signal TPBLEParameter_FBD_Trunk_FBD_VM_Byte02: start 16, 8 bit, little-endian, data-type-policy=OVERRIDE, base-type=uint8, compu {phys=raw}, range phys 0..255
          signal TPBLEParameter_FBD_Trunk_FBD_VM_Byte03: start 24, 8 bit, little-endian, data-type-policy=OVERRIDE, base-type=uint8, compu {phys=raw}, range phys 0..255
          signal TPBLEParameter_FBD_Trunk_FBD_VM_Byte04: start 32, 8 bit, little-endian, data-type-policy=OVERRIDE, base-type=uint8, compu {phys=raw}, range phys 0..255
          signal TPBLEParameter_FBD_Trunk_FBD_VM_Byte05: start 40, 8 bit, little-endian, data-type-policy=OVERRIDE, base-type=uint8, compu {phys=raw}, range phys 0..255
          signal TPBLEParameter_FBD_Trunk_FBD_VM_Byte06: start 48, 8 bit, little-endian, data-type-policy=OVERRIDE, base-type=uint8, compu {phys=raw}, range phys 0..255
          signal TPBLEParameter_FBD_Trunk_FBD_VM_Byte07: start 56, 8 bit, little-endian, data-type-policy=OVERRIDE, base-type=uint8, compu {phys=raw}, range phys 0..255
          signal TPBLEParameter_FBD_Trunk_FBD_VM_Byte08: start 64, 8 bit, little-endian, data-type-policy=OVERRIDE, base-type=uint8, compu {phys=raw}, range phys 0..255
          signal TPBLEParameter_FBD_Trunk_FBD_VM_Byte09: start 72, 8 bit, little-endian, data-type-policy=OVERRIDE, base-type=uint8, compu {phys=raw}, range phys 0..255
          signal TPBLEParameter_FBD_Trunk_FBD_VM_Byte10: start 80, 8 bit, little-endian, data-type-policy=OVERRIDE, base-type=uint8, compu {phys=raw}, range phys 0..255
          signal TPBLEParameter_FBD_Trunk_FBD_VM_Byte11: start 88, 8 bit, little-endian, data-type-policy=OVERRIDE, base-type=uint8, compu {phys=raw}, range phys 0..255
          signal TPBLEParameter_FBD_Trunk_FBD_VM_Byte12: start 96, 8 bit, little-endian, data-type-policy=OVERRIDE, base-type=uint8, compu {phys=raw}, range phys 0..255
          signal TPBLEParameter_FBD_Trunk_FBD_VM_Byte13: start 104, 8 bit, little-endian, data-type-policy=OVERRIDE, base-type=uint8, compu {phys=raw}, range phys 0..255
          signal TPBLEParameter_FBD_Trunk_FBD_VM_Byte14: start 112, 8 bit, little-endian, data-type-policy=OVERRIDE, base-type=uint8, compu {phys=raw}, range phys 0..255
          signal TPBLEParameter_FBD_Trunk_FBD_VM_Byte15: start 120, 8 bit, little-endian, data-type-policy=OVERRIDE, base-type=uint8, compu {phys=raw}, range phys 0..255
          signal TPBLEParameter_FBD_Trunk_FBD_VM_Byte16: start 128, 8 bit, little-endian, data-type-policy=OVERRIDE, base-type=uint8, compu {phys=raw}, range phys 0..255
          signal TPBLEParameter_FBD_Trunk_FBD_VM_Byte17: start 136, 8 bit, little-endian, data-type-policy=OVERRIDE, base-type=uint8, compu {phys=raw}, range phys 0..255
          signal TPBLEParameter_FBD_Trunk_FBD_VM_Byte18: start 144, 8 bit, little-endian, data-type-policy=OVERRIDE, base-type=uint8, compu {phys=raw}, range phys 0..255
          signal TPBLEParameter_FBD_Trunk_FBD_VM_Byte19: start 152, 8 bit, little-endian, data-type-policy=OVERRIDE, base-type=uint8, compu {phys=raw}, range phys 0..255
          signal TPBLEParameter_FBD_Trunk_FBD_VM_Byte20: start 160, 8 bit, little-endian, data-type-policy=OVERRIDE, base-type=uint8, compu {phys=raw}, range phys 0..255
          signal TPBLEParameter_FBD_Trunk_FBD_VM_Byte21: start 168, 8 bit, little-endian, data-type-policy=OVERRIDE, base-type=uint8, compu {phys=raw}, range phys 0..255
          signal TPBLEParameter_FBD_Trunk_FBD_VM_Byte22: start 176, 8 bit, little-endian, data-type-policy=OVERRIDE, base-type=uint8, compu {phys=raw}, range phys 0..255
          signal TPBLEParameter_FBD_Trunk_FBD_VM_Byte23: start 184, 8 bit, little-endian, data-type-policy=OVERRIDE, base-type=uint8, compu {phys=raw}, range phys 0..255
          signal TPBLEParameter_FBD_Trunk_FBD_VM_Byte24: start 192, 8 bit, little-endian, data-type-policy=OVERRIDE, base-type=uint8, compu {phys=raw}, range phys 0..255
          signal TPBLEParameter_FBD_Trunk_FBD_VM_Byte25: start 200, 8 bit, little-endian, data-type-policy=OVERRIDE, base-type=uint8, compu {phys=raw}, range phys 0..255
          signal TPBLEParameter_FBD_Trunk_FBD_VM_Byte26: start 208, 8 bit, little-endian, data-type-policy=OVERRIDE, base-type=uint8, compu {phys=raw}, range phys 0..255
          signal TPBLEParameter_FBD_Trunk_FBD_VM_Byte27: start 216, 8 bit, little-endian, data-type-policy=OVERRIDE, base-type=uint8, compu {phys=raw}, range phys 0..255
          signal TPBLEParameter_FBD_Trunk_FBD_VM_Byte28: start 224, 8 bit, little-endian, data-type-policy=OVERRIDE, base-type=uint8, compu {phys=raw}, range phys 0..255
          signal TPBLEParameter_FBD_Trunk_FBD_VM_Byte29: start 232, 8 bit, little-endian, data-type-policy=OVERRIDE, base-type=uint8, compu {phys=raw}, range phys 0..255
          signal TPBLEParameter_FBD_Trunk_FBD_VM_Byte30: start 240, 8 bit, little-endian, data-type-policy=OVERRIDE, base-type=uint8, compu {phys=raw}, range phys 0..255
          signal TPBLEParameter_FBD_Trunk_FBD_VM_Byte31: start 248, 8 bit, little-endian, data-type-policy=OVERRIDE, base-type=uint8, compu {phys=raw}, range phys 0..255
          signal TPBLEParameter_FBD_Trunk_FBD_VM_Byte32: start 256, 8 bit, little-endian, data-type-policy=OVERRIDE, base-type=uint8, compu {phys=raw}, range phys 0..255
          signal TPBLEParameter_FBD_Trunk_FBD_VM_Byte33: start 264, 8 bit, little-endian, data-type-policy=OVERRIDE, base-type=uint8, compu {phys=raw}, range phys 0..255
          signal TPBLEParameter_FBD_Trunk_FBD_VM_Byte34: start 272, 8 bit, little-endian, data-type-policy=OVERRIDE, base-type=uint8, compu {phys=raw}, range phys 0..255
          signal TPBLEParameter_FBD_Trunk_FBD_VM_Byte35: start 280, 8 bit, little-endian, data-type-policy=OVERRIDE, base-type=uint8, compu {phys=raw}, range phys 0..255
          signal TPBLEParameter_FBD_Trunk_FBD_VM_Byte36: start 288, 8 bit, little-endian, data-type-policy=OVERRIDE, base-type=uint8, compu {phys=raw}, range phys 0..255
          signal TPBLEParameter_FBD_Trunk_FBD_VM_Byte37: start 296, 8 bit, little-endian, data-type-policy=OVERRIDE, base-type=uint8, compu {phys=raw}, range phys 0..255
          signal TPBLEParameter_FBD_Trunk_FBD_VM_Byte38: start 304, 8 bit, little-endian, data-type-policy=OVERRIDE, base-type=uint8, compu {phys=raw}, range phys 0..255
          signal TPBLEParameter_FBD_Trunk_FBD_VM_Byte39: start 312, 8 bit, little-endian, data-type-policy=OVERRIDE, base-type=uint8, compu {phys=raw}, range phys 0..255
          signal TPBLEParameter_FBD_Trunk_FBD_VM_Byte40: start 320, 8 bit, little-endian, data-type-policy=OVERRIDE, base-type=uint8, compu {phys=raw}, range phys 0..255
          signal TPBLEParameter_FBD_Trunk_FBD_VM_Byte41: start 328, 8 bit, little-endian, data-type-policy=OVERRIDE, base-type=uint8, compu {phys=raw}, range phys 0..255
          signal TPBLEParameter_FBD_Trunk_FBD_VM_Byte42: start 336, 8 bit, little-endian, data-type-policy=OVERRIDE, base-type=uint8, compu {phys=raw}, range phys 0..255
          signal TPBLEParameter_FBD_Trunk_FBD_VM_Byte43: start 344, 8 bit, little-endian, data-type-policy=OVERRIDE, base-type=uint8, compu {phys=raw}, range phys 0..255
          signal TPBLEParameter_FBD_Trunk_FBD_VM_Byte44: start 352, 8 bit, little-endian, data-type-policy=OVERRIDE, base-type=uint8, compu {phys=raw}, range phys 0..255
          signal TPBLEParameter_FBD_Trunk_FBD_VM_Byte45: start 360, 8 bit, little-endian, data-type-policy=OVERRIDE, base-type=uint8, compu {phys=raw}, range phys 0..255
          signal TPBLEParameter_FBD_Trunk_FBD_VM_Byte46: start 368, 8 bit, little-endian, data-type-policy=OVERRIDE, base-type=uint8, compu {phys=raw}, range phys 0..255
          signal TPBLEParameter_FBD_Trunk_FBD_VM_Byte47: start 376, 8 bit, little-endian, data-type-policy=OVERRIDE, base-type=uint8, compu {phys=raw}, range phys 0..255
          signal TPBLEParameter_FBD_Trunk_FBD_VM_Byte48: start 384, 8 bit, little-endian, data-type-policy=OVERRIDE, base-type=uint8, compu {phys=raw}, range phys 0..255
          signal TPBLEParameter_FBD_Trunk_FBD_VM_Byte49: start 392, 8 bit, little-endian, data-type-policy=OVERRIDE, base-type=uint8, compu {phys=raw}, range phys 0..255
          signal TPBLEParameter_FBD_Trunk_FBD_VM_Byte50: start 400, 8 bit, little-endian, data-type-policy=OVERRIDE, base-type=uint8, compu {phys=raw}, range phys 0..255
          signal TPBLEParameter_FBD_Trunk_FBD_VM_Byte51: start 408, 8 bit, little-endian, data-type-policy=OVERRIDE, base-type=uint8, compu {phys=raw}, range phys 0..255
          signal TPBLEParameter_FBD_Trunk_FBD_VM_Byte52: start 416, 8 bit, little-endian, data-type-policy=OVERRIDE, base-type=uint8, compu {phys=raw}, range phys 0..255
          signal TPBLEParameter_FBD_Trunk_FBD_VM_Byte53: start 424, 8 bit, little-endian, data-type-policy=OVERRIDE, base-type=uint8, compu {phys=raw}, range phys 0..255
          signal TPBLEParameter_FBD_Trunk_FBD_VM_Byte54: start 432, 8 bit, little-endian, data-type-policy=OVERRIDE, base-type=uint8, compu {phys=raw}, range phys 0..255
          signal TPBLEParameter_FBD_Trunk_FBD_VM_Byte55: start 440, 8 bit, little-endian, data-type-policy=OVERRIDE, base-type=uint8, compu {phys=raw}, range phys 0..255
          signal TPBLEParameter_FBD_Trunk_FBD_VM_Byte56: start 448, 8 bit, little-endian, data-type-policy=OVERRIDE, base-type=uint8, compu {phys=raw}, range phys 0..255
          signal TPBLEParameter_FBD_Trunk_FBD_VM_Byte57: start 456, 8 bit, little-endian, data-type-policy=OVERRIDE, base-type=uint8, compu {phys=raw}, range phys 0..255
          signal TPBLEParameter_FBD_Trunk_FBD_VM_Byte58: start 464, 8 bit, little-endian, data-type-policy=OVERRIDE, base-type=uint8, compu {phys=raw}, range phys 0..255
          signal TPBLEParameter_FBD_Trunk_FBD_VM_Byte59: start 472, 8 bit, little-endian, data-type-policy=OVERRIDE, base-type=uint8, compu {phys=raw}, range phys 0..255
          signal TPBLEParameter_FBD_Trunk_FBD_VM_Byte60: start 480, 8 bit, little-endian, data-type-policy=OVERRIDE, base-type=uint8, compu {phys=raw}, range phys 0..255
          signal TPBLEParameter_FBD_Trunk_FBD_VM_Byte61: start 488, 8 bit, little-endian, data-type-policy=OVERRIDE, base-type=uint8, compu {phys=raw}, range phys 0..255
          signal TPBLEParameter_FBD_Trunk_FBD_VM_Byte62: start 496, 8 bit, little-endian, data-type-policy=OVERRIDE, base-type=uint8, compu {phys=raw}, range phys 0..255
          signal TPBLEParameter_FBD_Trunk_FBD_VM_Byte63: start 504, 8 bit, little-endian, data-type-policy=OVERRIDE, base-type=uint8, compu {phys=raw}, range phys 0..255
      frame TPBLEParameter_FBD_VL_FBD_VM: id 0x392, frame-length=64, can-addressing-mode=STANDARD, can-frame-rx-behavior=CAN-FD, can-frame-tx-behavior=CAN-FD
        pdu TPBLEParameter_FBD_VL_FBD_VM: length=64, unused-bit-pattern=0
          signal TPBLEParameter_FBD_VL_FBD_VM_Byte00: start 0, 8 bit, little-endian, data-type-policy=OVERRIDE, base-type=uint8, compu {phys=raw}, range phys 0..255
          signal TPBLEParameter_FBD_VL_FBD_VM_Byte01: start 8, 8 bit, little-endian, data-type-policy=OVERRIDE, base-type=uint8, compu {phys=raw}, range phys 0..255
          signal TPBLEParameter_FBD_VL_FBD_VM_Byte02: start 16, 8 bit, little-endian, data-type-policy=OVERRIDE, base-type=uint8, compu {phys=raw}, range phys 0..255
          signal TPBLEParameter_FBD_VL_FBD_VM_Byte03: start 24, 8 bit, little-endian, data-type-policy=OVERRIDE, base-type=uint8, compu {phys=raw}, range phys 0..255
          signal TPBLEParameter_FBD_VL_FBD_VM_Byte04: start 32, 8 bit, little-endian, data-type-policy=OVERRIDE, base-type=uint8, compu {phys=raw}, range phys 0..255
          signal TPBLEParameter_FBD_VL_FBD_VM_Byte05: start 40, 8 bit, little-endian, data-type-policy=OVERRIDE, base-type=uint8, compu {phys=raw}, range phys 0..255
          signal TPBLEParameter_FBD_VL_FBD_VM_Byte06: start 48, 8 bit, little-endian, data-type-policy=OVERRIDE, base-type=uint8, compu {phys=raw}, range phys 0..255
          signal TPBLEParameter_FBD_VL_FBD_VM_Byte07: start 56, 8 bit, little-endian, data-type-policy=OVERRIDE, base-type=uint8, compu {phys=raw}, range phys 0..255
          signal TPBLEParameter_FBD_VL_FBD_VM_Byte08: start 64, 8 bit, little-endian, data-type-policy=OVERRIDE, base-type=uint8, compu {phys=raw}, range phys 0..255
          signal TPBLEParameter_FBD_VL_FBD_VM_Byte09: start 72, 8 bit, little-endian, data-type-policy=OVERRIDE, base-type=uint8, compu {phys=raw}, range phys 0..255
          signal TPBLEParameter_FBD_VL_FBD_VM_Byte10: start 80, 8 bit, little-endian, data-type-policy=OVERRIDE, base-type=uint8, compu {phys=raw}, range phys 0..255
          signal TPBLEParameter_FBD_VL_FBD_VM_Byte11: start 88, 8 bit, little-endian, data-type-policy=OVERRIDE, base-type=uint8, compu {phys=raw}, range phys 0..255
          signal TPBLEParameter_FBD_VL_FBD_VM_Byte12: start 96, 8 bit, little-endian, data-type-policy=OVERRIDE, base-type=uint8, compu {phys=raw}, range phys 0..255
          signal TPBLEParameter_FBD_VL_FBD_VM_Byte13: start 104, 8 bit, little-endian, data-type-policy=OVERRIDE, base-type=uint8, compu {phys=raw}, range phys 0..255
          signal TPBLEParameter_FBD_VL_FBD_VM_Byte14: start 112, 8 bit, little-endian, data-type-policy=OVERRIDE, base-type=uint8, compu {phys=raw}, range phys 0..255
          signal TPBLEParameter_FBD_VL_FBD_VM_Byte15: start 120, 8 bit, little-endian, data-type-policy=OVERRIDE, base-type=uint8, compu {phys=raw}, range phys 0..255
          signal TPBLEParameter_FBD_VL_FBD_VM_Byte16: start 128, 8 bit, little-endian, data-type-policy=OVERRIDE, base-type=uint8, compu {phys=raw}, range phys 0..255
          signal TPBLEParameter_FBD_VL_FBD_VM_Byte17: start 136, 8 bit, little-endian, data-type-policy=OVERRIDE, base-type=uint8, compu {phys=raw}, range phys 0..255
          signal TPBLEParameter_FBD_VL_FBD_VM_Byte18: start 144, 8 bit, little-endian, data-type-policy=OVERRIDE, base-type=uint8, compu {phys=raw}, range phys 0..255
          signal TPBLEParameter_FBD_VL_FBD_VM_Byte19: start 152, 8 bit, little-endian, data-type-policy=OVERRIDE, base-type=uint8, compu {phys=raw}, range phys 0..255
          signal TPBLEParameter_FBD_VL_FBD_VM_Byte20: start 160, 8 bit, little-endian, data-type-policy=OVERRIDE, base-type=uint8, compu {phys=raw}, range phys 0..255
          signal TPBLEParameter_FBD_VL_FBD_VM_Byte21: start 168, 8 bit, little-endian, data-type-policy=OVERRIDE, base-type=uint8, compu {phys=raw}, range phys 0..255
          signal TPBLEParameter_FBD_VL_FBD_VM_Byte22: start 176, 8 bit, little-endian, data-type-policy=OVERRIDE, base-type=uint8, compu {phys=raw}, range phys 0..255
          signal TPBLEParameter_FBD_VL_FBD_VM_Byte23: start 184, 8 bit, little-endian, data-type-policy=OVERRIDE, base-type=uint8, compu {phys=raw}, range phys 0..255
          signal TPBLEParameter_FBD_VL_FBD_VM_Byte24: start 192, 8 bit, little-endian, data-type-policy=OVERRIDE, base-type=uint8, compu {phys=raw}, range phys 0..255
          signal TPBLEParameter_FBD_VL_FBD_VM_Byte25: start 200, 8 bit, little-endian, data-type-policy=OVERRIDE, base-type=uint8, compu {phys=raw}, range phys 0..255
          signal TPBLEParameter_FBD_VL_FBD_VM_Byte26: start 208, 8 bit, little-endian, data-type-policy=OVERRIDE, base-type=uint8, compu {phys=raw}, range phys 0..255
          signal TPBLEParameter_FBD_VL_FBD_VM_Byte27: start 216, 8 bit, little-endian, data-type-policy=OVERRIDE, base-type=uint8, compu {phys=raw}, range phys 0..255
          signal TPBLEParameter_FBD_VL_FBD_VM_Byte28: start 224, 8 bit, little-endian, data-type-policy=OVERRIDE, base-type=uint8, compu {phys=raw}, range phys 0..255
          signal TPBLEParameter_FBD_VL_FBD_VM_Byte29: start 232, 8 bit, little-endian, data-type-policy=OVERRIDE, base-type=uint8, compu {phys=raw}, range phys 0..255
          signal TPBLEParameter_FBD_VL_FBD_VM_Byte30: start 240, 8 bit, little-endian, data-type-policy=OVERRIDE, base-type=uint8, compu {phys=raw}, range phys 0..255
          signal TPBLEParameter_FBD_VL_FBD_VM_Byte31: start 248, 8 bit, little-endian, data-type-policy=OVERRIDE, base-type=uint8, compu {phys=raw}, range phys 0..255
          signal TPBLEParameter_FBD_VL_FBD_VM_Byte32: start 256, 8 bit, little-endian, data-type-policy=OVERRIDE, base-type=uint8, compu {phys=raw}, range phys 0..255
          signal TPBLEParameter_FBD_VL_FBD_VM_Byte33: start 264, 8 bit, little-endian, data-type-policy=OVERRIDE, base-type=uint8, compu {phys=raw}, range phys 0..255
          signal TPBLEParameter_FBD_VL_FBD_VM_Byte34: start 272, 8 bit, little-endian, data-type-policy=OVERRIDE, base-type=uint8, compu {phys=raw}, range phys 0..255
          signal TPBLEParameter_FBD_VL_FBD_VM_Byte35: start 280, 8 bit, little-endian, data-type-policy=OVERRIDE, base-type=uint8, compu {phys=raw}, range phys 0..255
          signal TPBLEParameter_FBD_VL_FBD_VM_Byte36: start 288, 8 bit, little-endian, data-type-policy=OVERRIDE, base-type=uint8, compu {phys=raw}, range phys 0..255
          signal TPBLEParameter_FBD_VL_FBD_VM_Byte37: start 296, 8 bit, little-endian, data-type-policy=OVERRIDE, base-type=uint8, compu {phys=raw}, range phys 0..255
          signal TPBLEParameter_FBD_VL_FBD_VM_Byte38: start 304, 8 bit, little-endian, data-type-policy=OVERRIDE, base-type=uint8, compu {phys=raw}, range phys 0..255
          signal TPBLEParameter_FBD_VL_FBD_VM_Byte39: start 312, 8 bit, little-endian, data-type-policy=OVERRIDE, base-type=uint8, compu {phys=raw}, range phys 0..255
          signal TPBLEParameter_FBD_VL_FBD_VM_Byte40: start 320, 8 bit, little-endian, data-type-policy=OVERRIDE, base-type=uint8, compu {phys=raw}, range phys 0..255
          signal TPBLEParameter_FBD_VL_FBD_VM_Byte41: start 328, 8 bit, little-endian, data-type-policy=OVERRIDE, base-type=uint8, compu {phys=raw}, range phys 0..255
          signal TPBLEParameter_FBD_VL_FBD_VM_Byte42: start 336, 8 bit, little-endian, data-type-policy=OVERRIDE, base-type=uint8, compu {phys=raw}, range phys 0..255
          signal TPBLEParameter_FBD_VL_FBD_VM_Byte43: start 344, 8 bit, little-endian, data-type-policy=OVERRIDE, base-type=uint8, compu {phys=raw}, range phys 0..255
          signal TPBLEParameter_FBD_VL_FBD_VM_Byte44: start 352, 8 bit, little-endian, data-type-policy=OVERRIDE, base-type=uint8, compu {phys=raw}, range phys 0..255
          signal TPBLEParameter_FBD_VL_FBD_VM_Byte45: start 360, 8 bit, little-endian, data-type-policy=OVERRIDE, base-type=uint8, compu {phys=raw}, range phys 0..255
          signal TPBLEParameter_FBD_VL_FBD_VM_Byte46: start 368, 8 bit, little-endian, data-type-policy=OVERRIDE, base-type=uint8, compu {phys=raw}, range phys 0..255
          signal TPBLEParameter_FBD_VL_FBD_VM_Byte47: start 376, 8 bit, little-endian, data-type-policy=OVERRIDE, base-type=uint8, compu {phys=raw}, range phys 0..255
          signal TPBLEParameter_FBD_VL_FBD_VM_Byte48: start 384, 8 bit, little-endian, data-type-policy=OVERRIDE, base-type=uint8, compu {phys=raw}, range phys 0..255
          signal TPBLEParameter_FBD_VL_FBD_VM_Byte49: start 392, 8 bit, little-endian, data-type-policy=OVERRIDE, base-type=uint8, compu {phys=raw}, range phys 0..255
          signal TPBLEParameter_FBD_VL_FBD_VM_Byte50: start 400, 8 bit, little-endian, data-type-policy=OVERRIDE, base-type=uint8, compu {phys=raw}, range phys 0..255
          signal TPBLEParameter_FBD_VL_FBD_VM_Byte51: start 408, 8 bit, little-endian, data-type-policy=OVERRIDE, base-type=uint8, compu {phys=raw}, range phys 0..255
          signal TPBLEParameter_FBD_VL_FBD_VM_Byte52: start 416, 8 bit, little-endian, data-type-policy=OVERRIDE, base-type=uint8, compu {phys=raw}, range phys 0..255
          signal TPBLEParameter_FBD_VL_FBD_VM_Byte53: start 424, 8 bit, little-endian, data-type-policy=OVERRIDE, base-type=uint8, compu {phys=raw}, range phys 0..255
          signal TPBLEParameter_FBD_VL_FBD_VM_Byte54: start 432, 8 bit, little-endian, data-type-policy=OVERRIDE, base-type=uint8, compu {phys=raw}, range phys 0..255
          signal TPBLEParameter_FBD_VL_FBD_VM_Byte55: start 440, 8 bit, little-endian, data-type-policy=OVERRIDE, base-type=uint8, compu {phys=raw}, range phys 0..255
          signal TPBLEParameter_FBD_VL_FBD_VM_Byte56: start 448, 8 bit, little-endian, data-type-policy=OVERRIDE, base-type=uint8, compu {phys=raw}, range phys 0..255
          signal TPBLEParameter_FBD_VL_FBD_VM_Byte57: start 456, 8 bit, little-endian, data-type-policy=OVERRIDE, base-type=uint8, compu {phys=raw}, range phys 0..255
          signal TPBLEParameter_FBD_VL_FBD_VM_Byte58: start 464, 8 bit, little-endian, data-type-policy=OVERRIDE, base-type=uint8, compu {phys=raw}, range phys 0..255
          signal TPBLEParameter_FBD_VL_FBD_VM_Byte59: start 472, 8 bit, little-endian, data-type-policy=OVERRIDE, base-type=uint8, compu {phys=raw}, range phys 0..255
          signal TPBLEParameter_FBD_VL_FBD_VM_Byte60: start 480, 8 bit, little-endian, data-type-policy=OVERRIDE, base-type=uint8, compu {phys=raw}, range phys 0..255
          signal TPBLEParameter_FBD_VL_FBD_VM_Byte61: start 488, 8 bit, little-endian, data-type-policy=OVERRIDE, base-type=uint8, compu {phys=raw}, range phys 0..255
          signal TPBLEParameter_FBD_VL_FBD_VM_Byte62: start 496, 8 bit, little-endian, data-type-policy=OVERRIDE, base-type=uint8, compu {phys=raw}, range phys 0..255
          signal TPBLEParameter_FBD_VL_FBD_VM_Byte63: start 504, 8 bit, little-endian, data-type-policy=OVERRIDE, base-type=uint8, compu {phys=raw}, range phys 0..255
      frame TPBLEParameter_FBD_VM_FBD_HL: id 0x38A, frame-length=64, can-addressing-mode=STANDARD, can-frame-rx-behavior=CAN-FD, can-frame-tx-behavior=CAN-FD
        pdu TPBLEParameter_FBD_VM_FBD_HL: length=64, unused-bit-pattern=0
          signal TPBLEParameter_FBD_VM_FBD_HL_Byte00: start 0, 8 bit, little-endian, data-type-policy=OVERRIDE, base-type=uint8, compu {phys=raw}, range phys 0..255
          signal TPBLEParameter_FBD_VM_FBD_HL_Byte01: start 8, 8 bit, little-endian, data-type-policy=OVERRIDE, base-type=uint8, compu {phys=raw}, range phys 0..255
          signal TPBLEParameter_FBD_VM_FBD_HL_Byte02: start 16, 8 bit, little-endian, data-type-policy=OVERRIDE, base-type=uint8, compu {phys=raw}, range phys 0..255
          signal TPBLEParameter_FBD_VM_FBD_HL_Byte03: start 24, 8 bit, little-endian, data-type-policy=OVERRIDE, base-type=uint8, compu {phys=raw}, range phys 0..255
          signal TPBLEParameter_FBD_VM_FBD_HL_Byte04: start 32, 8 bit, little-endian, data-type-policy=OVERRIDE, base-type=uint8, compu {phys=raw}, range phys 0..255
          signal TPBLEParameter_FBD_VM_FBD_HL_Byte05: start 40, 8 bit, little-endian, data-type-policy=OVERRIDE, base-type=uint8, compu {phys=raw}, range phys 0..255
          signal TPBLEParameter_FBD_VM_FBD_HL_Byte06: start 48, 8 bit, little-endian, data-type-policy=OVERRIDE, base-type=uint8, compu {phys=raw}, range phys 0..255
          signal TPBLEParameter_FBD_VM_FBD_HL_Byte07: start 56, 8 bit, little-endian, data-type-policy=OVERRIDE, base-type=uint8, compu {phys=raw}, range phys 0..255
          signal TPBLEParameter_FBD_VM_FBD_HL_Byte08: start 64, 8 bit, little-endian, data-type-policy=OVERRIDE, base-type=uint8, compu {phys=raw}, range phys 0..255
          signal TPBLEParameter_FBD_VM_FBD_HL_Byte09: start 72, 8 bit, little-endian, data-type-policy=OVERRIDE, base-type=uint8, compu {phys=raw}, range phys 0..255
          signal TPBLEParameter_FBD_VM_FBD_HL_Byte10: start 80, 8 bit, little-endian, data-type-policy=OVERRIDE, base-type=uint8, compu {phys=raw}, range phys 0..255
          signal TPBLEParameter_FBD_VM_FBD_HL_Byte11: start 88, 8 bit, little-endian, data-type-policy=OVERRIDE, base-type=uint8, compu {phys=raw}, range phys 0..255
          signal TPBLEParameter_FBD_VM_FBD_HL_Byte12: start 96, 8 bit, little-endian, data-type-policy=OVERRIDE, base-type=uint8, compu {phys=raw}, range phys 0..255
          signal TPBLEParameter_FBD_VM_FBD_HL_Byte13: start 104, 8 bit, little-endian, data-type-policy=OVERRIDE, base-type=uint8, compu {phys=raw}, range phys 0..255
          signal TPBLEParameter_FBD_VM_FBD_HL_Byte14: start 112, 8 bit, little-endian, data-type-policy=OVERRIDE, base-type=uint8, compu {phys=raw}, range phys 0..255
          signal TPBLEParameter_FBD_VM_FBD_HL_Byte15: start 120, 8 bit, little-endian, data-type-policy=OVERRIDE, base-type=uint8, compu {phys=raw}, range phys 0..255
          signal TPBLEParameter_FBD_VM_FBD_HL_Byte16: start 128, 8 bit, little-endian, data-type-policy=OVERRIDE, base-type=uint8, compu {phys=raw}, range phys 0..255
          signal TPBLEParameter_FBD_VM_FBD_HL_Byte17: start 136, 8 bit, little-endian, data-type-policy=OVERRIDE, base-type=uint8, compu {phys=raw}, range phys 0..255
          signal TPBLEParameter_FBD_VM_FBD_HL_Byte18: start 144, 8 bit, little-endian, data-type-policy=OVERRIDE, base-type=uint8, compu {phys=raw}, range phys 0..255
          signal TPBLEParameter_FBD_VM_FBD_HL_Byte19: start 152, 8 bit, little-endian, data-type-policy=OVERRIDE, base-type=uint8, compu {phys=raw}, range phys 0..255
          signal TPBLEParameter_FBD_VM_FBD_HL_Byte20: start 160, 8 bit, little-endian, data-type-policy=OVERRIDE, base-type=uint8, compu {phys=raw}, range phys 0..255
          signal TPBLEParameter_FBD_VM_FBD_HL_Byte21: start 168, 8 bit, little-endian, data-type-policy=OVERRIDE, base-type=uint8, compu {phys=raw}, range phys 0..255
          signal TPBLEParameter_FBD_VM_FBD_HL_Byte22: start 176, 8 bit, little-endian, data-type-policy=OVERRIDE, base-type=uint8, compu {phys=raw}, range phys 0..255
          signal TPBLEParameter_FBD_VM_FBD_HL_Byte23: start 184, 8 bit, little-endian, data-type-policy=OVERRIDE, base-type=uint8, compu {phys=raw}, range phys 0..255
          signal TPBLEParameter_FBD_VM_FBD_HL_Byte24: start 192, 8 bit, little-endian, data-type-policy=OVERRIDE, base-type=uint8, compu {phys=raw}, range phys 0..255
          signal TPBLEParameter_FBD_VM_FBD_HL_Byte25: start 200, 8 bit, little-endian, data-type-policy=OVERRIDE, base-type=uint8, compu {phys=raw}, range phys 0..255
          signal TPBLEParameter_FBD_VM_FBD_HL_Byte26: start 208, 8 bit, little-endian, data-type-policy=OVERRIDE, base-type=uint8, compu {phys=raw}, range phys 0..255
          signal TPBLEParameter_FBD_VM_FBD_HL_Byte27: start 216, 8 bit, little-endian, data-type-policy=OVERRIDE, base-type=uint8, compu {phys=raw}, range phys 0..255
          signal TPBLEParameter_FBD_VM_FBD_HL_Byte28: start 224, 8 bit, little-endian, data-type-policy=OVERRIDE, base-type=uint8, compu {phys=raw}, range phys 0..255
          signal TPBLEParameter_FBD_VM_FBD_HL_Byte29: start 232, 8 bit, little-endian, data-type-policy=OVERRIDE, base-type=uint8, compu {phys=raw}, range phys 0..255
          signal TPBLEParameter_FBD_VM_FBD_HL_Byte30: start 240, 8 bit, little-endian, data-type-policy=OVERRIDE, base-type=uint8, compu {phys=raw}, range phys 0..255
          signal TPBLEParameter_FBD_VM_FBD_HL_Byte31: start 248, 8 bit, little-endian, data-type-policy=OVERRIDE, base-type=uint8, compu {phys=raw}, range phys 0..255
          signal TPBLEParameter_FBD_VM_FBD_HL_Byte32: start 256, 8 bit, little-endian, data-type-policy=OVERRIDE, base-type=uint8, compu {phys=raw}, range phys 0..255
          signal TPBLEParameter_FBD_VM_FBD_HL_Byte33: start 264, 8 bit, little-endian, data-type-policy=OVERRIDE, base-type=uint8, compu {phys=raw}, range phys 0..255
          signal TPBLEParameter_FBD_VM_FBD_HL_Byte34: start 272, 8 bit, little-endian, data-type-policy=OVERRIDE, base-type=uint8, compu {phys=raw}, range phys 0..255
          signal TPBLEParameter_FBD_VM_FBD_HL_Byte35: start 280, 8 bit, little-endian, data-type-policy=OVERRIDE, base-type=uint8, compu {phys=raw}, range phys 0..255
          signal TPBLEParameter_FBD_VM_FBD_HL_Byte36: start 288, 8 bit, little-endian, data-type-policy=OVERRIDE, base-type=uint8, compu {phys=raw}, range phys 0..255
          signal TPBLEParameter_FBD_VM_FBD_HL_Byte37: start 296, 8 bit, little-endian, data-type-policy=OVERRIDE, base-type=uint8, compu {phys=raw}, range phys 0..255
          signal TPBLEParameter_FBD_VM_FBD_HL_Byte38: start 304, 8 bit, little-endian, data-type-policy=OVERRIDE, base-type=uint8, compu {phys=raw}, range phys 0..255
          signal TPBLEParameter_FBD_VM_FBD_HL_Byte39: start 312, 8 bit, little-endian, data-type-policy=OVERRIDE, base-type=uint8, compu {phys=raw}, range phys 0..255
          signal TPBLEParameter_FBD_VM_FBD_HL_Byte40: start 320, 8 bit, little-endian, data-type-policy=OVERRIDE, base-type=uint8, compu {phys=raw}, range phys 0..255
          signal TPBLEParameter_FBD_VM_FBD_HL_Byte41: start 328, 8 bit, little-endian, data-type-policy=OVERRIDE, base-type=uint8, compu {phys=raw}, range phys 0..255
          signal TPBLEParameter_FBD_VM_FBD_HL_Byte42: start 336, 8 bit, little-endian, data-type-policy=OVERRIDE, base-type=uint8, compu {phys=raw}, range phys 0..255
          signal TPBLEParameter_FBD_VM_FBD_HL_Byte43: start 344, 8 bit, little-endian, data-type-policy=OVERRIDE, base-type=uint8, compu {phys=raw}, range phys 0..255
          signal TPBLEParameter_FBD_VM_FBD_HL_Byte44: start 352, 8 bit, little-endian, data-type-policy=OVERRIDE, base-type=uint8, compu {phys=raw}, range phys 0..255
          signal TPBLEParameter_FBD_VM_FBD_HL_Byte45: start 360, 8 bit, little-endian, data-type-policy=OVERRIDE, base-type=uint8, compu {phys=raw}, range phys 0..255
          signal TPBLEParameter_FBD_VM_FBD_HL_Byte46: start 368, 8 bit, little-endian, data-type-policy=OVERRIDE, base-type=uint8, compu {phys=raw}, range phys 0..255
          signal TPBLEParameter_FBD_VM_FBD_HL_Byte47: start 376, 8 bit, little-endian, data-type-policy=OVERRIDE, base-type=uint8, compu {phys=raw}, range phys 0..255
          signal TPBLEParameter_FBD_VM_FBD_HL_Byte48: start 384, 8 bit, little-endian, data-type-policy=OVERRIDE, base-type=uint8, compu {phys=raw}, range phys 0..255
          signal TPBLEParameter_FBD_VM_FBD_HL_Byte49: start 392, 8 bit, little-endian, data-type-policy=OVERRIDE, base-type=uint8, compu {phys=raw}, range phys 0..255
          signal TPBLEParameter_FBD_VM_FBD_HL_Byte50: start 400, 8 bit, little-endian, data-type-policy=OVERRIDE, base-type=uint8, compu {phys=raw}, range phys 0..255
          signal TPBLEParameter_FBD_VM_FBD_HL_Byte51: start 408, 8 bit, little-endian, data-type-policy=OVERRIDE, base-type=uint8, compu {phys=raw}, range phys 0..255
          signal TPBLEParameter_FBD_VM_FBD_HL_Byte52: start 416, 8 bit, little-endian, data-type-policy=OVERRIDE, base-type=uint8, compu {phys=raw}, range phys 0..255
          signal TPBLEParameter_FBD_VM_FBD_HL_Byte53: start 424, 8 bit, little-endian, data-type-policy=OVERRIDE, base-type=uint8, compu {phys=raw}, range phys 0..255
          signal TPBLEParameter_FBD_VM_FBD_HL_Byte54: start 432, 8 bit, little-endian, data-type-policy=OVERRIDE, base-type=uint8, compu {phys=raw}, range phys 0..255
          signal TPBLEParameter_FBD_VM_FBD_HL_Byte55: start 440, 8 bit, little-endian, data-type-policy=OVERRIDE, base-type=uint8, compu {phys=raw}, range phys 0..255
          signal TPBLEParameter_FBD_VM_FBD_HL_Byte56: start 448, 8 bit, little-endian, data-type-policy=OVERRIDE, base-type=uint8, compu {phys=raw}, range phys 0..255
          signal TPBLEParameter_FBD_VM_FBD_HL_Byte57: start 456, 8 bit, little-endian, data-type-policy=OVERRIDE, base-type=uint8, compu {phys=raw}, range phys 0..255
          signal TPBLEParameter_FBD_VM_FBD_HL_Byte58: start 464, 8 bit, little-endian, data-type-policy=OVERRIDE, base-type=uint8, compu {phys=raw}, range phys 0..255
          signal TPBLEParameter_FBD_VM_FBD_HL_Byte59: start 472, 8 bit, little-endian, data-type-policy=OVERRIDE, base-type=uint8, compu {phys=raw}, range phys 0..255
          signal TPBLEParameter_FBD_VM_FBD_HL_Byte60: start 480, 8 bit, little-endian, data-type-policy=OVERRIDE, base-type=uint8, compu {phys=raw}, range phys 0..255
          signal TPBLEParameter_FBD_VM_FBD_HL_Byte61: start 488, 8 bit, little-endian, data-type-policy=OVERRIDE, base-type=uint8, compu {phys=raw}, range phys 0..255
          signal TPBLEParameter_FBD_VM_FBD_HL_Byte62: start 496, 8 bit, little-endian, data-type-policy=OVERRIDE, base-type=uint8, compu {phys=raw}, range phys 0..255
          signal TPBLEParameter_FBD_VM_FBD_HL_Byte63: start 504, 8 bit, little-endian, data-type-policy=OVERRIDE, base-type=uint8, compu {phys=raw}, range phys 0..255
      frame TPBLEParameter_FBD_VM_FBD_HM: id 0x385, frame-length=64, can-addressing-mode=STANDARD, can-frame-rx-behavior=CAN-FD, can-frame-tx-behavior=CAN-FD
        pdu TPBLEParameter_FBD_VM_FBD_HM: length=64, unused-bit-pattern=0
          signal TPBLEParameter_FBD_VM_FBD_HM_Byte00: start 0, 8 bit, little-endian, data-type-policy=OVERRIDE, base-type=uint8, compu {phys=raw}, range phys 0..255
          signal TPBLEParameter_FBD_VM_FBD_HM_Byte01: start 8, 8 bit, little-endian, data-type-policy=OVERRIDE, base-type=uint8, compu {phys=raw}, range phys 0..255
          signal TPBLEParameter_FBD_VM_FBD_HM_Byte02: start 16, 8 bit, little-endian, data-type-policy=OVERRIDE, base-type=uint8, compu {phys=raw}, range phys 0..255
          signal TPBLEParameter_FBD_VM_FBD_HM_Byte03: start 24, 8 bit, little-endian, data-type-policy=OVERRIDE, base-type=uint8, compu {phys=raw}, range phys 0..255
          signal TPBLEParameter_FBD_VM_FBD_HM_Byte04: start 32, 8 bit, little-endian, data-type-policy=OVERRIDE, base-type=uint8, compu {phys=raw}, range phys 0..255
          signal TPBLEParameter_FBD_VM_FBD_HM_Byte05: start 40, 8 bit, little-endian, data-type-policy=OVERRIDE, base-type=uint8, compu {phys=raw}, range phys 0..255
          signal TPBLEParameter_FBD_VM_FBD_HM_Byte06: start 48, 8 bit, little-endian, data-type-policy=OVERRIDE, base-type=uint8, compu {phys=raw}, range phys 0..255
          signal TPBLEParameter_FBD_VM_FBD_HM_Byte07: start 56, 8 bit, little-endian, data-type-policy=OVERRIDE, base-type=uint8, compu {phys=raw}, range phys 0..255
          signal TPBLEParameter_FBD_VM_FBD_HM_Byte08: start 64, 8 bit, little-endian, data-type-policy=OVERRIDE, base-type=uint8, compu {phys=raw}, range phys 0..255
          signal TPBLEParameter_FBD_VM_FBD_HM_Byte09: start 72, 8 bit, little-endian, data-type-policy=OVERRIDE, base-type=uint8, compu {phys=raw}, range phys 0..255
          signal TPBLEParameter_FBD_VM_FBD_HM_Byte10: start 80, 8 bit, little-endian, data-type-policy=OVERRIDE, base-type=uint8, compu {phys=raw}, range phys 0..255
          signal TPBLEParameter_FBD_VM_FBD_HM_Byte11: start 88, 8 bit, little-endian, data-type-policy=OVERRIDE, base-type=uint8, compu {phys=raw}, range phys 0..255
          signal TPBLEParameter_FBD_VM_FBD_HM_Byte12: start 96, 8 bit, little-endian, data-type-policy=OVERRIDE, base-type=uint8, compu {phys=raw}, range phys 0..255
          signal TPBLEParameter_FBD_VM_FBD_HM_Byte13: start 104, 8 bit, little-endian, data-type-policy=OVERRIDE, base-type=uint8, compu {phys=raw}, range phys 0..255
          signal TPBLEParameter_FBD_VM_FBD_HM_Byte14: start 112, 8 bit, little-endian, data-type-policy=OVERRIDE, base-type=uint8, compu {phys=raw}, range phys 0..255
          signal TPBLEParameter_FBD_VM_FBD_HM_Byte15: start 120, 8 bit, little-endian, data-type-policy=OVERRIDE, base-type=uint8, compu {phys=raw}, range phys 0..255
          signal TPBLEParameter_FBD_VM_FBD_HM_Byte16: start 128, 8 bit, little-endian, data-type-policy=OVERRIDE, base-type=uint8, compu {phys=raw}, range phys 0..255
          signal TPBLEParameter_FBD_VM_FBD_HM_Byte17: start 136, 8 bit, little-endian, data-type-policy=OVERRIDE, base-type=uint8, compu {phys=raw}, range phys 0..255
          signal TPBLEParameter_FBD_VM_FBD_HM_Byte18: start 144, 8 bit, little-endian, data-type-policy=OVERRIDE, base-type=uint8, compu {phys=raw}, range phys 0..255
          signal TPBLEParameter_FBD_VM_FBD_HM_Byte19: start 152, 8 bit, little-endian, data-type-policy=OVERRIDE, base-type=uint8, compu {phys=raw}, range phys 0..255
          signal TPBLEParameter_FBD_VM_FBD_HM_Byte20: start 160, 8 bit, little-endian, data-type-policy=OVERRIDE, base-type=uint8, compu {phys=raw}, range phys 0..255
          signal TPBLEParameter_FBD_VM_FBD_HM_Byte21: start 168, 8 bit, little-endian, data-type-policy=OVERRIDE, base-type=uint8, compu {phys=raw}, range phys 0..255
          signal TPBLEParameter_FBD_VM_FBD_HM_Byte22: start 176, 8 bit, little-endian, data-type-policy=OVERRIDE, base-type=uint8, compu {phys=raw}, range phys 0..255
          signal TPBLEParameter_FBD_VM_FBD_HM_Byte23: start 184, 8 bit, little-endian, data-type-policy=OVERRIDE, base-type=uint8, compu {phys=raw}, range phys 0..255
          signal TPBLEParameter_FBD_VM_FBD_HM_Byte24: start 192, 8 bit, little-endian, data-type-policy=OVERRIDE, base-type=uint8, compu {phys=raw}, range phys 0..255
          signal TPBLEParameter_FBD_VM_FBD_HM_Byte25: start 200, 8 bit, little-endian, data-type-policy=OVERRIDE, base-type=uint8, compu {phys=raw}, range phys 0..255
          signal TPBLEParameter_FBD_VM_FBD_HM_Byte26: start 208, 8 bit, little-endian, data-type-policy=OVERRIDE, base-type=uint8, compu {phys=raw}, range phys 0..255
          signal TPBLEParameter_FBD_VM_FBD_HM_Byte27: start 216, 8 bit, little-endian, data-type-policy=OVERRIDE, base-type=uint8, compu {phys=raw}, range phys 0..255
          signal TPBLEParameter_FBD_VM_FBD_HM_Byte28: start 224, 8 bit, little-endian, data-type-policy=OVERRIDE, base-type=uint8, compu {phys=raw}, range phys 0..255
          signal TPBLEParameter_FBD_VM_FBD_HM_Byte29: start 232, 8 bit, little-endian, data-type-policy=OVERRIDE, base-type=uint8, compu {phys=raw}, range phys 0..255
          signal TPBLEParameter_FBD_VM_FBD_HM_Byte30: start 240, 8 bit, little-endian, data-type-policy=OVERRIDE, base-type=uint8, compu {phys=raw}, range phys 0..255
          signal TPBLEParameter_FBD_VM_FBD_HM_Byte31: start 248, 8 bit, little-endian, data-type-policy=OVERRIDE, base-type=uint8, compu {phys=raw}, range phys 0..255
          signal TPBLEParameter_FBD_VM_FBD_HM_Byte32: start 256, 8 bit, little-endian, data-type-policy=OVERRIDE, base-type=uint8, compu {phys=raw}, range phys 0..255
          signal TPBLEParameter_FBD_VM_FBD_HM_Byte33: start 264, 8 bit, little-endian, data-type-policy=OVERRIDE, base-type=uint8, compu {phys=raw}, range phys 0..255
          signal TPBLEParameter_FBD_VM_FBD_HM_Byte34: start 272, 8 bit, little-endian, data-type-policy=OVERRIDE, base-type=uint8, compu {phys=raw}, range phys 0..255
          signal TPBLEParameter_FBD_VM_FBD_HM_Byte35: start 280, 8 bit, little-endian, data-type-policy=OVERRIDE, base-type=uint8, compu {phys=raw}, range phys 0..255
          signal TPBLEParameter_FBD_VM_FBD_HM_Byte36: start 288, 8 bit, little-endian, data-type-policy=OVERRIDE, base-type=uint8, compu {phys=raw}, range phys 0..255
          signal TPBLEParameter_FBD_VM_FBD_HM_Byte37: start 296, 8 bit, little-endian, data-type-policy=OVERRIDE, base-type=uint8, compu {phys=raw}, range phys 0..255
          signal TPBLEParameter_FBD_VM_FBD_HM_Byte38: start 304, 8 bit, little-endian, data-type-policy=OVERRIDE, base-type=uint8, compu {phys=raw}, range phys 0..255
          signal TPBLEParameter_FBD_VM_FBD_HM_Byte39: start 312, 8 bit, little-endian, data-type-policy=OVERRIDE, base-type=uint8, compu {phys=raw}, range phys 0..255
          signal TPBLEParameter_FBD_VM_FBD_HM_Byte40: start 320, 8 bit, little-endian, data-type-policy=OVERRIDE, base-type=uint8, compu {phys=raw}, range phys 0..255
          signal TPBLEParameter_FBD_VM_FBD_HM_Byte41: start 328, 8 bit, little-endian, data-type-policy=OVERRIDE, base-type=uint8, compu {phys=raw}, range phys 0..255
          signal TPBLEParameter_FBD_VM_FBD_HM_Byte42: start 336, 8 bit, little-endian, data-type-policy=OVERRIDE, base-type=uint8, compu {phys=raw}, range phys 0..255
          signal TPBLEParameter_FBD_VM_FBD_HM_Byte43: start 344, 8 bit, little-endian, data-type-policy=OVERRIDE, base-type=uint8, compu {phys=raw}, range phys 0..255
          signal TPBLEParameter_FBD_VM_FBD_HM_Byte44: start 352, 8 bit, little-endian, data-type-policy=OVERRIDE, base-type=uint8, compu {phys=raw}, range phys 0..255
          signal TPBLEParameter_FBD_VM_FBD_HM_Byte45: start 360, 8 bit, little-endian, data-type-policy=OVERRIDE, base-type=uint8, compu {phys=raw}, range phys 0..255
          signal TPBLEParameter_FBD_VM_FBD_HM_Byte46: start 368, 8 bit, little-endian, data-type-policy=OVERRIDE, base-type=uint8, compu {phys=raw}, range phys 0..255
          signal TPBLEParameter_FBD_VM_FBD_HM_Byte47: start 376, 8 bit, little-endian, data-type-policy=OVERRIDE, base-type=uint8, compu {phys=raw}, range phys 0..255
          signal TPBLEParameter_FBD_VM_FBD_HM_Byte48: start 384, 8 bit, little-endian, data-type-policy=OVERRIDE, base-type=uint8, compu {phys=raw}, range phys 0..255
          signal TPBLEParameter_FBD_VM_FBD_HM_Byte49: start 392, 8 bit, little-endian, data-type-policy=OVERRIDE, base-type=uint8, compu {phys=raw}, range phys 0..255
          signal TPBLEParameter_FBD_VM_FBD_HM_Byte50: start 400, 8 bit, little-endian, data-type-policy=OVERRIDE, base-type=uint8, compu {phys=raw}, range phys 0..255
          signal TPBLEParameter_FBD_VM_FBD_HM_Byte51: start 408, 8 bit, little-endian, data-type-policy=OVERRIDE, base-type=uint8, compu {phys=raw}, range phys 0..255
          signal TPBLEParameter_FBD_VM_FBD_HM_Byte52: start 416, 8 bit, little-endian, data-type-policy=OVERRIDE, base-type=uint8, compu {phys=raw}, range phys 0..255
          signal TPBLEParameter_FBD_VM_FBD_HM_Byte53: start 424, 8 bit, little-endian, data-type-policy=OVERRIDE, base-type=uint8, compu {phys=raw}, range phys 0..255
          signal TPBLEParameter_FBD_VM_FBD_HM_Byte54: start 432, 8 bit, little-endian, data-type-policy=OVERRIDE, base-type=uint8, compu {phys=raw}, range phys 0..255
          signal TPBLEParameter_FBD_VM_FBD_HM_Byte55: start 440, 8 bit, little-endian, data-type-policy=OVERRIDE, base-type=uint8, compu {phys=raw}, range phys 0..255
          signal TPBLEParameter_FBD_VM_FBD_HM_Byte56: start 448, 8 bit, little-endian, data-type-policy=OVERRIDE, base-type=uint8, compu {phys=raw}, range phys 0..255
          signal TPBLEParameter_FBD_VM_FBD_HM_Byte57: start 456, 8 bit, little-endian, data-type-policy=OVERRIDE, base-type=uint8, compu {phys=raw}, range phys 0..255
          signal TPBLEParameter_FBD_VM_FBD_HM_Byte58: start 464, 8 bit, little-endian, data-type-policy=OVERRIDE, base-type=uint8, compu {phys=raw}, range phys 0..255
          signal TPBLEParameter_FBD_VM_FBD_HM_Byte59: start 472, 8 bit, little-endian, data-type-policy=OVERRIDE, base-type=uint8, compu {phys=raw}, range phys 0..255
          signal TPBLEParameter_FBD_VM_FBD_HM_Byte60: start 480, 8 bit, little-endian, data-type-policy=OVERRIDE, base-type=uint8, compu {phys=raw}, range phys 0..255
          signal TPBLEParameter_FBD_VM_FBD_HM_Byte61: start 488, 8 bit, little-endian, data-type-policy=OVERRIDE, base-type=uint8, compu {phys=raw}, range phys 0..255
          signal TPBLEParameter_FBD_VM_FBD_HM_Byte62: start 496, 8 bit, little-endian, data-type-policy=OVERRIDE, base-type=uint8, compu {phys=raw}, range phys 0..255
          signal TPBLEParameter_FBD_VM_FBD_HM_Byte63: start 504, 8 bit, little-endian, data-type-policy=OVERRIDE, base-type=uint8, compu {phys=raw}, range phys 0..255
      frame TPBLEParameter_FBD_VM_FBD_HR: id 0x38B, frame-length=64, can-addressing-mode=STANDARD, can-frame-rx-behavior=CAN-FD, can-frame-tx-behavior=CAN-FD
        pdu TPBLEParameter_FBD_VM_FBD_HR: length=64, unused-bit-pattern=0
          signal TPBLEParameter_FBD_VM_FBD_HR_Byte00: start 0, 8 bit, little-endian, data-type-policy=OVERRIDE, base-type=uint8, compu {phys=raw}, range phys 0..255
          signal TPBLEParameter_FBD_VM_FBD_HR_Byte01: start 8, 8 bit, little-endian, data-type-policy=OVERRIDE, base-type=uint8, compu {phys=raw}, range phys 0..255
          signal TPBLEParameter_FBD_VM_FBD_HR_Byte02: start 16, 8 bit, little-endian, data-type-policy=OVERRIDE, base-type=uint8, compu {phys=raw}, range phys 0..255
          signal TPBLEParameter_FBD_VM_FBD_HR_Byte03: start 24, 8 bit, little-endian, data-type-policy=OVERRIDE, base-type=uint8, compu {phys=raw}, range phys 0..255
          signal TPBLEParameter_FBD_VM_FBD_HR_Byte04: start 32, 8 bit, little-endian, data-type-policy=OVERRIDE, base-type=uint8, compu {phys=raw}, range phys 0..255
          signal TPBLEParameter_FBD_VM_FBD_HR_Byte05: start 40, 8 bit, little-endian, data-type-policy=OVERRIDE, base-type=uint8, compu {phys=raw}, range phys 0..255
          signal TPBLEParameter_FBD_VM_FBD_HR_Byte06: start 48, 8 bit, little-endian, data-type-policy=OVERRIDE, base-type=uint8, compu {phys=raw}, range phys 0..255
          signal TPBLEParameter_FBD_VM_FBD_HR_Byte07: start 56, 8 bit, little-endian, data-type-policy=OVERRIDE, base-type=uint8, compu {phys=raw}, range phys 0..255
          signal TPBLEParameter_FBD_VM_FBD_HR_Byte08: start 64, 8 bit, little-endian, data-type-policy=OVERRIDE, base-type=uint8, compu {phys=raw}, range phys 0..255
          signal TPBLEParameter_FBD_VM_FBD_HR_Byte09: start 72, 8 bit, little-endian, data-type-policy=OVERRIDE, base-type=uint8, compu {phys=raw}, range phys 0..255
          signal TPBLEParameter_FBD_VM_FBD_HR_Byte10: start 80, 8 bit, little-endian, data-type-policy=OVERRIDE, base-type=uint8, compu {phys=raw}, range phys 0..255
          signal TPBLEParameter_FBD_VM_FBD_HR_Byte11: start 88, 8 bit, little-endian, data-type-policy=OVERRIDE, base-type=uint8, compu {phys=raw}, range phys 0..255
          signal TPBLEParameter_FBD_VM_FBD_HR_Byte12: start 96, 8 bit, little-endian, data-type-policy=OVERRIDE, base-type=uint8, compu {phys=raw}, range phys 0..255
          signal TPBLEParameter_FBD_VM_FBD_HR_Byte13: start 104, 8 bit, little-endian, data-type-policy=OVERRIDE, base-type=uint8, compu {phys=raw}, range phys 0..255
          signal TPBLEParameter_FBD_VM_FBD_HR_Byte14: start 112, 8 bit, little-endian, data-type-policy=OVERRIDE, base-type=uint8, compu {phys=raw}, range phys 0..255
          signal TPBLEParameter_FBD_VM_FBD_HR_Byte15: start 120, 8 bit, little-endian, data-type-policy=OVERRIDE, base-type=uint8, compu {phys=raw}, range phys 0..255
          signal TPBLEParameter_FBD_VM_FBD_HR_Byte16: start 128, 8 bit, little-endian, data-type-policy=OVERRIDE, base-type=uint8, compu {phys=raw}, range phys 0..255
          signal TPBLEParameter_FBD_VM_FBD_HR_Byte17: start 136, 8 bit, little-endian, data-type-policy=OVERRIDE, base-type=uint8, compu {phys=raw}, range phys 0..255
          signal TPBLEParameter_FBD_VM_FBD_HR_Byte18: start 144, 8 bit, little-endian, data-type-policy=OVERRIDE, base-type=uint8, compu {phys=raw}, range phys 0..255
          signal TPBLEParameter_FBD_VM_FBD_HR_Byte19: start 152, 8 bit, little-endian, data-type-policy=OVERRIDE, base-type=uint8, compu {phys=raw}, range phys 0..255
          signal TPBLEParameter_FBD_VM_FBD_HR_Byte20: start 160, 8 bit, little-endian, data-type-policy=OVERRIDE, base-type=uint8, compu {phys=raw}, range phys 0..255
          signal TPBLEParameter_FBD_VM_FBD_HR_Byte21: start 168, 8 bit, little-endian, data-type-policy=OVERRIDE, base-type=uint8, compu {phys=raw}, range phys 0..255
          signal TPBLEParameter_FBD_VM_FBD_HR_Byte22: start 176, 8 bit, little-endian, data-type-policy=OVERRIDE, base-type=uint8, compu {phys=raw}, range phys 0..255
          signal TPBLEParameter_FBD_VM_FBD_HR_Byte23: start 184, 8 bit, little-endian, data-type-policy=OVERRIDE, base-type=uint8, compu {phys=raw}, range phys 0..255
          signal TPBLEParameter_FBD_VM_FBD_HR_Byte24: start 192, 8 bit, little-endian, data-type-policy=OVERRIDE, base-type=uint8, compu {phys=raw}, range phys 0..255
          signal TPBLEParameter_FBD_VM_FBD_HR_Byte25: start 200, 8 bit, little-endian, data-type-policy=OVERRIDE, base-type=uint8, compu {phys=raw}, range phys 0..255
          signal TPBLEParameter_FBD_VM_FBD_HR_Byte26: start 208, 8 bit, little-endian, data-type-policy=OVERRIDE, base-type=uint8, compu {phys=raw}, range phys 0..255
          signal TPBLEParameter_FBD_VM_FBD_HR_Byte27: start 216, 8 bit, little-endian, data-type-policy=OVERRIDE, base-type=uint8, compu {phys=raw}, range phys 0..255
          signal TPBLEParameter_FBD_VM_FBD_HR_Byte28: start 224, 8 bit, little-endian, data-type-policy=OVERRIDE, base-type=uint8, compu {phys=raw}, range phys 0..255
          signal TPBLEParameter_FBD_VM_FBD_HR_Byte29: start 232, 8 bit, little-endian, data-type-policy=OVERRIDE, base-type=uint8, compu {phys=raw}, range phys 0..255
          signal TPBLEParameter_FBD_VM_FBD_HR_Byte30: start 240, 8 bit, little-endian, data-type-policy=OVERRIDE, base-type=uint8, compu {phys=raw}, range phys 0..255
          signal TPBLEParameter_FBD_VM_FBD_HR_Byte31: start 248, 8 bit, little-endian, data-type-policy=OVERRIDE, base-type=uint8, compu {phys=raw}, range phys 0..255
          signal TPBLEParameter_FBD_VM_FBD_HR_Byte32: start 256, 8 bit, little-endian, data-type-policy=OVERRIDE, base-type=uint8, compu {phys=raw}, range phys 0..255
          signal TPBLEParameter_FBD_VM_FBD_HR_Byte33: start 264, 8 bit, little-endian, data-type-policy=OVERRIDE, base-type=uint8, compu {phys=raw}, range phys 0..255
          signal TPBLEParameter_FBD_VM_FBD_HR_Byte34: start 272, 8 bit, little-endian, data-type-policy=OVERRIDE, base-type=uint8, compu {phys=raw}, range phys 0..255
          signal TPBLEParameter_FBD_VM_FBD_HR_Byte35: start 280, 8 bit, little-endian, data-type-policy=OVERRIDE, base-type=uint8, compu {phys=raw}, range phys 0..255
          signal TPBLEParameter_FBD_VM_FBD_HR_Byte36: start 288, 8 bit, little-endian, data-type-policy=OVERRIDE, base-type=uint8, compu {phys=raw}, range phys 0..255
          signal TPBLEParameter_FBD_VM_FBD_HR_Byte37: start 296, 8 bit, little-endian, data-type-policy=OVERRIDE, base-type=uint8, compu {phys=raw}, range phys 0..255
          signal TPBLEParameter_FBD_VM_FBD_HR_Byte38: start 304, 8 bit, little-endian, data-type-policy=OVERRIDE, base-type=uint8, compu {phys=raw}, range phys 0..255
          signal TPBLEParameter_FBD_VM_FBD_HR_Byte39: start 312, 8 bit, little-endian, data-type-policy=OVERRIDE, base-type=uint8, compu {phys=raw}, range phys 0..255
          signal TPBLEParameter_FBD_VM_FBD_HR_Byte40: start 320, 8 bit, little-endian, data-type-policy=OVERRIDE, base-type=uint8, compu {phys=raw}, range phys 0..255
          signal TPBLEParameter_FBD_VM_FBD_HR_Byte41: start 328, 8 bit, little-endian, data-type-policy=OVERRIDE, base-type=uint8, compu {phys=raw}, range phys 0..255
          signal TPBLEParameter_FBD_VM_FBD_HR_Byte42: start 336, 8 bit, little-endian, data-type-policy=OVERRIDE, base-type=uint8, compu {phys=raw}, range phys 0..255
          signal TPBLEParameter_FBD_VM_FBD_HR_Byte43: start 344, 8 bit, little-endian, data-type-policy=OVERRIDE, base-type=uint8, compu {phys=raw}, range phys 0..255
          signal TPBLEParameter_FBD_VM_FBD_HR_Byte44: start 352, 8 bit, little-endian, data-type-policy=OVERRIDE, base-type=uint8, compu {phys=raw}, range phys 0..255
          signal TPBLEParameter_FBD_VM_FBD_HR_Byte45: start 360, 8 bit, little-endian, data-type-policy=OVERRIDE, base-type=uint8, compu {phys=raw}, range phys 0..255
          signal TPBLEParameter_FBD_VM_FBD_HR_Byte46: start 368, 8 bit, little-endian, data-type-policy=OVERRIDE, base-type=uint8, compu {phys=raw}, range phys 0..255
          signal TPBLEParameter_FBD_VM_FBD_HR_Byte47: start 376, 8 bit, little-endian, data-type-policy=OVERRIDE, base-type=uint8, compu {phys=raw}, range phys 0..255
          signal TPBLEParameter_FBD_VM_FBD_HR_Byte48: start 384, 8 bit, little-endian, data-type-policy=OVERRIDE, base-type=uint8, compu {phys=raw}, range phys 0..255
          signal TPBLEParameter_FBD_VM_FBD_HR_Byte49: start 392, 8 bit, little-endian, data-type-policy=OVERRIDE, base-type=uint8, compu {phys=raw}, range phys 0..255
          signal TPBLEParameter_FBD_VM_FBD_HR_Byte50: start 400, 8 bit, little-endian, data-type-policy=OVERRIDE, base-type=uint8, compu {phys=raw}, range phys 0..255
          signal TPBLEParameter_FBD_VM_FBD_HR_Byte51: start 408, 8 bit, little-endian, data-type-policy=OVERRIDE, base-type=uint8, compu {phys=raw}, range phys 0..255
          signal TPBLEParameter_FBD_VM_FBD_HR_Byte52: start 416, 8 bit, little-endian, data-type-policy=OVERRIDE, base-type=uint8, compu {phys=raw}, range phys 0..255
          signal TPBLEParameter_FBD_VM_FBD_HR_Byte53: start 424, 8 bit, little-endian, data-type-policy=OVERRIDE, base-type=uint8, compu {phys=raw}, range phys 0..255
          signal TPBLEParameter_FBD_VM_FBD_HR_Byte54: start 432, 8 bit, little-endian, data-type-policy=OVERRIDE, base-type=uint8, compu {phys=raw}, range phys 0..255
          signal TPBLEParameter_FBD_VM_FBD_HR_Byte55: start 440, 8 bit, little-endian, data-type-policy=OVERRIDE, base-type=uint8, compu {phys=raw}, range phys 0..255
          signal TPBLEParameter_FBD_VM_FBD_HR_Byte56: start 448, 8 bit, little-endian, data-type-policy=OVERRIDE, base-type=uint8, compu {phys=raw}, range phys 0..255
          signal TPBLEParameter_FBD_VM_FBD_HR_Byte57: start 456, 8 bit, little-endian, data-type-policy=OVERRIDE, base-type=uint8, compu {phys=raw}, range phys 0..255
          signal TPBLEParameter_FBD_VM_FBD_HR_Byte58: start 464, 8 bit, little-endian, data-type-policy=OVERRIDE, base-type=uint8, compu {phys=raw}, range phys 0..255
          signal TPBLEParameter_FBD_VM_FBD_HR_Byte59: start 472, 8 bit, little-endian, data-type-policy=OVERRIDE, base-type=uint8, compu {phys=raw}, range phys 0..255
          signal TPBLEParameter_FBD_VM_FBD_HR_Byte60: start 480, 8 bit, little-endian, data-type-policy=OVERRIDE, base-type=uint8, compu {phys=raw}, range phys 0..255
          signal TPBLEParameter_FBD_VM_FBD_HR_Byte61: start 488, 8 bit, little-endian, data-type-policy=OVERRIDE, base-type=uint8, compu {phys=raw}, range phys 0..255
          signal TPBLEParameter_FBD_VM_FBD_HR_Byte62: start 496, 8 bit, little-endian, data-type-policy=OVERRIDE, base-type=uint8, compu {phys=raw}, range phys 0..255
          signal TPBLEParameter_FBD_VM_FBD_HR_Byte63: start 504, 8 bit, little-endian, data-type-policy=OVERRIDE, base-type=uint8, compu {phys=raw}, range phys 0..255
      frame TPBLEParameter_FBD_VM_FBD_Miko: id 0x386, frame-length=64, can-addressing-mode=STANDARD, can-frame-rx-behavior=CAN-FD, can-frame-tx-behavior=CAN-FD
        pdu TPBLEParameter_FBD_VM_FBD_Miko: length=64, unused-bit-pattern=0
          signal TPBLEParameter_FBD_VM_FBD_Miko_Byte00: start 0, 8 bit, little-endian, data-type-policy=OVERRIDE, base-type=uint8, compu {phys=raw}, range phys 0..255
          signal TPBLEParameter_FBD_VM_FBD_Miko_Byte01: start 8, 8 bit, little-endian, data-type-policy=OVERRIDE, base-type=uint8, compu {phys=raw}, range phys 0..255
          signal TPBLEParameter_FBD_VM_FBD_Miko_Byte02: start 16, 8 bit, little-endian, data-type-policy=OVERRIDE, base-type=uint8, compu {phys=raw}, range phys 0..255
          signal TPBLEParameter_FBD_VM_FBD_Miko_Byte03: start 24, 8 bit, little-endian, data-type-policy=OVERRIDE, base-type=uint8, compu {phys=raw}, range phys 0..255
          signal TPBLEParameter_FBD_VM_FBD_Miko_Byte04: start 32, 8 bit, little-endian, data-type-policy=OVERRIDE, base-type=uint8, compu {phys=raw}, range phys 0..255
          signal TPBLEParameter_FBD_VM_FBD_Miko_Byte05: start 40, 8 bit, little-endian, data-type-policy=OVERRIDE, base-type=uint8, compu {phys=raw}, range phys 0..255
          signal TPBLEParameter_FBD_VM_FBD_Miko_Byte06: start 48, 8 bit, little-endian, data-type-policy=OVERRIDE, base-type=uint8, compu {phys=raw}, range phys 0..255
          signal TPBLEParameter_FBD_VM_FBD_Miko_Byte07: start 56, 8 bit, little-endian, data-type-policy=OVERRIDE, base-type=uint8, compu {phys=raw}, range phys 0..255
          signal TPBLEParameter_FBD_VM_FBD_Miko_Byte08: start 64, 8 bit, little-endian, data-type-policy=OVERRIDE, base-type=uint8, compu {phys=raw}, range phys 0..255
          signal TPBLEParameter_FBD_VM_FBD_Miko_Byte09: start 72, 8 bit, little-endian, data-type-policy=OVERRIDE, base-type=uint8, compu {phys=raw}, range phys 0..255
          signal TPBLEParameter_FBD_VM_FBD_Miko_Byte10: start 80, 8 bit, little-endian, data-type-policy=OVERRIDE, base-type=uint8, compu {phys=raw}, range phys 0..255
          signal TPBLEParameter_FBD_VM_FBD_Miko_Byte11: start 88, 8 bit, little-endian, data-type-policy=OVERRIDE, base-type=uint8, compu {phys=raw}, range phys 0..255
          signal TPBLEParameter_FBD_VM_FBD_Miko_Byte12: start 96, 8 bit, little-endian, data-type-policy=OVERRIDE, base-type=uint8, compu {phys=raw}, range phys 0..255
          signal TPBLEParameter_FBD_VM_FBD_Miko_Byte13: start 104, 8 bit, little-endian, data-type-policy=OVERRIDE, base-type=uint8, compu {phys=raw}, range phys 0..255
          signal TPBLEParameter_FBD_VM_FBD_Miko_Byte14: start 112, 8 bit, little-endian, data-type-policy=OVERRIDE, base-type=uint8, compu {phys=raw}, range phys 0..255
          signal TPBLEParameter_FBD_VM_FBD_Miko_Byte15: start 120, 8 bit, little-endian, data-type-policy=OVERRIDE, base-type=uint8, compu {phys=raw}, range phys 0..255
          signal TPBLEParameter_FBD_VM_FBD_Miko_Byte16: start 128, 8 bit, little-endian, data-type-policy=OVERRIDE, base-type=uint8, compu {phys=raw}, range phys 0..255
          signal TPBLEParameter_FBD_VM_FBD_Miko_Byte17: start 136, 8 bit, little-endian, data-type-policy=OVERRIDE, base-type=uint8, compu {phys=raw}, range phys 0..255
          signal TPBLEParameter_FBD_VM_FBD_Miko_Byte18: start 144, 8 bit, little-endian, data-type-policy=OVERRIDE, base-type=uint8, compu {phys=raw}, range phys 0..255
          signal TPBLEParameter_FBD_VM_FBD_Miko_Byte19: start 152, 8 bit, little-endian, data-type-policy=OVERRIDE, base-type=uint8, compu {phys=raw}, range phys 0..255
          signal TPBLEParameter_FBD_VM_FBD_Miko_Byte20: start 160, 8 bit, little-endian, data-type-policy=OVERRIDE, base-type=uint8, compu {phys=raw}, range phys 0..255
          signal TPBLEParameter_FBD_VM_FBD_Miko_Byte21: start 168, 8 bit, little-endian, data-type-policy=OVERRIDE, base-type=uint8, compu {phys=raw}, range phys 0..255
          signal TPBLEParameter_FBD_VM_FBD_Miko_Byte22: start 176, 8 bit, little-endian, data-type-policy=OVERRIDE, base-type=uint8, compu {phys=raw}, range phys 0..255
          signal TPBLEParameter_FBD_VM_FBD_Miko_Byte23: start 184, 8 bit, little-endian, data-type-policy=OVERRIDE, base-type=uint8, compu {phys=raw}, range phys 0..255
          signal TPBLEParameter_FBD_VM_FBD_Miko_Byte24: start 192, 8 bit, little-endian, data-type-policy=OVERRIDE, base-type=uint8, compu {phys=raw}, range phys 0..255
          signal TPBLEParameter_FBD_VM_FBD_Miko_Byte25: start 200, 8 bit, little-endian, data-type-policy=OVERRIDE, base-type=uint8, compu {phys=raw}, range phys 0..255
          signal TPBLEParameter_FBD_VM_FBD_Miko_Byte26: start 208, 8 bit, little-endian, data-type-policy=OVERRIDE, base-type=uint8, compu {phys=raw}, range phys 0..255
          signal TPBLEParameter_FBD_VM_FBD_Miko_Byte27: start 216, 8 bit, little-endian, data-type-policy=OVERRIDE, base-type=uint8, compu {phys=raw}, range phys 0..255
          signal TPBLEParameter_FBD_VM_FBD_Miko_Byte28: start 224, 8 bit, little-endian, data-type-policy=OVERRIDE, base-type=uint8, compu {phys=raw}, range phys 0..255
          signal TPBLEParameter_FBD_VM_FBD_Miko_Byte29: start 232, 8 bit, little-endian, data-type-policy=OVERRIDE, base-type=uint8, compu {phys=raw}, range phys 0..255
          signal TPBLEParameter_FBD_VM_FBD_Miko_Byte30: start 240, 8 bit, little-endian, data-type-policy=OVERRIDE, base-type=uint8, compu {phys=raw}, range phys 0..255
          signal TPBLEParameter_FBD_VM_FBD_Miko_Byte31: start 248, 8 bit, little-endian, data-type-policy=OVERRIDE, base-type=uint8, compu {phys=raw}, range phys 0..255
          signal TPBLEParameter_FBD_VM_FBD_Miko_Byte32: start 256, 8 bit, little-endian, data-type-policy=OVERRIDE, base-type=uint8, compu {phys=raw}, range phys 0..255
          signal TPBLEParameter_FBD_VM_FBD_Miko_Byte33: start 264, 8 bit, little-endian, data-type-policy=OVERRIDE, base-type=uint8, compu {phys=raw}, range phys 0..255
          signal TPBLEParameter_FBD_VM_FBD_Miko_Byte34: start 272, 8 bit, little-endian, data-type-policy=OVERRIDE, base-type=uint8, compu {phys=raw}, range phys 0..255
          signal TPBLEParameter_FBD_VM_FBD_Miko_Byte35: start 280, 8 bit, little-endian, data-type-policy=OVERRIDE, base-type=uint8, compu {phys=raw}, range phys 0..255
          signal TPBLEParameter_FBD_VM_FBD_Miko_Byte36: start 288, 8 bit, little-endian, data-type-policy=OVERRIDE, base-type=uint8, compu {phys=raw}, range phys 0..255
          signal TPBLEParameter_FBD_VM_FBD_Miko_Byte37: start 296, 8 bit, little-endian, data-type-policy=OVERRIDE, base-type=uint8, compu {phys=raw}, range phys 0..255
          signal TPBLEParameter_FBD_VM_FBD_Miko_Byte38: start 304, 8 bit, little-endian, data-type-policy=OVERRIDE, base-type=uint8, compu {phys=raw}, range phys 0..255
          signal TPBLEParameter_FBD_VM_FBD_Miko_Byte39: start 312, 8 bit, little-endian, data-type-policy=OVERRIDE, base-type=uint8, compu {phys=raw}, range phys 0..255
          signal TPBLEParameter_FBD_VM_FBD_Miko_Byte40: start 320, 8 bit, little-endian, data-type-policy=OVERRIDE, base-type=uint8, compu {phys=raw}, range phys 0..255
          signal TPBLEParameter_FBD_VM_FBD_Miko_Byte41: start 328, 8 bit, little-endian, data-type-policy=OVERRIDE, base-type=uint8, compu {phys=raw}, range phys 0..255
          signal TPBLEParameter_FBD_VM_FBD_Miko_Byte42: start 336, 8 bit, little-endian, data-type-policy=OVERRIDE, base-type=uint8, compu {phys=raw}, range phys 0..255
          signal TPBLEParameter_FBD_VM_FBD_Miko_Byte43: start 344, 8 bit, little-endian, data-type-policy=OVERRIDE, base-type=uint8, compu {phys=raw}, range phys 0..255
          signal TPBLEParameter_FBD_VM_FBD_Miko_Byte44: start 352, 8 bit, little-endian, data-type-policy=OVERRIDE, base-type=uint8, compu {phys=raw}, range phys 0..255
          signal TPBLEParameter_FBD_VM_FBD_Miko_Byte45: start 360, 8 bit, little-endian, data-type-policy=OVERRIDE, base-type=uint8, compu {phys=raw}, range phys 0..255
          signal TPBLEParameter_FBD_VM_FBD_Miko_Byte46: start 368, 8 bit, little-endian, data-type-policy=OVERRIDE, base-type=uint8, compu {phys=raw}, range phys 0..255
          signal TPBLEParameter_FBD_VM_FBD_Miko_Byte47: start 376, 8 bit, little-endian, data-type-policy=OVERRIDE, base-type=uint8, compu {phys=raw}, range phys 0..255
          signal TPBLEParameter_FBD_VM_FBD_Miko_Byte48: start 384, 8 bit, little-endian, data-type-policy=OVERRIDE, base-type=uint8, compu {phys=raw}, range phys 0..255
          signal TPBLEParameter_FBD_VM_FBD_Miko_Byte49: start 392, 8 bit, little-endian, data-type-policy=OVERRIDE, base-type=uint8, compu {phys=raw}, range phys 0..255
          signal TPBLEParameter_FBD_VM_FBD_Miko_Byte50: start 400, 8 bit, little-endian, data-type-policy=OVERRIDE, base-type=uint8, compu {phys=raw}, range phys 0..255
          signal TPBLEParameter_FBD_VM_FBD_Miko_Byte51: start 408, 8 bit, little-endian, data-type-policy=OVERRIDE, base-type=uint8, compu {phys=raw}, range phys 0..255
          signal TPBLEParameter_FBD_VM_FBD_Miko_Byte52: start 416, 8 bit, little-endian, data-type-policy=OVERRIDE, base-type=uint8, compu {phys=raw}, range phys 0..255
          signal TPBLEParameter_FBD_VM_FBD_Miko_Byte53: start 424, 8 bit, little-endian, data-type-policy=OVERRIDE, base-type=uint8, compu {phys=raw}, range phys 0..255
          signal TPBLEParameter_FBD_VM_FBD_Miko_Byte54: start 432, 8 bit, little-endian, data-type-policy=OVERRIDE, base-type=uint8, compu {phys=raw}, range phys 0..255
          signal TPBLEParameter_FBD_VM_FBD_Miko_Byte55: start 440, 8 bit, little-endian, data-type-policy=OVERRIDE, base-type=uint8, compu {phys=raw}, range phys 0..255
          signal TPBLEParameter_FBD_VM_FBD_Miko_Byte56: start 448, 8 bit, little-endian, data-type-policy=OVERRIDE, base-type=uint8, compu {phys=raw}, range phys 0..255
          signal TPBLEParameter_FBD_VM_FBD_Miko_Byte57: start 456, 8 bit, little-endian, data-type-policy=OVERRIDE, base-type=uint8, compu {phys=raw}, range phys 0..255
          signal TPBLEParameter_FBD_VM_FBD_Miko_Byte58: start 464, 8 bit, little-endian, data-type-policy=OVERRIDE, base-type=uint8, compu {phys=raw}, range phys 0..255
          signal TPBLEParameter_FBD_VM_FBD_Miko_Byte59: start 472, 8 bit, little-endian, data-type-policy=OVERRIDE, base-type=uint8, compu {phys=raw}, range phys 0..255
          signal TPBLEParameter_FBD_VM_FBD_Miko_Byte60: start 480, 8 bit, little-endian, data-type-policy=OVERRIDE, base-type=uint8, compu {phys=raw}, range phys 0..255
          signal TPBLEParameter_FBD_VM_FBD_Miko_Byte61: start 488, 8 bit, little-endian, data-type-policy=OVERRIDE, base-type=uint8, compu {phys=raw}, range phys 0..255
          signal TPBLEParameter_FBD_VM_FBD_Miko_Byte62: start 496, 8 bit, little-endian, data-type-policy=OVERRIDE, base-type=uint8, compu {phys=raw}, range phys 0..255
          signal TPBLEParameter_FBD_VM_FBD_Miko_Byte63: start 504, 8 bit, little-endian, data-type-policy=OVERRIDE, base-type=uint8, compu {phys=raw}, range phys 0..255
      frame TPBLEParameter_FBD_VM_FBD_MM: id 0x384, frame-length=64, can-addressing-mode=STANDARD, can-frame-rx-behavior=CAN-FD, can-frame-tx-behavior=CAN-FD
        pdu TPBLEParameter_FBD_VM_FBD_MM: length=64, unused-bit-pattern=0
          signal TPBLEParameter_FBD_VM_FBD_MM_Byte00: start 0, 8 bit, little-endian, data-type-policy=OVERRIDE, base-type=uint8, compu {phys=raw}, range phys 0..255
          signal TPBLEParameter_FBD_VM_FBD_MM_Byte01: start 8, 8 bit, little-endian, data-type-policy=OVERRIDE, base-type=uint8, compu {phys=raw}, range phys 0..255
          signal TPBLEParameter_FBD_VM_FBD_MM_Byte02: start 16, 8 bit, little-endian, data-type-policy=OVERRIDE, base-type=uint8, compu {phys=raw}, range phys 0..255
          signal TPBLEParameter_FBD_VM_FBD_MM_Byte03: start 24, 8 bit, little-endian, data-type-policy=OVERRIDE, base-type=uint8, compu {phys=raw}, range phys 0..255
          signal TPBLEParameter_FBD_VM_FBD_MM_Byte04: start 32, 8 bit, little-endian, data-type-policy=OVERRIDE, base-type=uint8, compu {phys=raw}, range phys 0..255
          signal TPBLEParameter_FBD_VM_FBD_MM_Byte05: start 40, 8 bit, little-endian, data-type-policy=OVERRIDE, base-type=uint8, compu {phys=raw}, range phys 0..255
          signal TPBLEParameter_FBD_VM_FBD_MM_Byte06: start 48, 8 bit, little-endian, data-type-policy=OVERRIDE, base-type=uint8, compu {phys=raw}, range phys 0..255
          signal TPBLEParameter_FBD_VM_FBD_MM_Byte07: start 56, 8 bit, little-endian, data-type-policy=OVERRIDE, base-type=uint8, compu {phys=raw}, range phys 0..255
          signal TPBLEParameter_FBD_VM_FBD_MM_Byte08: start 64, 8 bit, little-endian, data-type-policy=OVERRIDE, base-type=uint8, compu {phys=raw}, range phys 0..255
          signal TPBLEParameter_FBD_VM_FBD_MM_Byte09: start 72, 8 bit, little-endian, data-type-policy=OVERRIDE, base-type=uint8, compu {phys=raw}, range phys 0..255
          signal TPBLEParameter_FBD_VM_FBD_MM_Byte10: start 80, 8 bit, little-endian, data-type-policy=OVERRIDE, base-type=uint8, compu {phys=raw}, range phys 0..255
          signal TPBLEParameter_FBD_VM_FBD_MM_Byte11: start 88, 8 bit, little-endian, data-type-policy=OVERRIDE, base-type=uint8, compu {phys=raw}, range phys 0..255
          signal TPBLEParameter_FBD_VM_FBD_MM_Byte12: start 96, 8 bit, little-endian, data-type-policy=OVERRIDE, base-type=uint8, compu {phys=raw}, range phys 0..255
          signal TPBLEParameter_FBD_VM_FBD_MM_Byte13: start 104, 8 bit, little-endian, data-type-policy=OVERRIDE, base-type=uint8, compu {phys=raw}, range phys 0..255
          signal TPBLEParameter_FBD_VM_FBD_MM_Byte14: start 112, 8 bit, little-endian, data-type-policy=OVERRIDE, base-type=uint8, compu {phys=raw}, range phys 0..255
          signal TPBLEParameter_FBD_VM_FBD_MM_Byte15: start 120, 8 bit, little-endian, data-type-policy=OVERRIDE, base-type=uint8, compu {phys=raw}, range phys 0..255
          signal TPBLEParameter_FBD_VM_FBD_MM_Byte16: start 128, 8 bit, little-endian, data-type-policy=OVERRIDE, base-type=uint8, compu {phys=raw}, range phys 0..255
          signal TPBLEParameter_FBD_VM_FBD_MM_Byte17: start 136, 8 bit, little-endian, data-type-policy=OVERRIDE, base-type=uint8, compu {phys=raw}, range phys 0..255
          signal TPBLEParameter_FBD_VM_FBD_MM_Byte18: start 144, 8 bit, little-endian, data-type-policy=OVERRIDE, base-type=uint8, compu {phys=raw}, range phys 0..255
          signal TPBLEParameter_FBD_VM_FBD_MM_Byte19: start 152, 8 bit, little-endian, data-type-policy=OVERRIDE, base-type=uint8, compu {phys=raw}, range phys 0..255
          signal TPBLEParameter_FBD_VM_FBD_MM_Byte20: start 160, 8 bit, little-endian, data-type-policy=OVERRIDE, base-type=uint8, compu {phys=raw}, range phys 0..255
          signal TPBLEParameter_FBD_VM_FBD_MM_Byte21: start 168, 8 bit, little-endian, data-type-policy=OVERRIDE, base-type=uint8, compu {phys=raw}, range phys 0..255
          signal TPBLEParameter_FBD_VM_FBD_MM_Byte22: start 176, 8 bit, little-endian, data-type-policy=OVERRIDE, base-type=uint8, compu {phys=raw}, range phys 0..255
          signal TPBLEParameter_FBD_VM_FBD_MM_Byte23: start 184, 8 bit, little-endian, data-type-policy=OVERRIDE, base-type=uint8, compu {phys=raw}, range phys 0..255
          signal TPBLEParameter_FBD_VM_FBD_MM_Byte24: start 192, 8 bit, little-endian, data-type-policy=OVERRIDE, base-type=uint8, compu {phys=raw}, range phys 0..255
          signal TPBLEParameter_FBD_VM_FBD_MM_Byte25: start 200, 8 bit, little-endian, data-type-policy=OVERRIDE, base-type=uint8, compu {phys=raw}, range phys 0..255
          signal TPBLEParameter_FBD_VM_FBD_MM_Byte26: start 208, 8 bit, little-endian, data-type-policy=OVERRIDE, base-type=uint8, compu {phys=raw}, range phys 0..255
          signal TPBLEParameter_FBD_VM_FBD_MM_Byte27: start 216, 8 bit, little-endian, data-type-policy=OVERRIDE, base-type=uint8, compu {phys=raw}, range phys 0..255
          signal TPBLEParameter_FBD_VM_FBD_MM_Byte28: start 224, 8 bit, little-endian, data-type-policy=OVERRIDE, base-type=uint8, compu {phys=raw}, range phys 0..255
          signal TPBLEParameter_FBD_VM_FBD_MM_Byte29: start 232, 8 bit, little-endian, data-type-policy=OVERRIDE, base-type=uint8, compu {phys=raw}, range phys 0..255
          signal TPBLEParameter_FBD_VM_FBD_MM_Byte30: start 240, 8 bit, little-endian, data-type-policy=OVERRIDE, base-type=uint8, compu {phys=raw}, range phys 0..255
          signal TPBLEParameter_FBD_VM_FBD_MM_Byte31: start 248, 8 bit, little-endian, data-type-policy=OVERRIDE, base-type=uint8, compu {phys=raw}, range phys 0..255
          signal TPBLEParameter_FBD_VM_FBD_MM_Byte32: start 256, 8 bit, little-endian, data-type-policy=OVERRIDE, base-type=uint8, compu {phys=raw}, range phys 0..255
          signal TPBLEParameter_FBD_VM_FBD_MM_Byte33: start 264, 8 bit, little-endian, data-type-policy=OVERRIDE, base-type=uint8, compu {phys=raw}, range phys 0..255
          signal TPBLEParameter_FBD_VM_FBD_MM_Byte34: start 272, 8 bit, little-endian, data-type-policy=OVERRIDE, base-type=uint8, compu {phys=raw}, range phys 0..255
          signal TPBLEParameter_FBD_VM_FBD_MM_Byte35: start 280, 8 bit, little-endian, data-type-policy=OVERRIDE, base-type=uint8, compu {phys=raw}, range phys 0..255
          signal TPBLEParameter_FBD_VM_FBD_MM_Byte36: start 288, 8 bit, little-endian, data-type-policy=OVERRIDE, base-type=uint8, compu {phys=raw}, range phys 0..255
          signal TPBLEParameter_FBD_VM_FBD_MM_Byte37: start 296, 8 bit, little-endian, data-type-policy=OVERRIDE, base-type=uint8, compu {phys=raw}, range phys 0..255
          signal TPBLEParameter_FBD_VM_FBD_MM_Byte38: start 304, 8 bit, little-endian, data-type-policy=OVERRIDE, base-type=uint8, compu {phys=raw}, range phys 0..255
          signal TPBLEParameter_FBD_VM_FBD_MM_Byte39: start 312, 8 bit, little-endian, data-type-policy=OVERRIDE, base-type=uint8, compu {phys=raw}, range phys 0..255
          signal TPBLEParameter_FBD_VM_FBD_MM_Byte40: start 320, 8 bit, little-endian, data-type-policy=OVERRIDE, base-type=uint8, compu {phys=raw}, range phys 0..255
          signal TPBLEParameter_FBD_VM_FBD_MM_Byte41: start 328, 8 bit, little-endian, data-type-policy=OVERRIDE, base-type=uint8, compu {phys=raw}, range phys 0..255
          signal TPBLEParameter_FBD_VM_FBD_MM_Byte42: start 336, 8 bit, little-endian, data-type-policy=OVERRIDE, base-type=uint8, compu {phys=raw}, range phys 0..255
          signal TPBLEParameter_FBD_VM_FBD_MM_Byte43: start 344, 8 bit, little-endian, data-type-policy=OVERRIDE, base-type=uint8, compu {phys=raw}, range phys 0..255
          signal TPBLEParameter_FBD_VM_FBD_MM_Byte44: start 352, 8 bit, little-endian, data-type-policy=OVERRIDE, base-type=uint8, compu {phys=raw}, range phys 0..255
          signal TPBLEParameter_FBD_VM_FBD_MM_Byte45: start 360, 8 bit, little-endian, data-type-policy=OVERRIDE, base-type=uint8, compu {phys=raw}, range phys 0..255
          signal TPBLEParameter_FBD_VM_FBD_MM_Byte46: start 368, 8 bit, little-endian, data-type-policy=OVERRIDE, base-type=uint8, compu {phys=raw}, range phys 0..255
          signal TPBLEParameter_FBD_VM_FBD_MM_Byte47: start 376, 8 bit, little-endian, data-type-policy=OVERRIDE, base-type=uint8, compu {phys=raw}, range phys 0..255
          signal TPBLEParameter_FBD_VM_FBD_MM_Byte48: start 384, 8 bit, little-endian, data-type-policy=OVERRIDE, base-type=uint8, compu {phys=raw}, range phys 0..255
          signal TPBLEParameter_FBD_VM_FBD_MM_Byte49: start 392, 8 bit, little-endian, data-type-policy=OVERRIDE, base-type=uint8, compu {phys=raw}, range phys 0..255
          signal TPBLEParameter_FBD_VM_FBD_MM_Byte50: start 400, 8 bit, little-endian, data-type-policy=OVERRIDE, base-type=uint8, compu {phys=raw}, range phys 0..255
          signal TPBLEParameter_FBD_VM_FBD_MM_Byte51: start 408, 8 bit, little-endian, data-type-policy=OVERRIDE, base-type=uint8, compu {phys=raw}, range phys 0..255
          signal TPBLEParameter_FBD_VM_FBD_MM_Byte52: start 416, 8 bit, little-endian, data-type-policy=OVERRIDE, base-type=uint8, compu {phys=raw}, range phys 0..255
          signal TPBLEParameter_FBD_VM_FBD_MM_Byte53: start 424, 8 bit, little-endian, data-type-policy=OVERRIDE, base-type=uint8, compu {phys=raw}, range phys 0..255
          signal TPBLEParameter_FBD_VM_FBD_MM_Byte54: start 432, 8 bit, little-endian, data-type-policy=OVERRIDE, base-type=uint8, compu {phys=raw}, range phys 0..255
          signal TPBLEParameter_FBD_VM_FBD_MM_Byte55: start 440, 8 bit, little-endian, data-type-policy=OVERRIDE, base-type=uint8, compu {phys=raw}, range phys 0..255
          signal TPBLEParameter_FBD_VM_FBD_MM_Byte56: start 448, 8 bit, little-endian, data-type-policy=OVERRIDE, base-type=uint8, compu {phys=raw}, range phys 0..255
          signal TPBLEParameter_FBD_VM_FBD_MM_Byte57: start 456, 8 bit, little-endian, data-type-policy=OVERRIDE, base-type=uint8, compu {phys=raw}, range phys 0..255
          signal TPBLEParameter_FBD_VM_FBD_MM_Byte58: start 464, 8 bit, little-endian, data-type-policy=OVERRIDE, base-type=uint8, compu {phys=raw}, range phys 0..255
          signal TPBLEParameter_FBD_VM_FBD_MM_Byte59: start 472, 8 bit, little-endian, data-type-policy=OVERRIDE, base-type=uint8, compu {phys=raw}, range phys 0..255
          signal TPBLEParameter_FBD_VM_FBD_MM_Byte60: start 480, 8 bit, little-endian, data-type-policy=OVERRIDE, base-type=uint8, compu {phys=raw}, range phys 0..255
          signal TPBLEParameter_FBD_VM_FBD_MM_Byte61: start 488, 8 bit, little-endian, data-type-policy=OVERRIDE, base-type=uint8, compu {phys=raw}, range phys 0..255
          signal TPBLEParameter_FBD_VM_FBD_MM_Byte62: start 496, 8 bit, little-endian, data-type-policy=OVERRIDE, base-type=uint8, compu {phys=raw}, range phys 0..255
          signal TPBLEParameter_FBD_VM_FBD_MM_Byte63: start 504, 8 bit, little-endian, data-type-policy=OVERRIDE, base-type=uint8, compu {phys=raw}, range phys 0..255
      frame TPBLEParameter_FBD_VM_FBD_Trunk: id 0x387, frame-length=64, can-addressing-mode=STANDARD, can-frame-rx-behavior=CAN-FD, can-frame-tx-behavior=CAN-FD
        pdu TPBLEParameter_FBD_VM_FBD_Trunk: length=64, unused-bit-pattern=0
          signal TPBLEParameter_FBD_VM_FBD_Trunk_Byte00: start 0, 8 bit, little-endian, data-type-policy=OVERRIDE, base-type=uint8, compu {phys=raw}, range phys 0..255
          signal TPBLEParameter_FBD_VM_FBD_Trunk_Byte01: start 8, 8 bit, little-endian, data-type-policy=OVERRIDE, base-type=uint8, compu {phys=raw}, range phys 0..255
          signal TPBLEParameter_FBD_VM_FBD_Trunk_Byte02: start 16, 8 bit, little-endian, data-type-policy=OVERRIDE, base-type=uint8, compu {phys=raw}, range phys 0..255
          signal TPBLEParameter_FBD_VM_FBD_Trunk_Byte03: start 24, 8 bit, little-endian, data-type-policy=OVERRIDE, base-type=uint8, compu {phys=raw}, range phys 0..255
          signal TPBLEParameter_FBD_VM_FBD_Trunk_Byte04: start 32, 8 bit, little-endian, data-type-policy=OVERRIDE, base-type=uint8, compu {phys=raw}, range phys 0..255
          signal TPBLEParameter_FBD_VM_FBD_Trunk_Byte05: start 40, 8 bit, little-endian, data-type-policy=OVERRIDE, base-type=uint8, compu {phys=raw}, range phys 0..255
          signal TPBLEParameter_FBD_VM_FBD_Trunk_Byte06: start 48, 8 bit, little-endian, data-type-policy=OVERRIDE, base-type=uint8, compu {phys=raw}, range phys 0..255
          signal TPBLEParameter_FBD_VM_FBD_Trunk_Byte07: start 56, 8 bit, little-endian, data-type-policy=OVERRIDE, base-type=uint8, compu {phys=raw}, range phys 0..255
          signal TPBLEParameter_FBD_VM_FBD_Trunk_Byte08: start 64, 8 bit, little-endian, data-type-policy=OVERRIDE, base-type=uint8, compu {phys=raw}, range phys 0..255
          signal TPBLEParameter_FBD_VM_FBD_Trunk_Byte09: start 72, 8 bit, little-endian, data-type-policy=OVERRIDE, base-type=uint8, compu {phys=raw}, range phys 0..255
          signal TPBLEParameter_FBD_VM_FBD_Trunk_Byte10: start 80, 8 bit, little-endian, data-type-policy=OVERRIDE, base-type=uint8, compu {phys=raw}, range phys 0..255
          signal TPBLEParameter_FBD_VM_FBD_Trunk_Byte11: start 88, 8 bit, little-endian, data-type-policy=OVERRIDE, base-type=uint8, compu {phys=raw}, range phys 0..255
          signal TPBLEParameter_FBD_VM_FBD_Trunk_Byte12: start 96, 8 bit, little-endian, data-type-policy=OVERRIDE, base-type=uint8, compu {phys=raw}, range phys 0..255
          signal TPBLEParameter_FBD_VM_FBD_Trunk_Byte13: start 104, 8 bit, little-endian, data-type-policy=OVERRIDE, base-type=uint8, compu {phys=raw}, range phys 0..255
          signal TPBLEParameter_FBD_VM_FBD_Trunk_Byte14: start 112, 8 bit, little-endian, data-type-policy=OVERRIDE, base-type=uint8, compu {phys=raw}, range phys 0..255
          signal TPBLEParameter_FBD_VM_FBD_Trunk_Byte15: start 120, 8 bit, little-endian, data-type-policy=OVERRIDE, base-type=uint8, compu {phys=raw}, range phys 0..255
          signal TPBLEParameter_FBD_VM_FBD_Trunk_Byte16: start 128, 8 bit, little-endian, data-type-policy=OVERRIDE, base-type=uint8, compu {phys=raw}, range phys 0..255
          signal TPBLEParameter_FBD_VM_FBD_Trunk_Byte17: start 136, 8 bit, little-endian, data-type-policy=OVERRIDE, base-type=uint8, compu {phys=raw}, range phys 0..255
          signal TPBLEParameter_FBD_VM_FBD_Trunk_Byte18: start 144, 8 bit, little-endian, data-type-policy=OVERRIDE, base-type=uint8, compu {phys=raw}, range phys 0..255
          signal TPBLEParameter_FBD_VM_FBD_Trunk_Byte19: start 152, 8 bit, little-endian, data-type-policy=OVERRIDE, base-type=uint8, compu {phys=raw}, range phys 0..255
          signal TPBLEParameter_FBD_VM_FBD_Trunk_Byte20: start 160, 8 bit, little-endian, data-type-policy=OVERRIDE, base-type=uint8, compu {phys=raw}, range phys 0..255
          signal TPBLEParameter_FBD_VM_FBD_Trunk_Byte21: start 168, 8 bit, little-endian, data-type-policy=OVERRIDE, base-type=uint8, compu {phys=raw}, range phys 0..255
          signal TPBLEParameter_FBD_VM_FBD_Trunk_Byte22: start 176, 8 bit, little-endian, data-type-policy=OVERRIDE, base-type=uint8, compu {phys=raw}, range phys 0..255
          signal TPBLEParameter_FBD_VM_FBD_Trunk_Byte23: start 184, 8 bit, little-endian, data-type-policy=OVERRIDE, base-type=uint8, compu {phys=raw}, range phys 0..255
          signal TPBLEParameter_FBD_VM_FBD_Trunk_Byte24: start 192, 8 bit, little-endian, data-type-policy=OVERRIDE, base-type=uint8, compu {phys=raw}, range phys 0..255
          signal TPBLEParameter_FBD_VM_FBD_Trunk_Byte25: start 200, 8 bit, little-endian, data-type-policy=OVERRIDE, base-type=uint8, compu {phys=raw}, range phys 0..255
          signal TPBLEParameter_FBD_VM_FBD_Trunk_Byte26: start 208, 8 bit, little-endian, data-type-policy=OVERRIDE, base-type=uint8, compu {phys=raw}, range phys 0..255
          signal TPBLEParameter_FBD_VM_FBD_Trunk_Byte27: start 216, 8 bit, little-endian, data-type-policy=OVERRIDE, base-type=uint8, compu {phys=raw}, range phys 0..255
          signal TPBLEParameter_FBD_VM_FBD_Trunk_Byte28: start 224, 8 bit, little-endian, data-type-policy=OVERRIDE, base-type=uint8, compu {phys=raw}, range phys 0..255
          signal TPBLEParameter_FBD_VM_FBD_Trunk_Byte29: start 232, 8 bit, little-endian, data-type-policy=OVERRIDE, base-type=uint8, compu {phys=raw}, range phys 0..255
          signal TPBLEParameter_FBD_VM_FBD_Trunk_Byte30: start 240, 8 bit, little-endian, data-type-policy=OVERRIDE, base-type=uint8, compu {phys=raw}, range phys 0..255
          signal TPBLEParameter_FBD_VM_FBD_Trunk_Byte31: start 248, 8 bit, little-endian, data-type-policy=OVERRIDE, base-type=uint8, compu {phys=raw}, range phys 0..255
          signal TPBLEParameter_FBD_VM_FBD_Trunk_Byte32: start 256, 8 bit, little-endian, data-type-policy=OVERRIDE, base-type=uint8, compu {phys=raw}, range phys 0..255
          signal TPBLEParameter_FBD_VM_FBD_Trunk_Byte33: start 264, 8 bit, little-endian, data-type-policy=OVERRIDE, base-type=uint8, compu {phys=raw}, range phys 0..255
          signal TPBLEParameter_FBD_VM_FBD_Trunk_Byte34: start 272, 8 bit, little-endian, data-type-policy=OVERRIDE, base-type=uint8, compu {phys=raw}, range phys 0..255
          signal TPBLEParameter_FBD_VM_FBD_Trunk_Byte35: start 280, 8 bit, little-endian, data-type-policy=OVERRIDE, base-type=uint8, compu {phys=raw}, range phys 0..255
          signal TPBLEParameter_FBD_VM_FBD_Trunk_Byte36: start 288, 8 bit, little-endian, data-type-policy=OVERRIDE, base-type=uint8, compu {phys=raw}, range phys 0..255
          signal TPBLEParameter_FBD_VM_FBD_Trunk_Byte37: start 296, 8 bit, little-endian, data-type-policy=OVERRIDE, base-type=uint8, compu {phys=raw}, range phys 0..255
          signal TPBLEParameter_FBD_VM_FBD_Trunk_Byte38: start 304, 8 bit, little-endian, data-type-policy=OVERRIDE, base-type=uint8, compu {phys=raw}, range phys 0..255
          signal TPBLEParameter_FBD_VM_FBD_Trunk_Byte39: start 312, 8 bit, little-endian, data-type-policy=OVERRIDE, base-type=uint8, compu {phys=raw}, range phys 0..255
          signal TPBLEParameter_FBD_VM_FBD_Trunk_Byte40: start 320, 8 bit, little-endian, data-type-policy=OVERRIDE, base-type=uint8, compu {phys=raw}, range phys 0..255
          signal TPBLEParameter_FBD_VM_FBD_Trunk_Byte41: start 328, 8 bit, little-endian, data-type-policy=OVERRIDE, base-type=uint8, compu {phys=raw}, range phys 0..255
          signal TPBLEParameter_FBD_VM_FBD_Trunk_Byte42: start 336, 8 bit, little-endian, data-type-policy=OVERRIDE, base-type=uint8, compu {phys=raw}, range phys 0..255
          signal TPBLEParameter_FBD_VM_FBD_Trunk_Byte43: start 344, 8 bit, little-endian, data-type-policy=OVERRIDE, base-type=uint8, compu {phys=raw}, range phys 0..255
          signal TPBLEParameter_FBD_VM_FBD_Trunk_Byte44: start 352, 8 bit, little-endian, data-type-policy=OVERRIDE, base-type=uint8, compu {phys=raw}, range phys 0..255
          signal TPBLEParameter_FBD_VM_FBD_Trunk_Byte45: start 360, 8 bit, little-endian, data-type-policy=OVERRIDE, base-type=uint8, compu {phys=raw}, range phys 0..255
          signal TPBLEParameter_FBD_VM_FBD_Trunk_Byte46: start 368, 8 bit, little-endian, data-type-policy=OVERRIDE, base-type=uint8, compu {phys=raw}, range phys 0..255
          signal TPBLEParameter_FBD_VM_FBD_Trunk_Byte47: start 376, 8 bit, little-endian, data-type-policy=OVERRIDE, base-type=uint8, compu {phys=raw}, range phys 0..255
          signal TPBLEParameter_FBD_VM_FBD_Trunk_Byte48: start 384, 8 bit, little-endian, data-type-policy=OVERRIDE, base-type=uint8, compu {phys=raw}, range phys 0..255
          signal TPBLEParameter_FBD_VM_FBD_Trunk_Byte49: start 392, 8 bit, little-endian, data-type-policy=OVERRIDE, base-type=uint8, compu {phys=raw}, range phys 0..255
          signal TPBLEParameter_FBD_VM_FBD_Trunk_Byte50: start 400, 8 bit, little-endian, data-type-policy=OVERRIDE, base-type=uint8, compu {phys=raw}, range phys 0..255
          signal TPBLEParameter_FBD_VM_FBD_Trunk_Byte51: start 408, 8 bit, little-endian, data-type-policy=OVERRIDE, base-type=uint8, compu {phys=raw}, range phys 0..255
          signal TPBLEParameter_FBD_VM_FBD_Trunk_Byte52: start 416, 8 bit, little-endian, data-type-policy=OVERRIDE, base-type=uint8, compu {phys=raw}, range phys 0..255
          signal TPBLEParameter_FBD_VM_FBD_Trunk_Byte53: start 424, 8 bit, little-endian, data-type-policy=OVERRIDE, base-type=uint8, compu {phys=raw}, range phys 0..255
          signal TPBLEParameter_FBD_VM_FBD_Trunk_Byte54: start 432, 8 bit, little-endian, data-type-policy=OVERRIDE, base-type=uint8, compu {phys=raw}, range phys 0..255
          signal TPBLEParameter_FBD_VM_FBD_Trunk_Byte55: start 440, 8 bit, little-endian, data-type-policy=OVERRIDE, base-type=uint8, compu {phys=raw}, range phys 0..255
          signal TPBLEParameter_FBD_VM_FBD_Trunk_Byte56: start 448, 8 bit, little-endian, data-type-policy=OVERRIDE, base-type=uint8, compu {phys=raw}, range phys 0..255
          signal TPBLEParameter_FBD_VM_FBD_Trunk_Byte57: start 456, 8 bit, little-endian, data-type-policy=OVERRIDE, base-type=uint8, compu {phys=raw}, range phys 0..255
          signal TPBLEParameter_FBD_VM_FBD_Trunk_Byte58: start 464, 8 bit, little-endian, data-type-policy=OVERRIDE, base-type=uint8, compu {phys=raw}, range phys 0..255
          signal TPBLEParameter_FBD_VM_FBD_Trunk_Byte59: start 472, 8 bit, little-endian, data-type-policy=OVERRIDE, base-type=uint8, compu {phys=raw}, range phys 0..255
          signal TPBLEParameter_FBD_VM_FBD_Trunk_Byte60: start 480, 8 bit, little-endian, data-type-policy=OVERRIDE, base-type=uint8, compu {phys=raw}, range phys 0..255
          signal TPBLEParameter_FBD_VM_FBD_Trunk_Byte61: start 488, 8 bit, little-endian, data-type-policy=OVERRIDE, base-type=uint8, compu {phys=raw}, range phys 0..255
          signal TPBLEParameter_FBD_VM_FBD_Trunk_Byte62: start 496, 8 bit, little-endian, data-type-policy=OVERRIDE, base-type=uint8, compu {phys=raw}, range phys 0..255
          signal TPBLEParameter_FBD_VM_FBD_Trunk_Byte63: start 504, 8 bit, little-endian, data-type-policy=OVERRIDE, base-type=uint8, compu {phys=raw}, range phys 0..255
      frame TPBLEParameter_FBD_VM_FBD_VL: id 0x388, frame-length=64, can-addressing-mode=STANDARD, can-frame-rx-behavior=CAN-FD, can-frame-tx-behavior=CAN-FD
        pdu TPBLEParameter_FBD_VM_FBD_VL: length=64, unused-bit-pattern=0
          signal TPBLEParameter_FBD_VM_FBD_VL_Byte00: start 0, 8 bit, little-endian, data-type-policy=OVERRIDE, base-type=uint8, compu {phys=raw}, range phys 0..255
          signal TPBLEParameter_FBD_VM_FBD_VL_Byte01: start 8, 8 bit, little-endian, data-type-policy=OVERRIDE, base-type=uint8, compu {phys=raw}, range phys 0..255
          signal TPBLEParameter_FBD_VM_FBD_VL_Byte02: start 16, 8 bit, little-endian, data-type-policy=OVERRIDE, base-type=uint8, compu {phys=raw}, range phys 0..255
          signal TPBLEParameter_FBD_VM_FBD_VL_Byte03: start 24, 8 bit, little-endian, data-type-policy=OVERRIDE, base-type=uint8, compu {phys=raw}, range phys 0..255
          signal TPBLEParameter_FBD_VM_FBD_VL_Byte04: start 32, 8 bit, little-endian, data-type-policy=OVERRIDE, base-type=uint8, compu {phys=raw}, range phys 0..255
          signal TPBLEParameter_FBD_VM_FBD_VL_Byte05: start 40, 8 bit, little-endian, data-type-policy=OVERRIDE, base-type=uint8, compu {phys=raw}, range phys 0..255
          signal TPBLEParameter_FBD_VM_FBD_VL_Byte06: start 48, 8 bit, little-endian, data-type-policy=OVERRIDE, base-type=uint8, compu {phys=raw}, range phys 0..255
          signal TPBLEParameter_FBD_VM_FBD_VL_Byte07: start 56, 8 bit, little-endian, data-type-policy=OVERRIDE, base-type=uint8, compu {phys=raw}, range phys 0..255
          signal TPBLEParameter_FBD_VM_FBD_VL_Byte08: start 64, 8 bit, little-endian, data-type-policy=OVERRIDE, base-type=uint8, compu {phys=raw}, range phys 0..255
          signal TPBLEParameter_FBD_VM_FBD_VL_Byte09: start 72, 8 bit, little-endian, data-type-policy=OVERRIDE, base-type=uint8, compu {phys=raw}, range phys 0..255
          signal TPBLEParameter_FBD_VM_FBD_VL_Byte10: start 80, 8 bit, little-endian, data-type-policy=OVERRIDE, base-type=uint8, compu {phys=raw}, range phys 0..255
          signal TPBLEParameter_FBD_VM_FBD_VL_Byte11: start 88, 8 bit, little-endian, data-type-policy=OVERRIDE, base-type=uint8, compu {phys=raw}, range phys 0..255
          signal TPBLEParameter_FBD_VM_FBD_VL_Byte12: start 96, 8 bit, little-endian, data-type-policy=OVERRIDE, base-type=uint8, compu {phys=raw}, range phys 0..255
          signal TPBLEParameter_FBD_VM_FBD_VL_Byte13: start 104, 8 bit, little-endian, data-type-policy=OVERRIDE, base-type=uint8, compu {phys=raw}, range phys 0..255
          signal TPBLEParameter_FBD_VM_FBD_VL_Byte14: start 112, 8 bit, little-endian, data-type-policy=OVERRIDE, base-type=uint8, compu {phys=raw}, range phys 0..255
          signal TPBLEParameter_FBD_VM_FBD_VL_Byte15: start 120, 8 bit, little-endian, data-type-policy=OVERRIDE, base-type=uint8, compu {phys=raw}, range phys 0..255
          signal TPBLEParameter_FBD_VM_FBD_VL_Byte16: start 128, 8 bit, little-endian, data-type-policy=OVERRIDE, base-type=uint8, compu {phys=raw}, range phys 0..255
          signal TPBLEParameter_FBD_VM_FBD_VL_Byte17: start 136, 8 bit, little-endian, data-type-policy=OVERRIDE, base-type=uint8, compu {phys=raw}, range phys 0..255
          signal TPBLEParameter_FBD_VM_FBD_VL_Byte18: start 144, 8 bit, little-endian, data-type-policy=OVERRIDE, base-type=uint8, compu {phys=raw}, range phys 0..255
          signal TPBLEParameter_FBD_VM_FBD_VL_Byte19: start 152, 8 bit, little-endian, data-type-policy=OVERRIDE, base-type=uint8, compu {phys=raw}, range phys 0..255
          signal TPBLEParameter_FBD_VM_FBD_VL_Byte20: start 160, 8 bit, little-endian, data-type-policy=OVERRIDE, base-type=uint8, compu {phys=raw}, range phys 0..255
          signal TPBLEParameter_FBD_VM_FBD_VL_Byte21: start 168, 8 bit, little-endian, data-type-policy=OVERRIDE, base-type=uint8, compu {phys=raw}, range phys 0..255
          signal TPBLEParameter_FBD_VM_FBD_VL_Byte22: start 176, 8 bit, little-endian, data-type-policy=OVERRIDE, base-type=uint8, compu {phys=raw}, range phys 0..255
          signal TPBLEParameter_FBD_VM_FBD_VL_Byte23: start 184, 8 bit, little-endian, data-type-policy=OVERRIDE, base-type=uint8, compu {phys=raw}, range phys 0..255
          signal TPBLEParameter_FBD_VM_FBD_VL_Byte24: start 192, 8 bit, little-endian, data-type-policy=OVERRIDE, base-type=uint8, compu {phys=raw}, range phys 0..255
          signal TPBLEParameter_FBD_VM_FBD_VL_Byte25: start 200, 8 bit, little-endian, data-type-policy=OVERRIDE, base-type=uint8, compu {phys=raw}, range phys 0..255
          signal TPBLEParameter_FBD_VM_FBD_VL_Byte26: start 208, 8 bit, little-endian, data-type-policy=OVERRIDE, base-type=uint8, compu {phys=raw}, range phys 0..255
          signal TPBLEParameter_FBD_VM_FBD_VL_Byte27: start 216, 8 bit, little-endian, data-type-policy=OVERRIDE, base-type=uint8, compu {phys=raw}, range phys 0..255
          signal TPBLEParameter_FBD_VM_FBD_VL_Byte28: start 224, 8 bit, little-endian, data-type-policy=OVERRIDE, base-type=uint8, compu {phys=raw}, range phys 0..255
          signal TPBLEParameter_FBD_VM_FBD_VL_Byte29: start 232, 8 bit, little-endian, data-type-policy=OVERRIDE, base-type=uint8, compu {phys=raw}, range phys 0..255
          signal TPBLEParameter_FBD_VM_FBD_VL_Byte30: start 240, 8 bit, little-endian, data-type-policy=OVERRIDE, base-type=uint8, compu {phys=raw}, range phys 0..255
          signal TPBLEParameter_FBD_VM_FBD_VL_Byte31: start 248, 8 bit, little-endian, data-type-policy=OVERRIDE, base-type=uint8, compu {phys=raw}, range phys 0..255
          signal TPBLEParameter_FBD_VM_FBD_VL_Byte32: start 256, 8 bit, little-endian, data-type-policy=OVERRIDE, base-type=uint8, compu {phys=raw}, range phys 0..255
          signal TPBLEParameter_FBD_VM_FBD_VL_Byte33: start 264, 8 bit, little-endian, data-type-policy=OVERRIDE, base-type=uint8, compu {phys=raw}, range phys 0..255
          signal TPBLEParameter_FBD_VM_FBD_VL_Byte34: start 272, 8 bit, little-endian, data-type-policy=OVERRIDE, base-type=uint8, compu {phys=raw}, range phys 0..255
          signal TPBLEParameter_FBD_VM_FBD_VL_Byte35: start 280, 8 bit, little-endian, data-type-policy=OVERRIDE, base-type=uint8, compu {phys=raw}, range phys 0..255
          signal TPBLEParameter_FBD_VM_FBD_VL_Byte36: start 288, 8 bit, little-endian, data-type-policy=OVERRIDE, base-type=uint8, compu {phys=raw}, range phys 0..255
          signal TPBLEParameter_FBD_VM_FBD_VL_Byte37: start 296, 8 bit, little-endian, data-type-policy=OVERRIDE, base-type=uint8, compu {phys=raw}, range phys 0..255
          signal TPBLEParameter_FBD_VM_FBD_VL_Byte38: start 304, 8 bit, little-endian, data-type-policy=OVERRIDE, base-type=uint8, compu {phys=raw}, range phys 0..255
          signal TPBLEParameter_FBD_VM_FBD_VL_Byte39: start 312, 8 bit, little-endian, data-type-policy=OVERRIDE, base-type=uint8, compu {phys=raw}, range phys 0..255
          signal TPBLEParameter_FBD_VM_FBD_VL_Byte40: start 320, 8 bit, little-endian, data-type-policy=OVERRIDE, base-type=uint8, compu {phys=raw}, range phys 0..255
          signal TPBLEParameter_FBD_VM_FBD_VL_Byte41: start 328, 8 bit, little-endian, data-type-policy=OVERRIDE, base-type=uint8, compu {phys=raw}, range phys 0..255
          signal TPBLEParameter_FBD_VM_FBD_VL_Byte42: start 336, 8 bit, little-endian, data-type-policy=OVERRIDE, base-type=uint8, compu {phys=raw}, range phys 0..255
          signal TPBLEParameter_FBD_VM_FBD_VL_Byte43: start 344, 8 bit, little-endian, data-type-policy=OVERRIDE, base-type=uint8, compu {phys=raw}, range phys 0..255
          signal TPBLEParameter_FBD_VM_FBD_VL_Byte44: start 352, 8 bit, little-endian, data-type-policy=OVERRIDE, base-type=uint8, compu {phys=raw}, range phys 0..255
          signal TPBLEParameter_FBD_VM_FBD_VL_Byte45: start 360, 8 bit, little-endian, data-type-policy=OVERRIDE, base-type=uint8, compu {phys=raw}, range phys 0..255
          signal TPBLEParameter_FBD_VM_FBD_VL_Byte46: start 368, 8 bit, little-endian, data-type-policy=OVERRIDE, base-type=uint8, compu {phys=raw}, range phys 0..255
          signal TPBLEParameter_FBD_VM_FBD_VL_Byte47: start 376, 8 bit, little-endian, data-type-policy=OVERRIDE, base-type=uint8, compu {phys=raw}, range phys 0..255
          signal TPBLEParameter_FBD_VM_FBD_VL_Byte48: start 384, 8 bit, little-endian, data-type-policy=OVERRIDE, base-type=uint8, compu {phys=raw}, range phys 0..255
          signal TPBLEParameter_FBD_VM_FBD_VL_Byte49: start 392, 8 bit, little-endian, data-type-policy=OVERRIDE, base-type=uint8, compu {phys=raw}, range phys 0..255
          signal TPBLEParameter_FBD_VM_FBD_VL_Byte50: start 400, 8 bit, little-endian, data-type-policy=OVERRIDE, base-type=uint8, compu {phys=raw}, range phys 0..255
          signal TPBLEParameter_FBD_VM_FBD_VL_Byte51: start 408, 8 bit, little-endian, data-type-policy=OVERRIDE, base-type=uint8, compu {phys=raw}, range phys 0..255
          signal TPBLEParameter_FBD_VM_FBD_VL_Byte52: start 416, 8 bit, little-endian, data-type-policy=OVERRIDE, base-type=uint8, compu {phys=raw}, range phys 0..255
          signal TPBLEParameter_FBD_VM_FBD_VL_Byte53: start 424, 8 bit, little-endian, data-type-policy=OVERRIDE, base-type=uint8, compu {phys=raw}, range phys 0..255
          signal TPBLEParameter_FBD_VM_FBD_VL_Byte54: start 432, 8 bit, little-endian, data-type-policy=OVERRIDE, base-type=uint8, compu {phys=raw}, range phys 0..255
          signal TPBLEParameter_FBD_VM_FBD_VL_Byte55: start 440, 8 bit, little-endian, data-type-policy=OVERRIDE, base-type=uint8, compu {phys=raw}, range phys 0..255
          signal TPBLEParameter_FBD_VM_FBD_VL_Byte56: start 448, 8 bit, little-endian, data-type-policy=OVERRIDE, base-type=uint8, compu {phys=raw}, range phys 0..255
          signal TPBLEParameter_FBD_VM_FBD_VL_Byte57: start 456, 8 bit, little-endian, data-type-policy=OVERRIDE, base-type=uint8, compu {phys=raw}, range phys 0..255
          signal TPBLEParameter_FBD_VM_FBD_VL_Byte58: start 464, 8 bit, little-endian, data-type-policy=OVERRIDE, base-type=uint8, compu {phys=raw}, range phys 0..255
          signal TPBLEParameter_FBD_VM_FBD_VL_Byte59: start 472, 8 bit, little-endian, data-type-policy=OVERRIDE, base-type=uint8, compu {phys=raw}, range phys 0..255
          signal TPBLEParameter_FBD_VM_FBD_VL_Byte60: start 480, 8 bit, little-endian, data-type-policy=OVERRIDE, base-type=uint8, compu {phys=raw}, range phys 0..255
          signal TPBLEParameter_FBD_VM_FBD_VL_Byte61: start 488, 8 bit, little-endian, data-type-policy=OVERRIDE, base-type=uint8, compu {phys=raw}, range phys 0..255
          signal TPBLEParameter_FBD_VM_FBD_VL_Byte62: start 496, 8 bit, little-endian, data-type-policy=OVERRIDE, base-type=uint8, compu {phys=raw}, range phys 0..255
          signal TPBLEParameter_FBD_VM_FBD_VL_Byte63: start 504, 8 bit, little-endian, data-type-policy=OVERRIDE, base-type=uint8, compu {phys=raw}, range phys 0..255
      frame TPBLEParameter_FBD_VM_FBD_VR: id 0x389, frame-length=64, can-addressing-mode=STANDARD, can-frame-rx-behavior=CAN-FD, can-frame-tx-behavior=CAN-FD
        pdu TPBLEParameter_FBD_VM_FBD_VR: length=64, unused-bit-pattern=0
          signal TPBLEParameter_FBD_VM_FBD_VR_Byte00: start 0, 8 bit, little-endian, data-type-policy=OVERRIDE, base-type=uint8, compu {phys=raw}, range phys 0..255
          signal TPBLEParameter_FBD_VM_FBD_VR_Byte01: start 8, 8 bit, little-endian, data-type-policy=OVERRIDE, base-type=uint8, compu {phys=raw}, range phys 0..255
          signal TPBLEParameter_FBD_VM_FBD_VR_Byte02: start 16, 8 bit, little-endian, data-type-policy=OVERRIDE, base-type=uint8, compu {phys=raw}, range phys 0..255
          signal TPBLEParameter_FBD_VM_FBD_VR_Byte03: start 24, 8 bit, little-endian, data-type-policy=OVERRIDE, base-type=uint8, compu {phys=raw}, range phys 0..255
          signal TPBLEParameter_FBD_VM_FBD_VR_Byte04: start 32, 8 bit, little-endian, data-type-policy=OVERRIDE, base-type=uint8, compu {phys=raw}, range phys 0..255
          signal TPBLEParameter_FBD_VM_FBD_VR_Byte05: start 40, 8 bit, little-endian, data-type-policy=OVERRIDE, base-type=uint8, compu {phys=raw}, range phys 0..255
          signal TPBLEParameter_FBD_VM_FBD_VR_Byte06: start 48, 8 bit, little-endian, data-type-policy=OVERRIDE, base-type=uint8, compu {phys=raw}, range phys 0..255
          signal TPBLEParameter_FBD_VM_FBD_VR_Byte07: start 56, 8 bit, little-endian, data-type-policy=OVERRIDE, base-type=uint8, compu {phys=raw}, range phys 0..255
          signal TPBLEParameter_FBD_VM_FBD_VR_Byte08: start 64, 8 bit, little-endian, data-type-policy=OVERRIDE, base-type=uint8, compu {phys=raw}, range phys 0..255
          signal TPBLEParameter_FBD_VM_FBD_VR_Byte09: start 72, 8 bit, little-endian, data-type-policy=OVERRIDE, base-type=uint8, compu {phys=raw}, range phys 0..255
          signal TPBLEParameter_FBD_VM_FBD_VR_Byte10: start 80, 8 bit, little-endian, data-type-policy=OVERRIDE, base-type=uint8, compu {phys=raw}, range phys 0..255
          signal TPBLEParameter_FBD_VM_FBD_VR_Byte11: start 88, 8 bit, little-endian, data-type-policy=OVERRIDE, base-type=uint8, compu {phys=raw}, range phys 0..255
          signal TPBLEParameter_FBD_VM_FBD_VR_Byte12: start 96, 8 bit, little-endian, data-type-policy=OVERRIDE, base-type=uint8, compu {phys=raw}, range phys 0..255
          signal TPBLEParameter_FBD_VM_FBD_VR_Byte13: start 104, 8 bit, little-endian, data-type-policy=OVERRIDE, base-type=uint8, compu {phys=raw}, range phys 0..255
          signal TPBLEParameter_FBD_VM_FBD_VR_Byte14: start 112, 8 bit, little-endian, data-type-policy=OVERRIDE, base-type=uint8, compu {phys=raw}, range phys 0..255
          signal TPBLEParameter_FBD_VM_FBD_VR_Byte15: start 120, 8 bit, little-endian, data-type-policy=OVERRIDE, base-type=uint8, compu {phys=raw}, range phys 0..255
          signal TPBLEParameter_FBD_VM_FBD_VR_Byte16: start 128, 8 bit, little-endian, data-type-policy=OVERRIDE, base-type=uint8, compu {phys=raw}, range phys 0..255
          signal TPBLEParameter_FBD_VM_FBD_VR_Byte17: start 136, 8 bit, little-endian, data-type-policy=OVERRIDE, base-type=uint8, compu {phys=raw}, range phys 0..255
          signal TPBLEParameter_FBD_VM_FBD_VR_Byte18: start 144, 8 bit, little-endian, data-type-policy=OVERRIDE, base-type=uint8, compu {phys=raw}, range phys 0..255
          signal TPBLEParameter_FBD_VM_FBD_VR_Byte19: start 152, 8 bit, little-endian, data-type-policy=OVERRIDE, base-type=uint8, compu {phys=raw}, range phys 0..255
          signal TPBLEParameter_FBD_VM_FBD_VR_Byte20: start 160, 8 bit, little-endian, data-type-policy=OVERRIDE, base-type=uint8, compu {phys=raw}, range phys 0..255
          signal TPBLEParameter_FBD_VM_FBD_VR_Byte21: start 168, 8 bit, little-endian, data-type-policy=OVERRIDE, base-type=uint8, compu {phys=raw}, range phys 0..255
          signal TPBLEParameter_FBD_VM_FBD_VR_Byte22: start 176, 8 bit, little-endian, data-type-policy=OVERRIDE, base-type=uint8, compu {phys=raw}, range phys 0..255
          signal TPBLEParameter_FBD_VM_FBD_VR_Byte23: start 184, 8 bit, little-endian, data-type-policy=OVERRIDE, base-type=uint8, compu {phys=raw}, range phys 0..255
          signal TPBLEParameter_FBD_VM_FBD_VR_Byte24: start 192, 8 bit, little-endian, data-type-policy=OVERRIDE, base-type=uint8, compu {phys=raw}, range phys 0..255
          signal TPBLEParameter_FBD_VM_FBD_VR_Byte25: start 200, 8 bit, little-endian, data-type-policy=OVERRIDE, base-type=uint8, compu {phys=raw}, range phys 0..255
          signal TPBLEParameter_FBD_VM_FBD_VR_Byte26: start 208, 8 bit, little-endian, data-type-policy=OVERRIDE, base-type=uint8, compu {phys=raw}, range phys 0..255
          signal TPBLEParameter_FBD_VM_FBD_VR_Byte27: start 216, 8 bit, little-endian, data-type-policy=OVERRIDE, base-type=uint8, compu {phys=raw}, range phys 0..255
          signal TPBLEParameter_FBD_VM_FBD_VR_Byte28: start 224, 8 bit, little-endian, data-type-policy=OVERRIDE, base-type=uint8, compu {phys=raw}, range phys 0..255
          signal TPBLEParameter_FBD_VM_FBD_VR_Byte29: start 232, 8 bit, little-endian, data-type-policy=OVERRIDE, base-type=uint8, compu {phys=raw}, range phys 0..255
          signal TPBLEParameter_FBD_VM_FBD_VR_Byte30: start 240, 8 bit, little-endian, data-type-policy=OVERRIDE, base-type=uint8, compu {phys=raw}, range phys 0..255
          signal TPBLEParameter_FBD_VM_FBD_VR_Byte31: start 248, 8 bit, little-endian, data-type-policy=OVERRIDE, base-type=uint8, compu {phys=raw}, range phys 0..255
          signal TPBLEParameter_FBD_VM_FBD_VR_Byte32: start 256, 8 bit, little-endian, data-type-policy=OVERRIDE, base-type=uint8, compu {phys=raw}, range phys 0..255
          signal TPBLEParameter_FBD_VM_FBD_VR_Byte33: start 264, 8 bit, little-endian, data-type-policy=OVERRIDE, base-type=uint8, compu {phys=raw}, range phys 0..255
          signal TPBLEParameter_FBD_VM_FBD_VR_Byte34: start 272, 8 bit, little-endian, data-type-policy=OVERRIDE, base-type=uint8, compu {phys=raw}, range phys 0..255
          signal TPBLEParameter_FBD_VM_FBD_VR_Byte35: start 280, 8 bit, little-endian, data-type-policy=OVERRIDE, base-type=uint8, compu {phys=raw}, range phys 0..255
          signal TPBLEParameter_FBD_VM_FBD_VR_Byte36: start 288, 8 bit, little-endian, data-type-policy=OVERRIDE, base-type=uint8, compu {phys=raw}, range phys 0..255
          signal TPBLEParameter_FBD_VM_FBD_VR_Byte37: start 296, 8 bit, little-endian, data-type-policy=OVERRIDE, base-type=uint8, compu {phys=raw}, range phys 0..255
          signal TPBLEParameter_FBD_VM_FBD_VR_Byte38: start 304, 8 bit, little-endian, data-type-policy=OVERRIDE, base-type=uint8, compu {phys=raw}, range phys 0..255
          signal TPBLEParameter_FBD_VM_FBD_VR_Byte39: start 312, 8 bit, little-endian, data-type-policy=OVERRIDE, base-type=uint8, compu {phys=raw}, range phys 0..255
          signal TPBLEParameter_FBD_VM_FBD_VR_Byte40: start 320, 8 bit, little-endian, data-type-policy=OVERRIDE, base-type=uint8, compu {phys=raw}, range phys 0..255
          signal TPBLEParameter_FBD_VM_FBD_VR_Byte41: start 328, 8 bit, little-endian, data-type-policy=OVERRIDE, base-type=uint8, compu {phys=raw}, range phys 0..255
          signal TPBLEParameter_FBD_VM_FBD_VR_Byte42: start 336, 8 bit, little-endian, data-type-policy=OVERRIDE, base-type=uint8, compu {phys=raw}, range phys 0..255
          signal TPBLEParameter_FBD_VM_FBD_VR_Byte43: start 344, 8 bit, little-endian, data-type-policy=OVERRIDE, base-type=uint8, compu {phys=raw}, range phys 0..255
          signal TPBLEParameter_FBD_VM_FBD_VR_Byte44: start 352, 8 bit, little-endian, data-type-policy=OVERRIDE, base-type=uint8, compu {phys=raw}, range phys 0..255
          signal TPBLEParameter_FBD_VM_FBD_VR_Byte45: start 360, 8 bit, little-endian, data-type-policy=OVERRIDE, base-type=uint8, compu {phys=raw}, range phys 0..255
          signal TPBLEParameter_FBD_VM_FBD_VR_Byte46: start 368, 8 bit, little-endian, data-type-policy=OVERRIDE, base-type=uint8, compu {phys=raw}, range phys 0..255
          signal TPBLEParameter_FBD_VM_FBD_VR_Byte47: start 376, 8 bit, little-endian, data-type-policy=OVERRIDE, base-type=uint8, compu {phys=raw}, range phys 0..255
          signal TPBLEParameter_FBD_VM_FBD_VR_Byte48: start 384, 8 bit, little-endian, data-type-policy=OVERRIDE, base-type=uint8, compu {phys=raw}, range phys 0..255
          signal TPBLEParameter_FBD_VM_FBD_VR_Byte49: start 392, 8 bit, little-endian, data-type-policy=OVERRIDE, base-type=uint8, compu {phys=raw}, range phys 0..255
          signal TPBLEParameter_FBD_VM_FBD_VR_Byte50: start 400, 8 bit, little-endian, data-type-policy=OVERRIDE, base-type=uint8, compu {phys=raw}, range phys 0..255
          signal TPBLEParameter_FBD_VM_FBD_VR_Byte51: start 408, 8 bit, little-endian, data-type-policy=OVERRIDE, base-type=uint8, compu {phys=raw}, range phys 0..255
          signal TPBLEParameter_FBD_VM_FBD_VR_Byte52: start 416, 8 bit, little-endian, data-type-policy=OVERRIDE, base-type=uint8, compu {phys=raw}, range phys 0..255
          signal TPBLEParameter_FBD_VM_FBD_VR_Byte53: start 424, 8 bit, little-endian, data-type-policy=OVERRIDE, base-type=uint8, compu {phys=raw}, range phys 0..255
          signal TPBLEParameter_FBD_VM_FBD_VR_Byte54: start 432, 8 bit, little-endian, data-type-policy=OVERRIDE, base-type=uint8, compu {phys=raw}, range phys 0..255
          signal TPBLEParameter_FBD_VM_FBD_VR_Byte55: start 440, 8 bit, little-endian, data-type-policy=OVERRIDE, base-type=uint8, compu {phys=raw}, range phys 0..255
          signal TPBLEParameter_FBD_VM_FBD_VR_Byte56: start 448, 8 bit, little-endian, data-type-policy=OVERRIDE, base-type=uint8, compu {phys=raw}, range phys 0..255
          signal TPBLEParameter_FBD_VM_FBD_VR_Byte57: start 456, 8 bit, little-endian, data-type-policy=OVERRIDE, base-type=uint8, compu {phys=raw}, range phys 0..255
          signal TPBLEParameter_FBD_VM_FBD_VR_Byte58: start 464, 8 bit, little-endian, data-type-policy=OVERRIDE, base-type=uint8, compu {phys=raw}, range phys 0..255
          signal TPBLEParameter_FBD_VM_FBD_VR_Byte59: start 472, 8 bit, little-endian, data-type-policy=OVERRIDE, base-type=uint8, compu {phys=raw}, range phys 0..255
          signal TPBLEParameter_FBD_VM_FBD_VR_Byte60: start 480, 8 bit, little-endian, data-type-policy=OVERRIDE, base-type=uint8, compu {phys=raw}, range phys 0..255
          signal TPBLEParameter_FBD_VM_FBD_VR_Byte61: start 488, 8 bit, little-endian, data-type-policy=OVERRIDE, base-type=uint8, compu {phys=raw}, range phys 0..255
          signal TPBLEParameter_FBD_VM_FBD_VR_Byte62: start 496, 8 bit, little-endian, data-type-policy=OVERRIDE, base-type=uint8, compu {phys=raw}, range phys 0..255
          signal TPBLEParameter_FBD_VM_FBD_VR_Byte63: start 504, 8 bit, little-endian, data-type-policy=OVERRIDE, base-type=uint8, compu {phys=raw}, range phys 0..255
      frame TPBLEParameter_FBD_VR_FBD_VM: id 0x393, frame-length=64, can-addressing-mode=STANDARD, can-frame-rx-behavior=CAN-FD, can-frame-tx-behavior=CAN-FD
        pdu TPBLEParameter_FBD_VR_FBD_VM: length=64, unused-bit-pattern=0
          signal TPBLEParameter_FBD_VR_FBD_VM_Byte00: start 0, 8 bit, little-endian, data-type-policy=OVERRIDE, base-type=uint8, compu {phys=raw}, range phys 0..255
          signal TPBLEParameter_FBD_VR_FBD_VM_Byte01: start 8, 8 bit, little-endian, data-type-policy=OVERRIDE, base-type=uint8, compu {phys=raw}, range phys 0..255
          signal TPBLEParameter_FBD_VR_FBD_VM_Byte02: start 16, 8 bit, little-endian, data-type-policy=OVERRIDE, base-type=uint8, compu {phys=raw}, range phys 0..255
          signal TPBLEParameter_FBD_VR_FBD_VM_Byte03: start 24, 8 bit, little-endian, data-type-policy=OVERRIDE, base-type=uint8, compu {phys=raw}, range phys 0..255
          signal TPBLEParameter_FBD_VR_FBD_VM_Byte04: start 32, 8 bit, little-endian, data-type-policy=OVERRIDE, base-type=uint8, compu {phys=raw}, range phys 0..255
          signal TPBLEParameter_FBD_VR_FBD_VM_Byte05: start 40, 8 bit, little-endian, data-type-policy=OVERRIDE, base-type=uint8, compu {phys=raw}, range phys 0..255
          signal TPBLEParameter_FBD_VR_FBD_VM_Byte06: start 48, 8 bit, little-endian, data-type-policy=OVERRIDE, base-type=uint8, compu {phys=raw}, range phys 0..255
          signal TPBLEParameter_FBD_VR_FBD_VM_Byte07: start 56, 8 bit, little-endian, data-type-policy=OVERRIDE, base-type=uint8, compu {phys=raw}, range phys 0..255
          signal TPBLEParameter_FBD_VR_FBD_VM_Byte08: start 64, 8 bit, little-endian, data-type-policy=OVERRIDE, base-type=uint8, compu {phys=raw}, range phys 0..255
          signal TPBLEParameter_FBD_VR_FBD_VM_Byte09: start 72, 8 bit, little-endian, data-type-policy=OVERRIDE, base-type=uint8, compu {phys=raw}, range phys 0..255
          signal TPBLEParameter_FBD_VR_FBD_VM_Byte10: start 80, 8 bit, little-endian, data-type-policy=OVERRIDE, base-type=uint8, compu {phys=raw}, range phys 0..255
          signal TPBLEParameter_FBD_VR_FBD_VM_Byte11: start 88, 8 bit, little-endian, data-type-policy=OVERRIDE, base-type=uint8, compu {phys=raw}, range phys 0..255
          signal TPBLEParameter_FBD_VR_FBD_VM_Byte12: start 96, 8 bit, little-endian, data-type-policy=OVERRIDE, base-type=uint8, compu {phys=raw}, range phys 0..255
          signal TPBLEParameter_FBD_VR_FBD_VM_Byte13: start 104, 8 bit, little-endian, data-type-policy=OVERRIDE, base-type=uint8, compu {phys=raw}, range phys 0..255
          signal TPBLEParameter_FBD_VR_FBD_VM_Byte14: start 112, 8 bit, little-endian, data-type-policy=OVERRIDE, base-type=uint8, compu {phys=raw}, range phys 0..255
          signal TPBLEParameter_FBD_VR_FBD_VM_Byte15: start 120, 8 bit, little-endian, data-type-policy=OVERRIDE, base-type=uint8, compu {phys=raw}, range phys 0..255
          signal TPBLEParameter_FBD_VR_FBD_VM_Byte16: start 128, 8 bit, little-endian, data-type-policy=OVERRIDE, base-type=uint8, compu {phys=raw}, range phys 0..255
          signal TPBLEParameter_FBD_VR_FBD_VM_Byte17: start 136, 8 bit, little-endian, data-type-policy=OVERRIDE, base-type=uint8, compu {phys=raw}, range phys 0..255
          signal TPBLEParameter_FBD_VR_FBD_VM_Byte18: start 144, 8 bit, little-endian, data-type-policy=OVERRIDE, base-type=uint8, compu {phys=raw}, range phys 0..255
          signal TPBLEParameter_FBD_VR_FBD_VM_Byte19: start 152, 8 bit, little-endian, data-type-policy=OVERRIDE, base-type=uint8, compu {phys=raw}, range phys 0..255
          signal TPBLEParameter_FBD_VR_FBD_VM_Byte20: start 160, 8 bit, little-endian, data-type-policy=OVERRIDE, base-type=uint8, compu {phys=raw}, range phys 0..255
          signal TPBLEParameter_FBD_VR_FBD_VM_Byte21: start 168, 8 bit, little-endian, data-type-policy=OVERRIDE, base-type=uint8, compu {phys=raw}, range phys 0..255
          signal TPBLEParameter_FBD_VR_FBD_VM_Byte22: start 176, 8 bit, little-endian, data-type-policy=OVERRIDE, base-type=uint8, compu {phys=raw}, range phys 0..255
          signal TPBLEParameter_FBD_VR_FBD_VM_Byte23: start 184, 8 bit, little-endian, data-type-policy=OVERRIDE, base-type=uint8, compu {phys=raw}, range phys 0..255
          signal TPBLEParameter_FBD_VR_FBD_VM_Byte24: start 192, 8 bit, little-endian, data-type-policy=OVERRIDE, base-type=uint8, compu {phys=raw}, range phys 0..255
          signal TPBLEParameter_FBD_VR_FBD_VM_Byte25: start 200, 8 bit, little-endian, data-type-policy=OVERRIDE, base-type=uint8, compu {phys=raw}, range phys 0..255
          signal TPBLEParameter_FBD_VR_FBD_VM_Byte26: start 208, 8 bit, little-endian, data-type-policy=OVERRIDE, base-type=uint8, compu {phys=raw}, range phys 0..255
          signal TPBLEParameter_FBD_VR_FBD_VM_Byte27: start 216, 8 bit, little-endian, data-type-policy=OVERRIDE, base-type=uint8, compu {phys=raw}, range phys 0..255
          signal TPBLEParameter_FBD_VR_FBD_VM_Byte28: start 224, 8 bit, little-endian, data-type-policy=OVERRIDE, base-type=uint8, compu {phys=raw}, range phys 0..255
          signal TPBLEParameter_FBD_VR_FBD_VM_Byte29: start 232, 8 bit, little-endian, data-type-policy=OVERRIDE, base-type=uint8, compu {phys=raw}, range phys 0..255
          signal TPBLEParameter_FBD_VR_FBD_VM_Byte30: start 240, 8 bit, little-endian, data-type-policy=OVERRIDE, base-type=uint8, compu {phys=raw}, range phys 0..255
          signal TPBLEParameter_FBD_VR_FBD_VM_Byte31: start 248, 8 bit, little-endian, data-type-policy=OVERRIDE, base-type=uint8, compu {phys=raw}, range phys 0..255
          signal TPBLEParameter_FBD_VR_FBD_VM_Byte32: start 256, 8 bit, little-endian, data-type-policy=OVERRIDE, base-type=uint8, compu {phys=raw}, range phys 0..255
          signal TPBLEParameter_FBD_VR_FBD_VM_Byte33: start 264, 8 bit, little-endian, data-type-policy=OVERRIDE, base-type=uint8, compu {phys=raw}, range phys 0..255
          signal TPBLEParameter_FBD_VR_FBD_VM_Byte34: start 272, 8 bit, little-endian, data-type-policy=OVERRIDE, base-type=uint8, compu {phys=raw}, range phys 0..255
          signal TPBLEParameter_FBD_VR_FBD_VM_Byte35: start 280, 8 bit, little-endian, data-type-policy=OVERRIDE, base-type=uint8, compu {phys=raw}, range phys 0..255
          signal TPBLEParameter_FBD_VR_FBD_VM_Byte36: start 288, 8 bit, little-endian, data-type-policy=OVERRIDE, base-type=uint8, compu {phys=raw}, range phys 0..255
          signal TPBLEParameter_FBD_VR_FBD_VM_Byte37: start 296, 8 bit, little-endian, data-type-policy=OVERRIDE, base-type=uint8, compu {phys=raw}, range phys 0..255
          signal TPBLEParameter_FBD_VR_FBD_VM_Byte38: start 304, 8 bit, little-endian, data-type-policy=OVERRIDE, base-type=uint8, compu {phys=raw}, range phys 0..255
          signal TPBLEParameter_FBD_VR_FBD_VM_Byte39: start 312, 8 bit, little-endian, data-type-policy=OVERRIDE, base-type=uint8, compu {phys=raw}, range phys 0..255
          signal TPBLEParameter_FBD_VR_FBD_VM_Byte40: start 320, 8 bit, little-endian, data-type-policy=OVERRIDE, base-type=uint8, compu {phys=raw}, range phys 0..255
          signal TPBLEParameter_FBD_VR_FBD_VM_Byte41: start 328, 8 bit, little-endian, data-type-policy=OVERRIDE, base-type=uint8, compu {phys=raw}, range phys 0..255
          signal TPBLEParameter_FBD_VR_FBD_VM_Byte42: start 336, 8 bit, little-endian, data-type-policy=OVERRIDE, base-type=uint8, compu {phys=raw}, range phys 0..255
          signal TPBLEParameter_FBD_VR_FBD_VM_Byte43: start 344, 8 bit, little-endian, data-type-policy=OVERRIDE, base-type=uint8, compu {phys=raw}, range phys 0..255
          signal TPBLEParameter_FBD_VR_FBD_VM_Byte44: start 352, 8 bit, little-endian, data-type-policy=OVERRIDE, base-type=uint8, compu {phys=raw}, range phys 0..255
          signal TPBLEParameter_FBD_VR_FBD_VM_Byte45: start 360, 8 bit, little-endian, data-type-policy=OVERRIDE, base-type=uint8, compu {phys=raw}, range phys 0..255
          signal TPBLEParameter_FBD_VR_FBD_VM_Byte46: start 368, 8 bit, little-endian, data-type-policy=OVERRIDE, base-type=uint8, compu {phys=raw}, range phys 0..255
          signal TPBLEParameter_FBD_VR_FBD_VM_Byte47: start 376, 8 bit, little-endian, data-type-policy=OVERRIDE, base-type=uint8, compu {phys=raw}, range phys 0..255
          signal TPBLEParameter_FBD_VR_FBD_VM_Byte48: start 384, 8 bit, little-endian, data-type-policy=OVERRIDE, base-type=uint8, compu {phys=raw}, range phys 0..255
          signal TPBLEParameter_FBD_VR_FBD_VM_Byte49: start 392, 8 bit, little-endian, data-type-policy=OVERRIDE, base-type=uint8, compu {phys=raw}, range phys 0..255
          signal TPBLEParameter_FBD_VR_FBD_VM_Byte50: start 400, 8 bit, little-endian, data-type-policy=OVERRIDE, base-type=uint8, compu {phys=raw}, range phys 0..255
          signal TPBLEParameter_FBD_VR_FBD_VM_Byte51: start 408, 8 bit, little-endian, data-type-policy=OVERRIDE, base-type=uint8, compu {phys=raw}, range phys 0..255
          signal TPBLEParameter_FBD_VR_FBD_VM_Byte52: start 416, 8 bit, little-endian, data-type-policy=OVERRIDE, base-type=uint8, compu {phys=raw}, range phys 0..255
          signal TPBLEParameter_FBD_VR_FBD_VM_Byte53: start 424, 8 bit, little-endian, data-type-policy=OVERRIDE, base-type=uint8, compu {phys=raw}, range phys 0..255
          signal TPBLEParameter_FBD_VR_FBD_VM_Byte54: start 432, 8 bit, little-endian, data-type-policy=OVERRIDE, base-type=uint8, compu {phys=raw}, range phys 0..255
          signal TPBLEParameter_FBD_VR_FBD_VM_Byte55: start 440, 8 bit, little-endian, data-type-policy=OVERRIDE, base-type=uint8, compu {phys=raw}, range phys 0..255
          signal TPBLEParameter_FBD_VR_FBD_VM_Byte56: start 448, 8 bit, little-endian, data-type-policy=OVERRIDE, base-type=uint8, compu {phys=raw}, range phys 0..255
          signal TPBLEParameter_FBD_VR_FBD_VM_Byte57: start 456, 8 bit, little-endian, data-type-policy=OVERRIDE, base-type=uint8, compu {phys=raw}, range phys 0..255
          signal TPBLEParameter_FBD_VR_FBD_VM_Byte58: start 464, 8 bit, little-endian, data-type-policy=OVERRIDE, base-type=uint8, compu {phys=raw}, range phys 0..255
          signal TPBLEParameter_FBD_VR_FBD_VM_Byte59: start 472, 8 bit, little-endian, data-type-policy=OVERRIDE, base-type=uint8, compu {phys=raw}, range phys 0..255
          signal TPBLEParameter_FBD_VR_FBD_VM_Byte60: start 480, 8 bit, little-endian, data-type-policy=OVERRIDE, base-type=uint8, compu {phys=raw}, range phys 0..255
          signal TPBLEParameter_FBD_VR_FBD_VM_Byte61: start 488, 8 bit, little-endian, data-type-policy=OVERRIDE, base-type=uint8, compu {phys=raw}, range phys 0..255
          signal TPBLEParameter_FBD_VR_FBD_VM_Byte62: start 496, 8 bit, little-endian, data-type-policy=OVERRIDE, base-type=uint8, compu {phys=raw}, range phys 0..255
          signal TPBLEParameter_FBD_VR_FBD_VM_Byte63: start 504, 8 bit, little-endian, data-type-policy=OVERRIDE, base-type=uint8, compu {phys=raw}, range phys 0..255
      frame TPDiagnosisFlash_FBD_HL_IPB: id 0x2CC, frame-length=64, can-addressing-mode=STANDARD, can-frame-rx-behavior=CAN-FD, can-frame-tx-behavior=CAN-FD
        pdu TPDiagnosisFlash_FBD_HL_IPB: length=64, unused-bit-pattern=0
          signal TPDiagnosisFlashFBD_HLIPB_Byte00: start 0, 8 bit, little-endian, data-type-policy=OVERRIDE, base-type=uint8, compu {phys=raw}, range phys 0..252
          signal TPDiagnosisFlashFBD_HLIPB_Byte01: start 8, 8 bit, little-endian, data-type-policy=OVERRIDE, base-type=uint8, compu {phys=raw}, range phys 0..252
          signal TPDiagnosisFlashFBD_HLIPB_Byte02: start 16, 8 bit, little-endian, data-type-policy=OVERRIDE, base-type=uint8, compu {phys=raw}, range phys 0..252
          signal TPDiagnosisFlashFBD_HLIPB_Byte03: start 24, 8 bit, little-endian, data-type-policy=OVERRIDE, base-type=uint8, compu {phys=raw}, range phys 0..252
          signal TPDiagnosisFlashFBD_HLIPB_Byte04: start 32, 8 bit, little-endian, data-type-policy=OVERRIDE, base-type=uint8, compu {phys=raw}, range phys 0..252
          signal TPDiagnosisFlashFBD_HLIPB_Byte05: start 40, 8 bit, little-endian, data-type-policy=OVERRIDE, base-type=uint8, compu {phys=raw}, range phys 0..252
          signal TPDiagnosisFlashFBD_HLIPB_Byte06: start 48, 8 bit, little-endian, data-type-policy=OVERRIDE, base-type=uint8, compu {phys=raw}, range phys 0..252
          signal TPDiagnosisFlashFBD_HLIPB_Byte07: start 56, 8 bit, little-endian, data-type-policy=OVERRIDE, base-type=uint8, compu {phys=raw}, range phys 0..252
          signal TPDiagnosisFlashFBD_HLIPB_Byte08: start 64, 8 bit, little-endian, data-type-policy=OVERRIDE, base-type=uint8, compu {phys=raw}, range phys 0..252
          signal TPDiagnosisFlashFBD_HLIPB_Byte09: start 72, 8 bit, little-endian, data-type-policy=OVERRIDE, base-type=uint8, compu {phys=raw}, range phys 0..252
          signal TPDiagnosisFlashFBD_HLIPB_Byte10: start 80, 8 bit, little-endian, data-type-policy=OVERRIDE, base-type=uint8, compu {phys=raw}, range phys 0..252
          signal TPDiagnosisFlashFBD_HLIPB_Byte11: start 88, 8 bit, little-endian, data-type-policy=OVERRIDE, base-type=uint8, compu {phys=raw}, range phys 0..252
          signal TPDiagnosisFlashFBD_HLIPB_Byte12: start 96, 8 bit, little-endian, data-type-policy=OVERRIDE, base-type=uint8, compu {phys=raw}, range phys 0..252
          signal TPDiagnosisFlashFBD_HLIPB_Byte13: start 104, 8 bit, little-endian, data-type-policy=OVERRIDE, base-type=uint8, compu {phys=raw}, range phys 0..252
          signal TPDiagnosisFlashFBD_HLIPB_Byte14: start 112, 8 bit, little-endian, data-type-policy=OVERRIDE, base-type=uint8, compu {phys=raw}, range phys 0..252
          signal TPDiagnosisFlashFBD_HLIPB_Byte15: start 120, 8 bit, little-endian, data-type-policy=OVERRIDE, base-type=uint8, compu {phys=raw}, range phys 0..252
          signal TPDiagnosisFlashFBD_HLIPB_Byte16: start 128, 8 bit, little-endian, data-type-policy=OVERRIDE, base-type=uint8, compu {phys=raw}, range phys 0..252
          signal TPDiagnosisFlashFBD_HLIPB_Byte17: start 136, 8 bit, little-endian, data-type-policy=OVERRIDE, base-type=uint8, compu {phys=raw}, range phys 0..252
          signal TPDiagnosisFlashFBD_HLIPB_Byte18: start 144, 8 bit, little-endian, data-type-policy=OVERRIDE, base-type=uint8, compu {phys=raw}, range phys 0..252
          signal TPDiagnosisFlashFBD_HLIPB_Byte19: start 152, 8 bit, little-endian, data-type-policy=OVERRIDE, base-type=uint8, compu {phys=raw}, range phys 0..252
          signal TPDiagnosisFlashFBD_HLIPB_Byte20: start 160, 8 bit, little-endian, data-type-policy=OVERRIDE, base-type=uint8, compu {phys=raw}, range phys 0..252
          signal TPDiagnosisFlashFBD_HLIPB_Byte21: start 168, 8 bit, little-endian, data-type-policy=OVERRIDE, base-type=uint8, compu {phys=raw}, range phys 0..252
          signal TPDiagnosisFlashFBD_HLIPB_Byte22: start 176, 8 bit, little-endian, data-type-policy=OVERRIDE, base-type=uint8, compu {phys=raw}, range phys 0..252
          signal TPDiagnosisFlashFBD_HLIPB_Byte23: start 184, 8 bit, little-endian, data-type-policy=OVERRIDE, base-type=uint8, compu {phys=raw}, range phys 0..252
          signal TPDiagnosisFlashFBD_HLIPB_Byte24: start 192, 8 bit, little-endian, data-type-policy=OVERRIDE, base-type=uint8, compu {phys=raw}, range phys 0..252
          signal TPDiagnosisFlashFBD_HLIPB_Byte25: start 200, 8 bit, little-endian, data-type-policy=OVERRIDE, base-type=uint8, compu {phys=raw}, range phys 0..252
          signal TPDiagnosisFlashFBD_HLIPB_Byte26: start 208, 8 bit, little-endian, data-type-policy=OVERRIDE, base-type=uint8, compu {phys=raw}, range phys 0..252
          signal TPDiagnosisFlashFBD_HLIPB_Byte27: start 216, 8 bit, little-endian, data-type-policy=OVERRIDE, base-type=uint8, compu {phys=raw}, range phys 0..252
          signal TPDiagnosisFlashFBD_HLIPB_Byte28: start 224, 8 bit, little-endian, data-type-policy=OVERRIDE, base-type=uint8, compu {phys=raw}, range phys 0..252
          signal TPDiagnosisFlashFBD_HLIPB_Byte29: start 232, 8 bit, little-endian, data-type-policy=OVERRIDE, base-type=uint8, compu {phys=raw}, range phys 0..252
          signal TPDiagnosisFlashFBD_HLIPB_Byte30: start 240, 8 bit, little-endian, data-type-policy=OVERRIDE, base-type=uint8, compu {phys=raw}, range phys 0..252
          signal TPDiagnosisFlashFBD_HLIPB_Byte31: start 248, 8 bit, little-endian, data-type-policy=OVERRIDE, base-type=uint8, compu {phys=raw}, range phys 0..252
          signal TPDiagnosisFlashFBD_HLIPB_Byte32: start 256, 8 bit, little-endian, data-type-policy=OVERRIDE, base-type=uint8, compu {phys=raw}, range phys 0..252
          signal TPDiagnosisFlashFBD_HLIPB_Byte33: start 264, 8 bit, little-endian, data-type-policy=OVERRIDE, base-type=uint8, compu {phys=raw}, range phys 0..252
          signal TPDiagnosisFlashFBD_HLIPB_Byte34: start 272, 8 bit, little-endian, data-type-policy=OVERRIDE, base-type=uint8, compu {phys=raw}, range phys 0..252
          signal TPDiagnosisFlashFBD_HLIPB_Byte35: start 280, 8 bit, little-endian, data-type-policy=OVERRIDE, base-type=uint8, compu {phys=raw}, range phys 0..252
          signal TPDiagnosisFlashFBD_HLIPB_Byte36: start 288, 8 bit, little-endian, data-type-policy=OVERRIDE, base-type=uint8, compu {phys=raw}, range phys 0..252
          signal TPDiagnosisFlashFBD_HLIPB_Byte37: start 296, 8 bit, little-endian, data-type-policy=OVERRIDE, base-type=uint8, compu {phys=raw}, range phys 0..252
          signal TPDiagnosisFlashFBD_HLIPB_Byte38: start 304, 8 bit, little-endian, data-type-policy=OVERRIDE, base-type=uint8, compu {phys=raw}, range phys 0..252
          signal TPDiagnosisFlashFBD_HLIPB_Byte39: start 312, 8 bit, little-endian, data-type-policy=OVERRIDE, base-type=uint8, compu {phys=raw}, range phys 0..252
          signal TPDiagnosisFlashFBD_HLIPB_Byte40: start 320, 8 bit, little-endian, data-type-policy=OVERRIDE, base-type=uint8, compu {phys=raw}, range phys 0..252
          signal TPDiagnosisFlashFBD_HLIPB_Byte41: start 328, 8 bit, little-endian, data-type-policy=OVERRIDE, base-type=uint8, compu {phys=raw}, range phys 0..252
          signal TPDiagnosisFlashFBD_HLIPB_Byte42: start 336, 8 bit, little-endian, data-type-policy=OVERRIDE, base-type=uint8, compu {phys=raw}, range phys 0..252
          signal TPDiagnosisFlashFBD_HLIPB_Byte43: start 344, 8 bit, little-endian, data-type-policy=OVERRIDE, base-type=uint8, compu {phys=raw}, range phys 0..252
          signal TPDiagnosisFlashFBD_HLIPB_Byte44: start 352, 8 bit, little-endian, data-type-policy=OVERRIDE, base-type=uint8, compu {phys=raw}, range phys 0..252
          signal TPDiagnosisFlashFBD_HLIPB_Byte45: start 360, 8 bit, little-endian, data-type-policy=OVERRIDE, base-type=uint8, compu {phys=raw}, range phys 0..252
          signal TPDiagnosisFlashFBD_HLIPB_Byte46: start 368, 8 bit, little-endian, data-type-policy=OVERRIDE, base-type=uint8, compu {phys=raw}, range phys 0..252
          signal TPDiagnosisFlashFBD_HLIPB_Byte47: start 376, 8 bit, little-endian, data-type-policy=OVERRIDE, base-type=uint8, compu {phys=raw}, range phys 0..252
          signal TPDiagnosisFlashFBD_HLIPB_Byte48: start 384, 8 bit, little-endian, data-type-policy=OVERRIDE, base-type=uint8, compu {phys=raw}, range phys 0..252
          signal TPDiagnosisFlashFBD_HLIPB_Byte49: start 392, 8 bit, little-endian, data-type-policy=OVERRIDE, base-type=uint8, compu {phys=raw}, range phys 0..252
          signal TPDiagnosisFlashFBD_HLIPB_Byte50: start 400, 8 bit, little-endian, data-type-policy=OVERRIDE, base-type=uint8, compu {phys=raw}, range phys 0..252
          signal TPDiagnosisFlashFBD_HLIPB_Byte51: start 408, 8 bit, little-endian, data-type-policy=OVERRIDE, base-type=uint8, compu {phys=raw}, range phys 0..252
          signal TPDiagnosisFlashFBD_HLIPB_Byte52: start 416, 8 bit, little-endian, data-type-policy=OVERRIDE, base-type=uint8, compu {phys=raw}, range phys 0..252
          signal TPDiagnosisFlashFBD_HLIPB_Byte53: start 424, 8 bit, little-endian, data-type-policy=OVERRIDE, base-type=uint8, compu {phys=raw}, range phys 0..252
          signal TPDiagnosisFlashFBD_HLIPB_Byte54: start 432, 8 bit, little-endian, data-type-policy=OVERRIDE, base-type=uint8, compu {phys=raw}, range phys 0..252
          signal TPDiagnosisFlashFBD_HLIPB_Byte55: start 440, 8 bit, little-endian, data-type-policy=OVERRIDE, base-type=uint8, compu {phys=raw}, range phys 0..252
          signal TPDiagnosisFlashFBD_HLIPB_Byte56: start 448, 8 bit, little-endian, data-type-policy=OVERRIDE, base-type=uint8, compu {phys=raw}, range phys 0..252
          signal TPDiagnosisFlashFBD_HLIPB_Byte57: start 456, 8 bit, little-endian, data-type-policy=OVERRIDE, base-type=uint8, compu {phys=raw}, range phys 0..252
          signal TPDiagnosisFlashFBD_HLIPB_Byte58: start 464, 8 bit, little-endian, data-type-policy=OVERRIDE, base-type=uint8, compu {phys=raw}, range phys 0..252
          signal TPDiagnosisFlashFBD_HLIPB_Byte59: start 472, 8 bit, little-endian, data-type-policy=OVERRIDE, base-type=uint8, compu {phys=raw}, range phys 0..252
          signal TPDiagnosisFlashFBD_HLIPB_Byte60: start 480, 8 bit, little-endian, data-type-policy=OVERRIDE, base-type=uint8, compu {phys=raw}, range phys 0..252
          signal TPDiagnosisFlashFBD_HLIPB_Byte61: start 488, 8 bit, little-endian, data-type-policy=OVERRIDE, base-type=uint8, compu {phys=raw}, range phys 0..252
          signal TPDiagnosisFlashFBD_HLIPB_Byte62: start 496, 8 bit, little-endian, data-type-policy=OVERRIDE, base-type=uint8, compu {phys=raw}, range phys 0..252
          signal TPDiagnosisFlashFBD_HLIPB_Byte63: start 504, 8 bit, little-endian, data-type-policy=OVERRIDE, base-type=uint8, compu {phys=raw}, range phys 0..252
      frame TPDiagnosisFlash_FBD_HM_IPB: id 0x2C7, frame-length=64, can-addressing-mode=STANDARD, can-frame-rx-behavior=CAN-FD, can-frame-tx-behavior=CAN-FD
        pdu TPDiagnosisFlash_FBD_HM_IPB: length=64, unused-bit-pattern=0
          signal TPDiagnosisFlashFBD_HMIPB_Byte00: start 0, 8 bit, little-endian, data-type-policy=OVERRIDE, base-type=uint8, compu {phys=raw}, range phys 0..252
          signal TPDiagnosisFlashFBD_HMIPB_Byte01: start 8, 8 bit, little-endian, data-type-policy=OVERRIDE, base-type=uint8, compu {phys=raw}, range phys 0..252
          signal TPDiagnosisFlashFBD_HMIPB_Byte02: start 16, 8 bit, little-endian, data-type-policy=OVERRIDE, base-type=uint8, compu {phys=raw}, range phys 0..252
          signal TPDiagnosisFlashFBD_HMIPB_Byte03: start 24, 8 bit, little-endian, data-type-policy=OVERRIDE, base-type=uint8, compu {phys=raw}, range phys 0..252
          signal TPDiagnosisFlashFBD_HMIPB_Byte04: start 32, 8 bit, little-endian, data-type-policy=OVERRIDE, base-type=uint8, compu {phys=raw}, range phys 0..252
          signal TPDiagnosisFlashFBD_HMIPB_Byte05: start 40, 8 bit, little-endian, data-type-policy=OVERRIDE, base-type=uint8, compu {phys=raw}, range phys 0..252
          signal TPDiagnosisFlashFBD_HMIPB_Byte06: start 48, 8 bit, little-endian, data-type-policy=OVERRIDE, base-type=uint8, compu {phys=raw}, range phys 0..252
          signal TPDiagnosisFlashFBD_HMIPB_Byte07: start 56, 8 bit, little-endian, data-type-policy=OVERRIDE, base-type=uint8, compu {phys=raw}, range phys 0..252
          signal TPDiagnosisFlashFBD_HMIPB_Byte08: start 64, 8 bit, little-endian, data-type-policy=OVERRIDE, base-type=uint8, compu {phys=raw}, range phys 0..252
          signal TPDiagnosisFlashFBD_HMIPB_Byte09: start 72, 8 bit, little-endian, data-type-policy=OVERRIDE, base-type=uint8, compu {phys=raw}, range phys 0..252
          signal TPDiagnosisFlashFBD_HMIPB_Byte10: start 80, 8 bit, little-endian, data-type-policy=OVERRIDE, base-type=uint8, compu {phys=raw}, range phys 0..252
          signal TPDiagnosisFlashFBD_HMIPB_Byte11: start 88, 8 bit, little-endian, data-type-policy=OVERRIDE, base-type=uint8, compu {phys=raw}, range phys 0..252
          signal TPDiagnosisFlashFBD_HMIPB_Byte12: start 96, 8 bit, little-endian, data-type-policy=OVERRIDE, base-type=uint8, compu {phys=raw}, range phys 0..252
          signal TPDiagnosisFlashFBD_HMIPB_Byte13: start 104, 8 bit, little-endian, data-type-policy=OVERRIDE, base-type=uint8, compu {phys=raw}, range phys 0..252
          signal TPDiagnosisFlashFBD_HMIPB_Byte14: start 112, 8 bit, little-endian, data-type-policy=OVERRIDE, base-type=uint8, compu {phys=raw}, range phys 0..252
          signal TPDiagnosisFlashFBD_HMIPB_Byte15: start 120, 8 bit, little-endian, data-type-policy=OVERRIDE, base-type=uint8, compu {phys=raw}, range phys 0..252
          signal TPDiagnosisFlashFBD_HMIPB_Byte16: start 128, 8 bit, little-endian, data-type-policy=OVERRIDE, base-type=uint8, compu {phys=raw}, range phys 0..252
          signal TPDiagnosisFlashFBD_HMIPB_Byte17: start 136, 8 bit, little-endian, data-type-policy=OVERRIDE, base-type=uint8, compu {phys=raw}, range phys 0..252
          signal TPDiagnosisFlashFBD_HMIPB_Byte18: start 144, 8 bit, little-endian, data-type-policy=OVERRIDE, base-type=uint8, compu {phys=raw}, range phys 0..252
          signal TPDiagnosisFlashFBD_HMIPB_Byte19: start 152, 8 bit, little-endian, data-type-policy=OVERRIDE, base-type=uint8, compu {phys=raw}, range phys 0..252
          signal TPDiagnosisFlashFBD_HMIPB_Byte20: start 160, 8 bit, little-endian, data-type-policy=OVERRIDE, base-type=uint8, compu {phys=raw}, range phys 0..252
          signal TPDiagnosisFlashFBD_HMIPB_Byte21: start 168, 8 bit, little-endian, data-type-policy=OVERRIDE, base-type=uint8, compu {phys=raw}, range phys 0..252
          signal TPDiagnosisFlashFBD_HMIPB_Byte22: start 176, 8 bit, little-endian, data-type-policy=OVERRIDE, base-type=uint8, compu {phys=raw}, range phys 0..252
          signal TPDiagnosisFlashFBD_HMIPB_Byte23: start 184, 8 bit, little-endian, data-type-policy=OVERRIDE, base-type=uint8, compu {phys=raw}, range phys 0..252
          signal TPDiagnosisFlashFBD_HMIPB_Byte24: start 192, 8 bit, little-endian, data-type-policy=OVERRIDE, base-type=uint8, compu {phys=raw}, range phys 0..252
          signal TPDiagnosisFlashFBD_HMIPB_Byte25: start 200, 8 bit, little-endian, data-type-policy=OVERRIDE, base-type=uint8, compu {phys=raw}, range phys 0..252
          signal TPDiagnosisFlashFBD_HMIPB_Byte26: start 208, 8 bit, little-endian, data-type-policy=OVERRIDE, base-type=uint8, compu {phys=raw}, range phys 0..252
          signal TPDiagnosisFlashFBD_HMIPB_Byte27: start 216, 8 bit, little-endian, data-type-policy=OVERRIDE, base-type=uint8, compu {phys=raw}, range phys 0..252
          signal TPDiagnosisFlashFBD_HMIPB_Byte28: start 224, 8 bit, little-endian, data-type-policy=OVERRIDE, base-type=uint8, compu {phys=raw}, range phys 0..252
          signal TPDiagnosisFlashFBD_HMIPB_Byte29: start 232, 8 bit, little-endian, data-type-policy=OVERRIDE, base-type=uint8, compu {phys=raw}, range phys 0..252
          signal TPDiagnosisFlashFBD_HMIPB_Byte30: start 240, 8 bit, little-endian, data-type-policy=OVERRIDE, base-type=uint8, compu {phys=raw}, range phys 0..252
          signal TPDiagnosisFlashFBD_HMIPB_Byte31: start 248, 8 bit, little-endian, data-type-policy=OVERRIDE, base-type=uint8, compu {phys=raw}, range phys 0..252
          signal TPDiagnosisFlashFBD_HMIPB_Byte32: start 256, 8 bit, little-endian, data-type-policy=OVERRIDE, base-type=uint8, compu {phys=raw}, range phys 0..252
          signal TPDiagnosisFlashFBD_HMIPB_Byte33: start 264, 8 bit, little-endian, data-type-policy=OVERRIDE, base-type=uint8, compu {phys=raw}, range phys 0..252
          signal TPDiagnosisFlashFBD_HMIPB_Byte34: start 272, 8 bit, little-endian, data-type-policy=OVERRIDE, base-type=uint8, compu {phys=raw}, range phys 0..252
          signal TPDiagnosisFlashFBD_HMIPB_Byte35: start 280, 8 bit, little-endian, data-type-policy=OVERRIDE, base-type=uint8, compu {phys=raw}, range phys 0..252
          signal TPDiagnosisFlashFBD_HMIPB_Byte36: start 288, 8 bit, little-endian, data-type-policy=OVERRIDE, base-type=uint8, compu {phys=raw}, range phys 0..252
          signal TPDiagnosisFlashFBD_HMIPB_Byte37: start 296, 8 bit, little-endian, data-type-policy=OVERRIDE, base-type=uint8, compu {phys=raw}, range phys 0..252
          signal TPDiagnosisFlashFBD_HMIPB_Byte38: start 304, 8 bit, little-endian, data-type-policy=OVERRIDE, base-type=uint8, compu {phys=raw}, range phys 0..252
          signal TPDiagnosisFlashFBD_HMIPB_Byte39: start 312, 8 bit, little-endian, data-type-policy=OVERRIDE, base-type=uint8, compu {phys=raw}, range phys 0..252
          signal TPDiagnosisFlashFBD_HMIPB_Byte40: start 320, 8 bit, little-endian, data-type-policy=OVERRIDE, base-type=uint8, compu {phys=raw}, range phys 0..252
          signal TPDiagnosisFlashFBD_HMIPB_Byte41: start 328, 8 bit, little-endian, data-type-policy=OVERRIDE, base-type=uint8, compu {phys=raw}, range phys 0..252
          signal TPDiagnosisFlashFBD_HMIPB_Byte42: start 336, 8 bit, little-endian, data-type-policy=OVERRIDE, base-type=uint8, compu {phys=raw}, range phys 0..252
          signal TPDiagnosisFlashFBD_HMIPB_Byte43: start 344, 8 bit, little-endian, data-type-policy=OVERRIDE, base-type=uint8, compu {phys=raw}, range phys 0..252
          signal TPDiagnosisFlashFBD_HMIPB_Byte44: start 352, 8 bit, little-endian, data-type-policy=OVERRIDE, base-type=uint8, compu {phys=raw}, range phys 0..252
          signal TPDiagnosisFlashFBD_HMIPB_Byte45: start 360, 8 bit, little-endian, data-type-policy=OVERRIDE, base-type=uint8, compu {phys=raw}, range phys 0..252
          signal TPDiagnosisFlashFBD_HMIPB_Byte46: start 368, 8 bit, little-endian, data-type-policy=OVERRIDE, base-type=uint8, compu {phys=raw}, range phys 0..252
          signal TPDiagnosisFlashFBD_HMIPB_Byte47: start 376, 8 bit, little-endian, data-type-policy=OVERRIDE, base-type=uint8, compu {phys=raw}, range phys 0..252
          signal TPDiagnosisFlashFBD_HMIPB_Byte48: start 384, 8 bit, little-endian, data-type-policy=OVERRIDE, base-type=uint8, compu {phys=raw}, range phys 0..252
          signal TPDiagnosisFlashFBD_HMIPB_Byte49: start 392, 8 bit, little-endian, data-type-policy=OVERRIDE, base-type=uint8, compu {phys=raw}, range phys 0..252
          signal TPDiagnosisFlashFBD_HMIPB_Byte50: start 400, 8 bit, little-endian, data-type-policy=OVERRIDE, base-type=uint8, compu {phys=raw}, range phys 0..252
          signal TPDiagnosisFlashFBD_HMIPB_Byte51: start 408, 8 bit, little-endian, data-type-policy=OVERRIDE, base-type=uint8, compu {phys=raw}, range phys 0..252
          signal TPDiagnosisFlashFBD_HMIPB_Byte52: start 416, 8 bit, little-endian, data-type-policy=OVERRIDE, base-type=uint8, compu {phys=raw}, range phys 0..252
          signal TPDiagnosisFlashFBD_HMIPB_Byte53: start 424, 8 bit, little-endian, data-type-policy=OVERRIDE, base-type=uint8, compu {phys=raw}, range phys 0..252
          signal TPDiagnosisFlashFBD_HMIPB_Byte54: start 432, 8 bit, little-endian, data-type-policy=OVERRIDE, base-type=uint8, compu {phys=raw}, range phys 0..252
          signal TPDiagnosisFlashFBD_HMIPB_Byte55: start 440, 8 bit, little-endian, data-type-policy=OVERRIDE, base-type=uint8, compu {phys=raw}, range phys 0..252
          signal TPDiagnosisFlashFBD_HMIPB_Byte56: start 448, 8 bit, little-endian, data-type-policy=OVERRIDE, base-type=uint8, compu {phys=raw}, range phys 0..252
          signal TPDiagnosisFlashFBD_HMIPB_Byte57: start 456, 8 bit, little-endian, data-type-policy=OVERRIDE, base-type=uint8, compu {phys=raw}, range phys 0..252
          signal TPDiagnosisFlashFBD_HMIPB_Byte58: start 464, 8 bit, little-endian, data-type-policy=OVERRIDE, base-type=uint8, compu {phys=raw}, range phys 0..252
          signal TPDiagnosisFlashFBD_HMIPB_Byte59: start 472, 8 bit, little-endian, data-type-policy=OVERRIDE, base-type=uint8, compu {phys=raw}, range phys 0..252
          signal TPDiagnosisFlashFBD_HMIPB_Byte60: start 480, 8 bit, little-endian, data-type-policy=OVERRIDE, base-type=uint8, compu {phys=raw}, range phys 0..252
          signal TPDiagnosisFlashFBD_HMIPB_Byte61: start 488, 8 bit, little-endian, data-type-policy=OVERRIDE, base-type=uint8, compu {phys=raw}, range phys 0..252
          signal TPDiagnosisFlashFBD_HMIPB_Byte62: start 496, 8 bit, little-endian, data-type-policy=OVERRIDE, base-type=uint8, compu {phys=raw}, range phys 0..252
          signal TPDiagnosisFlashFBD_HMIPB_Byte63: start 504, 8 bit, little-endian, data-type-policy=OVERRIDE, base-type=uint8, compu {phys=raw}, range phys 0..252
      frame TPDiagnosisFlash_FBD_HR_IPB: id 0x2CD, frame-length=64, can-addressing-mode=STANDARD, can-frame-rx-behavior=CAN-FD, can-frame-tx-behavior=CAN-FD
        pdu TPDiagnosisFlash_FBD_HR_IPB: length=64, unused-bit-pattern=0
          signal TPDiagnosisFlashFBD_HRIPB_Byte00: start 0, 8 bit, little-endian, data-type-policy=OVERRIDE, base-type=uint8, compu {phys=raw}, range phys 0..252
          signal TPDiagnosisFlashFBD_HRIPB_Byte01: start 8, 8 bit, little-endian, data-type-policy=OVERRIDE, base-type=uint8, compu {phys=raw}, range phys 0..252
          signal TPDiagnosisFlashFBD_HRIPB_Byte02: start 16, 8 bit, little-endian, data-type-policy=OVERRIDE, base-type=uint8, compu {phys=raw}, range phys 0..252
          signal TPDiagnosisFlashFBD_HRIPB_Byte03: start 24, 8 bit, little-endian, data-type-policy=OVERRIDE, base-type=uint8, compu {phys=raw}, range phys 0..252
          signal TPDiagnosisFlashFBD_HRIPB_Byte04: start 32, 8 bit, little-endian, data-type-policy=OVERRIDE, base-type=uint8, compu {phys=raw}, range phys 0..252
          signal TPDiagnosisFlashFBD_HRIPB_Byte05: start 40, 8 bit, little-endian, data-type-policy=OVERRIDE, base-type=uint8, compu {phys=raw}, range phys 0..252
          signal TPDiagnosisFlashFBD_HRIPB_Byte06: start 48, 8 bit, little-endian, data-type-policy=OVERRIDE, base-type=uint8, compu {phys=raw}, range phys 0..252
          signal TPDiagnosisFlashFBD_HRIPB_Byte07: start 56, 8 bit, little-endian, data-type-policy=OVERRIDE, base-type=uint8, compu {phys=raw}, range phys 0..252
          signal TPDiagnosisFlashFBD_HRIPB_Byte08: start 64, 8 bit, little-endian, data-type-policy=OVERRIDE, base-type=uint8, compu {phys=raw}, range phys 0..252
          signal TPDiagnosisFlashFBD_HRIPB_Byte09: start 72, 8 bit, little-endian, data-type-policy=OVERRIDE, base-type=uint8, compu {phys=raw}, range phys 0..252
          signal TPDiagnosisFlashFBD_HRIPB_Byte10: start 80, 8 bit, little-endian, data-type-policy=OVERRIDE, base-type=uint8, compu {phys=raw}, range phys 0..252
          signal TPDiagnosisFlashFBD_HRIPB_Byte11: start 88, 8 bit, little-endian, data-type-policy=OVERRIDE, base-type=uint8, compu {phys=raw}, range phys 0..252
          signal TPDiagnosisFlashFBD_HRIPB_Byte12: start 96, 8 bit, little-endian, data-type-policy=OVERRIDE, base-type=uint8, compu {phys=raw}, range phys 0..252
          signal TPDiagnosisFlashFBD_HRIPB_Byte13: start 104, 8 bit, little-endian, data-type-policy=OVERRIDE, base-type=uint8, compu {phys=raw}, range phys 0..252
          signal TPDiagnosisFlashFBD_HRIPB_Byte14: start 112, 8 bit, little-endian, data-type-policy=OVERRIDE, base-type=uint8, compu {phys=raw}, range phys 0..252
          signal TPDiagnosisFlashFBD_HRIPB_Byte15: start 120, 8 bit, little-endian, data-type-policy=OVERRIDE, base-type=uint8, compu {phys=raw}, range phys 0..252
          signal TPDiagnosisFlashFBD_HRIPB_Byte16: start 128, 8 bit, little-endian, data-type-policy=OVERRIDE, base-type=uint8, compu {phys=raw}, range phys 0..252
          signal TPDiagnosisFlashFBD_HRIPB_Byte17: start 136, 8 bit, little-endian, data-type-policy=OVERRIDE, base-type=uint8, compu {phys=raw}, range phys 0..252
          signal TPDiagnosisFlashFBD_HRIPB_Byte18: start 144, 8 bit, little-endian, data-type-policy=OVERRIDE, base-type=uint8, compu {phys=raw}, range phys 0..252
          signal TPDiagnosisFlashFBD_HRIPB_Byte19: start 152, 8 bit, little-endian, data-type-policy=OVERRIDE, base-type=uint8, compu {phys=raw}, range phys 0..252
          signal TPDiagnosisFlashFBD_HRIPB_Byte20: start 160, 8 bit, little-endian, data-type-policy=OVERRIDE, base-type=uint8, compu {phys=raw}, range phys 0..252
          signal TPDiagnosisFlashFBD_HRIPB_Byte21: start 168, 8 bit, little-endian, data-type-policy=OVERRIDE, base-type=uint8, compu {phys=raw}, range phys 0..252
          signal TPDiagnosisFlashFBD_HRIPB_Byte22: start 176, 8 bit, little-endian, data-type-policy=OVERRIDE, base-type=uint8, compu {phys=raw}, range phys 0..252
          signal TPDiagnosisFlashFBD_HRIPB_Byte23: start 184, 8 bit, little-endian, data-type-policy=OVERRIDE, base-type=uint8, compu {phys=raw}, range phys 0..252
          signal TPDiagnosisFlashFBD_HRIPB_Byte24: start 192, 8 bit, little-endian, data-type-policy=OVERRIDE, base-type=uint8, compu {phys=raw}, range phys 0..252
          signal TPDiagnosisFlashFBD_HRIPB_Byte25: start 200, 8 bit, little-endian, data-type-policy=OVERRIDE, base-type=uint8, compu {phys=raw}, range phys 0..252
          signal TPDiagnosisFlashFBD_HRIPB_Byte26: start 208, 8 bit, little-endian, data-type-policy=OVERRIDE, base-type=uint8, compu {phys=raw}, range phys 0..252
          signal TPDiagnosisFlashFBD_HRIPB_Byte27: start 216, 8 bit, little-endian, data-type-policy=OVERRIDE, base-type=uint8, compu {phys=raw}, range phys 0..252
          signal TPDiagnosisFlashFBD_HRIPB_Byte28: start 224, 8 bit, little-endian, data-type-policy=OVERRIDE, base-type=uint8, compu {phys=raw}, range phys 0..252
          signal TPDiagnosisFlashFBD_HRIPB_Byte29: start 232, 8 bit, little-endian, data-type-policy=OVERRIDE, base-type=uint8, compu {phys=raw}, range phys 0..252
          signal TPDiagnosisFlashFBD_HRIPB_Byte30: start 240, 8 bit, little-endian, data-type-policy=OVERRIDE, base-type=uint8, compu {phys=raw}, range phys 0..252
          signal TPDiagnosisFlashFBD_HRIPB_Byte31: start 248, 8 bit, little-endian, data-type-policy=OVERRIDE, base-type=uint8, compu {phys=raw}, range phys 0..252
          signal TPDiagnosisFlashFBD_HRIPB_Byte32: start 256, 8 bit, little-endian, data-type-policy=OVERRIDE, base-type=uint8, compu {phys=raw}, range phys 0..252
          signal TPDiagnosisFlashFBD_HRIPB_Byte33: start 264, 8 bit, little-endian, data-type-policy=OVERRIDE, base-type=uint8, compu {phys=raw}, range phys 0..252
          signal TPDiagnosisFlashFBD_HRIPB_Byte34: start 272, 8 bit, little-endian, data-type-policy=OVERRIDE, base-type=uint8, compu {phys=raw}, range phys 0..252
          signal TPDiagnosisFlashFBD_HRIPB_Byte35: start 280, 8 bit, little-endian, data-type-policy=OVERRIDE, base-type=uint8, compu {phys=raw}, range phys 0..252
          signal TPDiagnosisFlashFBD_HRIPB_Byte36: start 288, 8 bit, little-endian, data-type-policy=OVERRIDE, base-type=uint8, compu {phys=raw}, range phys 0..252
          signal TPDiagnosisFlashFBD_HRIPB_Byte37: start 296, 8 bit, little-endian, data-type-policy=OVERRIDE, base-type=uint8, compu {phys=raw}, range phys 0..252
          signal TPDiagnosisFlashFBD_HRIPB_Byte38: start 304, 8 bit, little-endian, data-type-policy=OVERRIDE, base-type=uint8, compu {phys=raw}, range phys 0..252
          signal TPDiagnosisFlashFBD_HRIPB_Byte39: start 312, 8 bit, little-endian, data-type-policy=OVERRIDE, base-type=uint8, compu {phys=raw}, range phys 0..252
          signal TPDiagnosisFlashFBD_HRIPB_Byte40: start 320, 8 bit, little-endian, data-type-policy=OVERRIDE, base-type=uint8, compu {phys=raw}, range phys 0..252
          signal TPDiagnosisFlashFBD_HRIPB_Byte41: start 328, 8 bit, little-endian, data-type-policy=OVERRIDE, base-type=uint8, compu {phys=raw}, range phys 0..252
          signal TPDiagnosisFlashFBD_HRIPB_Byte42: start 336, 8 bit, little-endian, data-type-policy=OVERRIDE, base-type=uint8, compu {phys=raw}, range phys 0..252
          signal TPDiagnosisFlashFBD_HRIPB_Byte43: start 344, 8 bit, little-endian, data-type-policy=OVERRIDE, base-type=uint8, compu {phys=raw}, range phys 0..252
          signal TPDiagnosisFlashFBD_HRIPB_Byte44: start 352, 8 bit, little-endian, data-type-policy=OVERRIDE, base-type=uint8, compu {phys=raw}, range phys 0..252
          signal TPDiagnosisFlashFBD_HRIPB_Byte45: start 360, 8 bit, little-endian, data-type-policy=OVERRIDE, base-type=uint8, compu {phys=raw}, range phys 0..252
          signal TPDiagnosisFlashFBD_HRIPB_Byte46: start 368, 8 bit, little-endian, data-type-policy=OVERRIDE, base-type=uint8, compu {phys=raw}, range phys 0..252
          signal TPDiagnosisFlashFBD_HRIPB_Byte47: start 376, 8 bit, little-endian, data-type-policy=OVERRIDE, base-type=uint8, compu {phys=raw}, range phys 0..252
          signal TPDiagnosisFlashFBD_HRIPB_Byte48: start 384, 8 bit, little-endian, data-type-policy=OVERRIDE, base-type=uint8, compu {phys=raw}, range phys 0..252
          signal TPDiagnosisFlashFBD_HRIPB_Byte49: start 392, 8 bit, little-endian, data-type-policy=OVERRIDE, base-type=uint8, compu {phys=raw}, range phys 0..252
          signal TPDiagnosisFlashFBD_HRIPB_Byte50: start 400, 8 bit, little-endian, data-type-policy=OVERRIDE, base-type=uint8, compu {phys=raw}, range phys 0..252
          signal TPDiagnosisFlashFBD_HRIPB_Byte51: start 408, 8 bit, little-endian, data-type-policy=OVERRIDE, base-type=uint8, compu {phys=raw}, range phys 0..252
          signal TPDiagnosisFlashFBD_HRIPB_Byte52: start 416, 8 bit, little-endian, data-type-policy=OVERRIDE, base-type=uint8, compu {phys=raw}, range phys 0..252
          signal TPDiagnosisFlashFBD_HRIPB_Byte53: start 424, 8 bit, little-endian, data-type-policy=OVERRIDE, base-type=uint8, compu {phys=raw}, range phys 0..252
          signal TPDiagnosisFlashFBD_HRIPB_Byte54: start 432, 8 bit, little-endian, data-type-policy=OVERRIDE, base-type=uint8, compu {phys=raw}, range phys 0..252
          signal TPDiagnosisFlashFBD_HRIPB_Byte55: start 440, 8 bit, little-endian, data-type-policy=OVERRIDE, base-type=uint8, compu {phys=raw}, range phys 0..252
          signal TPDiagnosisFlashFBD_HRIPB_Byte56: start 448, 8 bit, little-endian, data-type-policy=OVERRIDE, base-type=uint8, compu {phys=raw}, range phys 0..252
          signal TPDiagnosisFlashFBD_HRIPB_Byte57: start 456, 8 bit, little-endian, data-type-policy=OVERRIDE, base-type=uint8, compu {phys=raw}, range phys 0..252
          signal TPDiagnosisFlashFBD_HRIPB_Byte58: start 464, 8 bit, little-endian, data-type-policy=OVERRIDE, base-type=uint8, compu {phys=raw}, range phys 0..252
          signal TPDiagnosisFlashFBD_HRIPB_Byte59: start 472, 8 bit, little-endian, data-type-policy=OVERRIDE, base-type=uint8, compu {phys=raw}, range phys 0..252
          signal TPDiagnosisFlashFBD_HRIPB_Byte60: start 480, 8 bit, little-endian, data-type-policy=OVERRIDE, base-type=uint8, compu {phys=raw}, range phys 0..252
          signal TPDiagnosisFlashFBD_HRIPB_Byte61: start 488, 8 bit, little-endian, data-type-policy=OVERRIDE, base-type=uint8, compu {phys=raw}, range phys 0..252
          signal TPDiagnosisFlashFBD_HRIPB_Byte62: start 496, 8 bit, little-endian, data-type-policy=OVERRIDE, base-type=uint8, compu {phys=raw}, range phys 0..252
          signal TPDiagnosisFlashFBD_HRIPB_Byte63: start 504, 8 bit, little-endian, data-type-policy=OVERRIDE, base-type=uint8, compu {phys=raw}, range phys 0..252
